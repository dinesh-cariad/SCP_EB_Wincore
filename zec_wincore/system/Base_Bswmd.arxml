AUTOSAR XML (schema 4-0-3)
standard types defined: Std_ReturnType, void, sint8, sint16, sint32, uint8, uint16, uint32, uint64, sint8_least, sint16_least, sint32_least, uint8_least, uint16_least, uint32_least, float32, float64, boolean
package /AUTOSAR_Std/ImplementationDataTypes
  impl type Std_VersionInfoType: category=STRUCTURE, type-emitter=BSW
    5 x element, all with category=TYPE_REFERENCE:
      vendorID: implementation-data-type=uint16
      moduleID: implementation-data-type=uint16
      sw_major_version: implementation-data-type=uint8
      sw_minor_version: implementation-data-type=uint8
      sw_patch_version: implementation-data-type=uint8
package /AUTOSAR_Platform/ImplementationDataTypes
  impl type ConstVoidPtr: category=DATA_REFERENCE, sw-pointer-target-props={target-category=VALUE, base-type=void, sw-impl-policy=CONST}, type-emitter=BSW
  impl type VoidPtr: category=DATA_REFERENCE, sw-pointer-target-props={target-category=VALUE, base-type=void}, type-emitter=BSW
package /AUTOSAR_Platform/CompuMethods
  compu method boolean_Literals: 0=FALSE, 1=TRUE
