[part 1 of 4: packages /E3_2_0 to /ECU]
AUTOSAR XML (schema 4-3-0)
package /E3_2_0
  system System: pnc-vector-length=7, pnc-vector-offset=1
    system mapping System_Mappings
      data-mappings:
        communication-direction=IN, data-element=ClimateControl_VR_XIX_Innenraumheizenelektrisch_XIX_Zone_VR.Geltungsbereich_E3_2_0.RP_IF_ACT102f_Notlaufposition_XIX_ClimateControl_VR_XIX_Innenraumheizenelektrisch_XIX_Zone_VR.DE_ACT102f_Notlaufposition, system-signal=ACT102f_Notlaufposition
        communication-direction=OUT, data-element=ClimateControl_VR_XIX_Innenraumheizenelektrisch_XIX_Zone_VR.Geltungsbereich_E3_2_0.SP_IF_STRG102f_Start_Position_XIX_ClimateControl_VR_XIX_Innenraumheizenelektrisch_XIX_Zone_VR.DE_STRG102f_Start_Position, system-signal=STRG102f_Start_Position
        communication-direction=IN, data-element=ClimateControl_VR_XIX_Innenraumheizenelektrisch_XIX_Zone_VR.Geltungsbereich_E3_2_0.RP_IF_ACT102f_Uebertemperatur_XIX_ClimateControl_VR_XIX_Innenraumheizenelektrisch_XIX_Zone_VR.DE_ACT102f_Uebertemperatur, system-signal=ACT102f_Uebertemperatur
        communication-direction=OUT, data-element=ClimateControl_VR_XIX_Innenraumheizenelektrisch_XIX_Zone_VR.Geltungsbereich_E3_2_0.SP_IF_STRG102f_Geschwindigkeitsvorgabe_XIX_ClimateControl_VR_XIX_Innenraumheizenelektrisch_XIX_Zone_VR.DE_STRG102f_Geschwindigkeitsvorgabe, system-signal=STRG102f_Geschwindigkeitsvorgabe
        communication-direction=OUT, data-element=ClimateControl_VR_XIX_Innenraumheizenelektrisch_XIX_Zone_VR.Geltungsbereich_E3_2_0.SP_IF_STRG102f_Freig_Blockiererkennung_XIX_ClimateControl_VR_XIX_Innenraumheizenelektrisch_XIX_Zone_VR.DE_STRG102f_Freig_Blockiererkennung, system-signal=STRG102f_Freig_Blockiererkennung
        communication-direction=IN, data-element=ClimateControl_VR_XIX_Innenraumheizenelektrisch_XIX_Zone_VR.Geltungsbereich_E3_2_0.RP_IF_ACT102f_Adresse_Aktuator_XIX_ClimateControl_VR_XIX_Innenraumheizenelektrisch_XIX_Zone_VR.DE_ACT102f_Adresse_Aktuator, system-signal=ACT102f_Adresse_Aktuator
        communication-direction=OUT, data-element=ClimateControl_VR_XIX_Innenraumheizenelektrisch_XIX_Zone_VR.Geltungsbereich_E3_2_0.SP_IF_STRG102f_PrgDaten_speichern_XIX_ClimateControl_VR_XIX_Innenraumheizenelektrisch_XIX_Zone_VR.DE_STRG102f_PrgDaten_speichern, system-signal=STRG102f_PrgDaten_speichern
        communication-direction=IN, data-element=ClimateControl_VR_XIX_Innenraumheizenelektrisch_XIX_Zone_VR.Geltungsbereich_E3_2_0.RP_IF_ACT102f_Geschwindigkeitsstatus_XIX_ClimateControl_VR_XIX_Innenraumheizenelektrisch_XIX_Zone_VR.DE_ACT102f_Geschwindigkeitsstatus, system-signal=ACT102f_Geschwindigkeitsstatus
        communication-direction=OUT, data-element=ClimateControl_VR_XIX_Innenraumheizenelektrisch_XIX_Zone_VR.Geltungsbereich_E3_2_0.SP_IF_STRG102f_Select_Positionsvorgabe_XIX_ClimateControl_VR_XIX_Innenraumheizenelektrisch_XIX_Zone_VR.DE_STRG102f_Select_Positionsvorgabe, system-signal=STRG102f_Select_Positionsvorgabe
        communication-direction=OUT, data-element=ClimateControl_VR_XIX_Innenraumheizenelektrisch_XIX_Zone_VR.Geltungsbereich_E3_2_0.SP_IF_STRG102f_Adresse_XIX_ClimateControl_VR_XIX_Innenraumheizenelektrisch_XIX_Zone_VR.DE_STRG102f_Adresse, system-signal=STRG102f_Adresse
        communication-direction=IN, data-element=ClimateControl_VR_XIX_Innenraumheizenelektrisch_XIX_Zone_VR.Geltungsbereich_E3_2_0.RP_IF_ACT102f_Versorgungsspannung_XIX_ClimateControl_VR_XIX_Innenraumheizenelektrisch_XIX_Zone_VR.DE_ACT102f_Versorgungsspannung, system-signal=ACT102f_Versorgungsspannung
        communication-direction=IN, data-element=ClimateControl_VR_XIX_Innenraumheizenelektrisch_XIX_Zone_VR.Geltungsbereich_E3_2_0.RP_IF_ACT102f_Selbsthaltemoment_XIX_ClimateControl_VR_XIX_Innenraumheizenelektrisch_XIX_Zone_VR.DE_ACT102f_Selbsthaltemoment, system-signal=ACT102f_Selbsthaltemoment
        communication-direction=OUT, data-element=ClimateControl_VR_XIX_Innenraumheizenelektrisch_XIX_Zone_VR.Geltungsbereich_E3_2_0.SP_IF_STRG102f_Stopmodus_XIX_ClimateControl_VR_XIX_Innenraumheizenelektrisch_XIX_Zone_VR.DE_STRG102f_Stopmodus, system-signal=STRG102f_Stopmodus
        communication-direction=IN, data-element=ClimateControl_VR_XIX_Innenraumheizenelektrisch_XIX_Zone_VR.Geltungsbereich_E3_2_0.RP_IF_ACT102f_Variante_XIX_ClimateControl_VR_XIX_Innenraumheizenelektrisch_XIX_Zone_VR.DE_ACT102f_Variante, system-signal=ACT102f_Variante
        communication-direction=OUT, data-element=ClimateControl_VR_XIX_Innenraumheizenelektrisch_XIX_Zone_VR.Geltungsbereich_E3_2_0.SP_IF_STRG102f_Notlaufposition_XIX_ClimateControl_VR_XIX_Innenraumheizenelektrisch_XIX_Zone_VR.DE_STRG102f_Notlaufposition, system-signal=STRG102f_Notlaufposition
        communication-direction=OUT, data-element=ClimateControl_VR_XIX_Innenraumheizenelektrisch_XIX_Zone_VR.Geltungsbereich_E3_2_0.SP_IF_STRG102f_Drehrichtung_XIX_ClimateControl_VR_XIX_Innenraumheizenelektrisch_XIX_Zone_VR.DE_STRG102f_Drehrichtung, system-signal=STRG102f_Drehrichtung
        communication-direction=OUT, data-element=ClimateControl_VR_XIX_Innenraumheizenelektrisch_XIX_Zone_VR.Geltungsbereich_E3_2_0.SP_IF_STRG102f_Spulenhaltebestromung_XIX_ClimateControl_VR_XIX_Innenraumheizenelektrisch_XIX_Zone_VR.DE_STRG102f_Spulenhaltebestromung, system-signal=STRG102f_Spulenhaltebestromung
        communication-direction=IN, data-element=ClimateControl_VR_XIX_Innenraumheizenelektrisch_XIX_Zone_VR.Geltungsbereich_E3_2_0.RP_IF_ACT102f_Notlauf_aufgetreten_XIX_ClimateControl_VR_XIX_Innenraumheizenelektrisch_XIX_Zone_VR.DE_ACT102f_Notlauf_aufgetreten, system-signal=ACT102f_Notlauf_aufgetreten
        communication-direction=OUT, data-element=ClimateControl_VR_XIX_Innenraumheizenelektrisch_XIX_Zone_VR.Geltungsbereich_E3_2_0.SP_IF_STRG102f_Soll_Position_XIX_ClimateControl_VR_XIX_Innenraumheizenelektrisch_XIX_Zone_VR.DE_STRG102f_Soll_Position, system-signal=STRG102f_Soll_Position
        communication-direction=IN, data-element=ClimateControl_VR_XIX_Innenraumheizenelektrisch_XIX_Zone_VR.Geltungsbereich_E3_2_0.RP_IF_ACT102f_Blockierung_aufgetreten_XIX_ClimateControl_VR_XIX_Innenraumheizenelektrisch_XIX_Zone_VR.DE_ACT102f_Blockierung_aufgetreten, system-signal=ACT102f_Blockierung_aufgetreten
        communication-direction=IN, data-element=ClimateControl_VR_XIX_Innenraumheizenelektrisch_XIX_Zone_VR.Geltungsbereich_E3_2_0.RP_IF_ACT102f_Notlauffreigabe_XIX_ClimateControl_VR_XIX_Innenraumheizenelektrisch_XIX_Zone_VR.DE_ACT102f_Notlauffreigabe, system-signal=ACT102f_Notlauffreigabe
        communication-direction=IN, data-element=ClimateControl_VR_XIX_Innenraumheizenelektrisch_XIX_Zone_VR.Geltungsbereich_E3_2_0.RP_IF_ACT102f_Reset_XIX_ClimateControl_VR_XIX_Innenraumheizenelektrisch_XIX_Zone_VR.DE_ACT102f_Reset, system-signal=ACT102f_Reset
        communication-direction=IN, data-element=ClimateControl_VR_XIX_Innenraumheizenelektrisch_XIX_Zone_VR.Geltungsbereich_E3_2_0.RP_IF_ACT102f_el_Defekt_XIX_ClimateControl_VR_XIX_Innenraumheizenelektrisch_XIX_Zone_VR.DE_ACT102f_el_Defekt, system-signal=ACT102f_el_Defekt
        communication-direction=IN, data-element=ClimateControl_VR_XIX_Innenraumheizenelektrisch_XIX_Zone_VR.Geltungsbereich_E3_2_0.RP_IF_ACT102f_Stopmodus_XIX_ClimateControl_VR_XIX_Innenraumheizenelektrisch_XIX_Zone_VR.DE_ACT102f_Stopmodus, system-signal=ACT102f_Stopmodus
        communication-direction=OUT, data-element=ClimateControl_VR_XIX_Innenraumheizenelektrisch_XIX_Zone_VR.Geltungsbereich_E3_2_0.SP_IF_STRG102f_Notlauffreigabe_XIX_ClimateControl_VR_XIX_Innenraumheizenelektrisch_XIX_Zone_VR.DE_STRG102f_Notlauffreigabe, system-signal=STRG102f_Notlauffreigabe
        communication-direction=IN, data-element=ClimateControl_VR_XIX_Innenraumheizenelektrisch_XIX_Zone_VR.Geltungsbereich_E3_2_0.RP_IF_ACT102f_Positionsvorgabe_Status_XIX_ClimateControl_VR_XIX_Innenraumheizenelektrisch_XIX_Zone_VR.DE_ACT102f_Positionsvorgabe_Status, system-signal=ACT102f_Positionsvorgabe_Status
        communication-direction=IN, data-element=ClimateControl_VR_XIX_Innenraumheizenelektrisch_XIX_Zone_VR.Geltungsbereich_E3_2_0.RP_IF_ACT102f_Sonderfunktionen_XIX_ClimateControl_VR_XIX_Innenraumheizenelektrisch_XIX_Zone_VR.DE_ACT102f_Sonderfunktionen, system-signal=ACT102f_Sonderfunktionen
        communication-direction=IN, data-element=ClimateControl_VR_XIX_Innenraumheizenelektrisch_XIX_Zone_VR.Geltungsbereich_E3_2_0.RP_IF_ACT102f_Verfahrrichtung_XIX_ClimateControl_VR_XIX_Innenraumheizenelektrisch_XIX_Zone_VR.DE_ACT102f_Verfahrrichtung, system-signal=ACT102f_Verfahrrichtung
        communication-direction=IN, data-element=ClimateControl_VR_XIX_Innenraumheizenelektrisch_XIX_Zone_VR.Geltungsbereich_E3_2_0.RP_IF_ACT102f_Spulenbestromung_XIX_ClimateControl_VR_XIX_Innenraumheizenelektrisch_XIX_Zone_VR.DE_ACT102f_Spulenbestromung, system-signal=ACT102f_Spulenbestromung
        communication-direction=OUT, data-element=ClimateControl_VR_XIX_Innenraumheizenelektrisch_XIX_Zone_VR.Geltungsbereich_E3_2_0.SP_IF_STRG102f_Clear_Event_Flags_XIX_ClimateControl_VR_XIX_Innenraumheizenelektrisch_XIX_Zone_VR.DE_STRG102f_Clear_Event_Flags, system-signal=STRG102f_Clear_Event_Flags
        communication-direction=IN, data-element=ClimateControl_VR_XIX_Innenraumheizenelektrisch_XIX_Zone_VR.Geltungsbereich_E3_2_0.RP_IF_ACT102f_Drehrichtung_XIX_ClimateControl_VR_XIX_Innenraumheizenelektrisch_XIX_Zone_VR.DE_ACT102f_Drehrichtung, system-signal=ACT102f_Drehrichtung
        communication-direction=IN, data-element=ClimateControl_VR_XIX_Innenraumheizenelektrisch_XIX_Zone_VR.Geltungsbereich_E3_2_0.RP_IF_ACT102f_Ist_Position_Aktuator_XIX_ClimateControl_VR_XIX_Innenraumheizenelektrisch_XIX_Zone_VR.DE_ACT102f_Ist_Position_Aktuator, system-signal=ACT102f_Ist_Position_Aktuator
        communication-direction=IN, data-element=ClimateControl_VR_XIX_Innenraumheizenelektrisch_XIX_Zone_VR.Geltungsbereich_E3_2_0.RP_IF_ACT106a_Sonderfunktionen_XIX_ClimateControl_VR_XIX_Innenraumheizenelektrisch_XIX_Zone_VR.DE_ACT106a_Sonderfunktionen, system-signal=ACT106a_Sonderfunktionen
        communication-direction=IN, data-element=ClimateControl_VR_XIX_Innenraumheizenelektrisch_XIX_Zone_VR.Geltungsbereich_E3_2_0.RP_IF_ACT105a_Spulenbestromung_XIX_ClimateControl_VR_XIX_Innenraumheizenelektrisch_XIX_Zone_VR.DE_ACT105a_Spulenbestromung, system-signal=ACT105a_Spulenbestromung
        communication-direction=IN, data-element=ClimateControl_VR_XIX_Innenraumheizenelektrisch_XIX_Zone_VR.Geltungsbereich_E3_2_0.RP_IF_ACT105a_Notlaufposition_XIX_ClimateControl_VR_XIX_Innenraumheizenelektrisch_XIX_Zone_VR.DE_ACT105a_Notlaufposition, system-signal=ACT105a_Notlaufposition
        communication-direction=OUT, data-element=ClimateControl_VR_XIX_Innenraumheizenelektrisch_XIX_Zone_VR.Geltungsbereich_E3_2_0.SP_IF_STRG109a_PrgDaten_speichern_XIX_ClimateControl_VR_XIX_Innenraumheizenelektrisch_XIX_Zone_VR.DE_STRG109a_PrgDaten_speichern, system-signal=STRG109a_PrgDaten_speichern
        communication-direction=OUT, data-element=ClimateControl_VR_XIX_Innenraumheizenelektrisch_XIX_Zone_VR.Geltungsbereich_E3_2_0.SP_IF_STRG104a_Select_Positionsvorgabe_XIX_ClimateControl_VR_XIX_Innenraumheizenelektrisch_XIX_Zone_VR.DE_STRG104a_Select_Positionsvorgabe, system-signal=STRG104a_Select_Positionsvorgabe
        communication-direction=OUT, data-element=ClimateControl_VR_XIX_Innenraumheizenelektrisch_XIX_Zone_VR.Geltungsbereich_E3_2_0.SP_IF_STRG106a_Geschwindigkeitsvorgabe_XIX_ClimateControl_VR_XIX_Innenraumheizenelektrisch_XIX_Zone_VR.DE_STRG106a_Geschwindigkeitsvorgabe, system-signal=STRG106a_Geschwindigkeitsvorgabe
        communication-direction=IN, data-element=ClimateControl_VR_XIX_Innenraumheizenelektrisch_XIX_Zone_VR.Geltungsbereich_E3_2_0.RP_IF_ACT109a_Drehrichtung_XIX_ClimateControl_VR_XIX_Innenraumheizenelektrisch_XIX_Zone_VR.DE_ACT109a_Drehrichtung, system-signal=ACT109a_Drehrichtung
        communication-direction=IN, data-element=ClimateControl_VR_XIX_Innenraumheizenelektrisch_XIX_Zone_VR.Geltungsbereich_E3_2_0.RP_IF_ACT104a_Spulenbestromung_XIX_ClimateControl_VR_XIX_Innenraumheizenelektrisch_XIX_Zone_VR.DE_ACT104a_Spulenbestromung, system-signal=ACT104a_Spulenbestromung
        communication-direction=IN, data-element=ClimateControl_VR_XIX_Innenraumheizenelektrisch_XIX_Zone_VR.Geltungsbereich_E3_2_0.RP_IF_ACT105a_Uebertemperatur_XIX_ClimateControl_VR_XIX_Innenraumheizenelektrisch_XIX_Zone_VR.DE_ACT105a_Uebertemperatur, system-signal=ACT105a_Uebertemperatur
        communication-direction=IN, data-element=ClimateControl_VR_XIX_Innenraumheizenelektrisch_XIX_Zone_VR.Geltungsbereich_E3_2_0.RP_IF_ACT106a_Reset_XIX_ClimateControl_VR_XIX_Innenraumheizenelektrisch_XIX_Zone_VR.DE_ACT106a_Reset, system-signal=ACT106a_Reset
        communication-direction=IN, data-element=ClimateControl_VR_XIX_Innenraumheizenelektrisch_XIX_Zone_VR.Geltungsbereich_E3_2_0.RP_IF_ACT106a_el_Defekt_XIX_ClimateControl_VR_XIX_Innenraumheizenelektrisch_XIX_Zone_VR.DE_ACT106a_el_Defekt, system-signal=ACT106a_el_Defekt
        communication-direction=IN, data-element=ClimateControl_VR_XIX_Innenraumheizenelektrisch_XIX_Zone_VR.Geltungsbereich_E3_2_0.RP_IF_ACT105a_Blockierung_aufgetreten_XIX_ClimateControl_VR_XIX_Innenraumheizenelektrisch_XIX_Zone_VR.DE_ACT105a_Blockierung_aufgetreten, system-signal=ACT105a_Blockierung_aufgetreten
        communication-direction=OUT, data-element=ClimateControl_VR_XIX_Innenraumheizenelektrisch_XIX_Zone_VR.Geltungsbereich_E3_2_0.SP_IF_STRG106a_PrgDaten_speichern_XIX_ClimateControl_VR_XIX_Innenraumheizenelektrisch_XIX_Zone_VR.DE_STRG106a_PrgDaten_speichern, system-signal=STRG106a_PrgDaten_speichern
        communication-direction=IN, data-element=ClimateControl_VR_XIX_Innenraumheizenelektrisch_XIX_Zone_VR.Geltungsbereich_E3_2_0.RP_IF_ACT109a_Ist_Position_Aktuator_XIX_ClimateControl_VR_XIX_Innenraumheizenelektrisch_XIX_Zone_VR.DE_ACT109a_Ist_Position_Aktuator, system-signal=ACT109a_Ist_Position_Aktuator
        communication-direction=IN, data-element=ClimateControl_VR_XIX_Innenraumheizenelektrisch_XIX_Zone_VR.Geltungsbereich_E3_2_0.RP_IF_ACT106a_Spulenbestromung_XIX_ClimateControl_VR_XIX_Innenraumheizenelektrisch_XIX_Zone_VR.DE_ACT106a_Spulenbestromung, system-signal=ACT106a_Spulenbestromung
        communication-direction=IN, data-element=ClimateControl_VR_XIX_Innenraumheizenelektrisch_XIX_Zone_VR.Geltungsbereich_E3_2_0.RP_IF_ACT109a_Stopmodus_XIX_ClimateControl_VR_XIX_Innenraumheizenelektrisch_XIX_Zone_VR.DE_ACT109a_Stopmodus, system-signal=ACT109a_Stopmodus
        communication-direction=IN, data-element=ClimateControl_VR_XIX_Innenraumheizenelektrisch_XIX_Zone_VR.Geltungsbereich_E3_2_0.RP_IF_ACT105a_Variante_XIX_ClimateControl_VR_XIX_Innenraumheizenelektrisch_XIX_Zone_VR.DE_ACT105a_Variante, system-signal=ACT105a_Variante
        communication-direction=IN, data-element=ClimateControl_VR_XIX_Innenraumheizenelektrisch_XIX_Zone_VR.Geltungsbereich_E3_2_0.RP_IF_ACT109a_Blockierung_aufgetreten_XIX_ClimateControl_VR_XIX_Innenraumheizenelektrisch_XIX_Zone_VR.DE_ACT109a_Blockierung_aufgetreten, system-signal=ACT109a_Blockierung_aufgetreten
        communication-direction=OUT, data-element=ClimateControl_VR_XIX_Innenraumheizenelektrisch_XIX_Zone_VR.Geltungsbereich_E3_2_0.SP_IF_STRG104a_Soll_Position_XIX_ClimateControl_VR_XIX_Innenraumheizenelektrisch_XIX_Zone_VR.DE_STRG104a_Soll_Position, system-signal=STRG104a_Soll_Position
        communication-direction=IN, data-element=ClimateControl_VR_XIX_Innenraumheizenelektrisch_XIX_Zone_VR.Geltungsbereich_E3_2_0.RP_IF_ACT109a_Verfahrrichtung_XIX_ClimateControl_VR_XIX_Innenraumheizenelektrisch_XIX_Zone_VR.DE_ACT109a_Verfahrrichtung, system-signal=ACT109a_Verfahrrichtung
        communication-direction=IN, data-element=ClimateControl_VR_XIX_Innenraumheizenelektrisch_XIX_Zone_VR.Geltungsbereich_E3_2_0.RP_IF_ACT104a_Notlaufposition_XIX_ClimateControl_VR_XIX_Innenraumheizenelektrisch_XIX_Zone_VR.DE_ACT104a_Notlaufposition, system-signal=ACT104a_Notlaufposition
        communication-direction=IN, data-element=ClimateControl_VR_XIX_Innenraumheizenelektrisch_XIX_Zone_VR.Geltungsbereich_E3_2_0.RP_IF_ACT105a_Stopmodus_XIX_ClimateControl_VR_XIX_Innenraumheizenelektrisch_XIX_Zone_VR.DE_ACT105a_Stopmodus, system-signal=ACT105a_Stopmodus
        communication-direction=IN, data-element=ClimateControl_VR_XIX_Innenraumheizenelektrisch_XIX_Zone_VR.Geltungsbereich_E3_2_0.RP_IF_ACT104a_Ist_Position_Aktuator_XIX_ClimateControl_VR_XIX_Innenraumheizenelektrisch_XIX_Zone_VR.DE_ACT104a_Ist_Position_Aktuator, system-signal=ACT104a_Ist_Position_Aktuator
        communication-direction=OUT, data-element=ClimateControl_VR_XIX_Innenraumheizenelektrisch_XIX_Zone_VR.Geltungsbereich_E3_2_0.SP_IF_STRG106a_Adresse_XIX_ClimateControl_VR_XIX_Innenraumheizenelektrisch_XIX_Zone_VR.DE_STRG106a_Adresse, system-signal=STRG106a_Adresse
        communication-direction=IN, data-element=ClimateControl_VR_XIX_Innenraumheizenelektrisch_XIX_Zone_VR.Geltungsbereich_E3_2_0.RP_IF_ACT106a_Selbsthaltemoment_XIX_ClimateControl_VR_XIX_Innenraumheizenelektrisch_XIX_Zone_VR.DE_ACT106a_Selbsthaltemoment, system-signal=ACT106a_Selbsthaltemoment
        communication-direction=IN, data-element=ClimateControl_VR_XIX_Innenraumheizenelektrisch_XIX_Zone_VR.Geltungsbereich_E3_2_0.RP_IF_ACT106a_Stopmodus_XIX_ClimateControl_VR_XIX_Innenraumheizenelektrisch_XIX_Zone_VR.DE_ACT106a_Stopmodus, system-signal=ACT106a_Stopmodus
        communication-direction=OUT, data-element=ClimateControl_VR_XIX_Innenraumheizenelektrisch_XIX_Zone_VR.Geltungsbereich_E3_2_0.SP_IF_STRG105a_Freig_Blockiererkennung_XIX_ClimateControl_VR_XIX_Innenraumheizenelektrisch_XIX_Zone_VR.DE_STRG105a_Freig_Blockiererkennung, system-signal=STRG105a_Freig_Blockiererkennung
        communication-direction=IN, data-element=ClimateControl_VR_XIX_Innenraumheizenelektrisch_XIX_Zone_VR.Geltungsbereich_E3_2_0.RP_IF_ACT109a_Geschwindigkeitsstatus_XIX_ClimateControl_VR_XIX_Innenraumheizenelektrisch_XIX_Zone_VR.DE_ACT109a_Geschwindigkeitsstatus, system-signal=ACT109a_Geschwindigkeitsstatus
        communication-direction=OUT, data-element=ClimateControl_VR_XIX_Innenraumheizenelektrisch_XIX_Zone_VR.Geltungsbereich_E3_2_0.SP_IF_STRG106a_Freig_Blockiererkennung_XIX_ClimateControl_VR_XIX_Innenraumheizenelektrisch_XIX_Zone_VR.DE_STRG106a_Freig_Blockiererkennung, system-signal=STRG106a_Freig_Blockiererkennung
        communication-direction=OUT, data-element=ClimateControl_VR_XIX_Innenraumheizenelektrisch_XIX_Zone_VR.Geltungsbereich_E3_2_0.SP_IF_STRG109a_Soll_Position_XIX_ClimateControl_VR_XIX_Innenraumheizenelektrisch_XIX_Zone_VR.DE_STRG109a_Soll_Position, system-signal=STRG109a_Soll_Position
        communication-direction=IN, data-element=ClimateControl_VR_XIX_Innenraumheizenelektrisch_XIX_Zone_VR.Geltungsbereich_E3_2_0.RP_IF_ACT109a_Notlauf_aufgetreten_XIX_ClimateControl_VR_XIX_Innenraumheizenelektrisch_XIX_Zone_VR.DE_ACT109a_Notlauf_aufgetreten, system-signal=ACT109a_Notlauf_aufgetreten
        communication-direction=IN, data-element=ClimateControl_VR_XIX_Innenraumheizenelektrisch_XIX_Zone_VR.Geltungsbereich_E3_2_0.RP_IF_ACT104a_el_Defekt_XIX_ClimateControl_VR_XIX_Innenraumheizenelektrisch_XIX_Zone_VR.DE_ACT104a_el_Defekt, system-signal=ACT104a_el_Defekt
        communication-direction=IN, data-element=ClimateControl_VR_XIX_Innenraumheizenelektrisch_XIX_Zone_VR.Geltungsbereich_E3_2_0.RP_IF_ACT109a_Notlaufposition_XIX_ClimateControl_VR_XIX_Innenraumheizenelektrisch_XIX_Zone_VR.DE_ACT109a_Notlaufposition, system-signal=ACT109a_Notlaufposition
        communication-direction=IN, data-element=ClimateControl_VR_XIX_Innenraumheizenelektrisch_XIX_Zone_VR.Geltungsbereich_E3_2_0.RP_IF_ACT105a_el_Defekt_XIX_ClimateControl_VR_XIX_Innenraumheizenelektrisch_XIX_Zone_VR.DE_ACT105a_el_Defekt, system-signal=ACT105a_el_Defekt
        communication-direction=OUT, data-element=ClimateControl_VR_XIX_Innenraumheizenelektrisch_XIX_Zone_VR.Geltungsbereich_E3_2_0.SP_IF_STRG109a_Notlaufposition_XIX_ClimateControl_VR_XIX_Innenraumheizenelektrisch_XIX_Zone_VR.DE_STRG109a_Notlaufposition, system-signal=STRG109a_Notlaufposition
        communication-direction=IN, data-element=ClimateControl_VR_XIX_Innenraumheizenelektrisch_XIX_Zone_VR.Geltungsbereich_E3_2_0.RP_IF_ACT105a_Notlauffreigabe_XIX_ClimateControl_VR_XIX_Innenraumheizenelektrisch_XIX_Zone_VR.DE_ACT105a_Notlauffreigabe, system-signal=ACT105a_Notlauffreigabe
        communication-direction=IN, data-element=ClimateControl_VR_XIX_Innenraumheizenelektrisch_XIX_Zone_VR.Geltungsbereich_E3_2_0.RP_IF_ACT109a_el_Defekt_XIX_ClimateControl_VR_XIX_Innenraumheizenelektrisch_XIX_Zone_VR.DE_ACT109a_el_Defekt, system-signal=ACT109a_el_Defekt
        communication-direction=OUT, data-element=ClimateControl_VR_XIX_Innenraumheizenelektrisch_XIX_Zone_VR.Geltungsbereich_E3_2_0.SP_IF_STRG104a_Notlauffreigabe_XIX_ClimateControl_VR_XIX_Innenraumheizenelektrisch_XIX_Zone_VR.DE_STRG104a_Notlauffreigabe, system-signal=STRG104a_Notlauffreigabe
        communication-direction=IN, data-element=ClimateControl_VR_XIX_Innenraumheizenelektrisch_XIX_Zone_VR.Geltungsbereich_E3_2_0.RP_IF_ACT104a_Drehrichtung_XIX_ClimateControl_VR_XIX_Innenraumheizenelektrisch_XIX_Zone_VR.DE_ACT104a_Drehrichtung, system-signal=ACT104a_Drehrichtung
        communication-direction=IN, data-element=ClimateControl_VR_XIX_Innenraumheizenelektrisch_XIX_Zone_VR.Geltungsbereich_E3_2_0.RP_IF_ACT109a_Sonderfunktionen_XIX_ClimateControl_VR_XIX_Innenraumheizenelektrisch_XIX_Zone_VR.DE_ACT109a_Sonderfunktionen, system-signal=ACT109a_Sonderfunktionen
        communication-direction=IN, data-element=ClimateControl_VR_XIX_Innenraumheizenelektrisch_XIX_Zone_VR.Geltungsbereich_E3_2_0.RP_IF_ACT109a_Spulenbestromung_XIX_ClimateControl_VR_XIX_Innenraumheizenelektrisch_XIX_Zone_VR.DE_ACT109a_Spulenbestromung, system-signal=ACT109a_Spulenbestromung
        communication-direction=OUT, data-element=ClimateControl_VR_XIX_Innenraumheizenelektrisch_XIX_Zone_VR.Geltungsbereich_E3_2_0.SP_IF_STRG106a_Select_Positionsvorgabe_XIX_ClimateControl_VR_XIX_Innenraumheizenelektrisch_XIX_Zone_VR.DE_STRG106a_Select_Positionsvorgabe, system-signal=STRG106a_Select_Positionsvorgabe
        communication-direction=IN, data-element=ClimateControl_VR_XIX_Innenraumheizenelektrisch_XIX_Zone_VR.Geltungsbereich_E3_2_0.RP_IF_ACT104a_Stopmodus_XIX_ClimateControl_VR_XIX_Innenraumheizenelektrisch_XIX_Zone_VR.DE_ACT104a_Stopmodus, system-signal=ACT104a_Stopmodus
        communication-direction=IN, data-element=ClimateControl_VR_XIX_Innenraumheizenelektrisch_XIX_Zone_VR.Geltungsbereich_E3_2_0.RP_IF_ACT105a_Notlauf_aufgetreten_XIX_ClimateControl_VR_XIX_Innenraumheizenelektrisch_XIX_Zone_VR.DE_ACT105a_Notlauf_aufgetreten, system-signal=ACT105a_Notlauf_aufgetreten
        communication-direction=OUT, data-element=ClimateControl_VR_XIX_Innenraumheizenelektrisch_XIX_Zone_VR.Geltungsbereich_E3_2_0.SP_IF_STRG105a_PrgDaten_speichern_XIX_ClimateControl_VR_XIX_Innenraumheizenelektrisch_XIX_Zone_VR.DE_STRG105a_PrgDaten_speichern, system-signal=STRG105a_PrgDaten_speichern
        communication-direction=IN, data-element=ClimateControl_VR_XIX_Innenraumheizenelektrisch_XIX_Zone_VR.Geltungsbereich_E3_2_0.RP_IF_ACT104a_Notlauffreigabe_XIX_ClimateControl_VR_XIX_Innenraumheizenelektrisch_XIX_Zone_VR.DE_ACT104a_Notlauffreigabe, system-signal=ACT104a_Notlauffreigabe
        communication-direction=IN, data-element=ClimateControl_VR_XIX_Innenraumheizenelektrisch_XIX_Zone_VR.Geltungsbereich_E3_2_0.RP_IF_ACT104a_Sonderfunktionen_XIX_ClimateControl_VR_XIX_Innenraumheizenelektrisch_XIX_Zone_VR.DE_ACT104a_Sonderfunktionen, system-signal=ACT104a_Sonderfunktionen
        communication-direction=OUT, data-element=ClimateControl_VR_XIX_Innenraumheizenelektrisch_XIX_Zone_VR.Geltungsbereich_E3_2_0.SP_IF_STRG104a_Adresse_XIX_ClimateControl_VR_XIX_Innenraumheizenelektrisch_XIX_Zone_VR.DE_STRG104a_Adresse, system-signal=STRG104a_Adresse
        communication-direction=OUT, data-element=ClimateControl_VR_XIX_Innenraumheizenelektrisch_XIX_Zone_VR.Geltungsbereich_E3_2_0.SP_IF_STRG105a_Select_Positionsvorgabe_XIX_ClimateControl_VR_XIX_Innenraumheizenelektrisch_XIX_Zone_VR.DE_STRG105a_Select_Positionsvorgabe, system-signal=STRG105a_Select_Positionsvorgabe
        communication-direction=OUT, data-element=ClimateControl_VR_XIX_Innenraumheizenelektrisch_XIX_Zone_VR.Geltungsbereich_E3_2_0.SP_IF_STRG105a_Notlaufposition_XIX_ClimateControl_VR_XIX_Innenraumheizenelektrisch_XIX_Zone_VR.DE_STRG105a_Notlaufposition, system-signal=STRG105a_Notlaufposition
        communication-direction=IN, data-element=ClimateControl_VR_XIX_Innenraumheizenelektrisch_XIX_Zone_VR.Geltungsbereich_E3_2_0.RP_IF_ACT105a_Ist_Position_Aktuator_XIX_ClimateControl_VR_XIX_Innenraumheizenelektrisch_XIX_Zone_VR.DE_ACT105a_Ist_Position_Aktuator, system-signal=ACT105a_Ist_Position_Aktuator
        communication-direction=OUT, data-element=ClimateControl_VR_XIX_Innenraumheizenelektrisch_XIX_Zone_VR.Geltungsbereich_E3_2_0.SP_IF_STRG106a_Soll_Position_XIX_ClimateControl_VR_XIX_Innenraumheizenelektrisch_XIX_Zone_VR.DE_STRG106a_Soll_Position, system-signal=STRG106a_Soll_Position
        communication-direction=IN, data-element=ClimateControl_VR_XIX_Innenraumheizenelektrisch_XIX_Zone_VR.Geltungsbereich_E3_2_0.RP_IF_ACT105a_Verfahrrichtung_XIX_ClimateControl_VR_XIX_Innenraumheizenelektrisch_XIX_Zone_VR.DE_ACT105a_Verfahrrichtung, system-signal=ACT105a_Verfahrrichtung
        communication-direction=IN, data-element=ClimateControl_VR_XIX_Innenraumheizenelektrisch_XIX_Zone_VR.Geltungsbereich_E3_2_0.RP_IF_ACT106a_Uebertemperatur_XIX_ClimateControl_VR_XIX_Innenraumheizenelektrisch_XIX_Zone_VR.DE_ACT106a_Uebertemperatur, system-signal=ACT106a_Uebertemperatur
        communication-direction=IN, data-element=ClimateControl_VR_XIX_Innenraumheizenelektrisch_XIX_Zone_VR.Geltungsbereich_E3_2_0.RP_IF_ACT106a_Versorgungsspannung_XIX_ClimateControl_VR_XIX_Innenraumheizenelektrisch_XIX_Zone_VR.DE_ACT106a_Versorgungsspannung, system-signal=ACT106a_Versorgungsspannung
        communication-direction=IN, data-element=ClimateControl_VR_XIX_Innenraumheizenelektrisch_XIX_Zone_VR.Geltungsbereich_E3_2_0.RP_IF_ACT109a_Adresse_Aktuator_XIX_ClimateControl_VR_XIX_Innenraumheizenelektrisch_XIX_Zone_VR.DE_ACT109a_Adresse_Aktuator, system-signal=ACT109a_Adresse_Aktuator
        communication-direction=OUT, data-element=ClimateControl_VR_XIX_Innenraumheizenelektrisch_XIX_Zone_VR.Geltungsbereich_E3_2_0.SP_IF_STRG105a_Start_Position_XIX_ClimateControl_VR_XIX_Innenraumheizenelektrisch_XIX_Zone_VR.DE_STRG105a_Start_Position, system-signal=STRG105a_Start_Position
        communication-direction=OUT, data-element=ClimateControl_VR_XIX_Innenraumheizenelektrisch_XIX_Zone_VR.Geltungsbereich_E3_2_0.SP_IF_STRG109a_Select_Positionsvorgabe_XIX_ClimateControl_VR_XIX_Innenraumheizenelektrisch_XIX_Zone_VR.DE_STRG109a_Select_Positionsvorgabe, system-signal=STRG109a_Select_Positionsvorgabe
        communication-direction=OUT, data-element=ClimateControl_VR_XIX_Innenraumheizenelektrisch_XIX_Zone_VR.Geltungsbereich_E3_2_0.SP_IF_STRG104a_Start_Position_XIX_ClimateControl_VR_XIX_Innenraumheizenelektrisch_XIX_Zone_VR.DE_STRG104a_Start_Position, system-signal=STRG104a_Start_Position
        communication-direction=IN, data-element=ClimateControl_VR_XIX_Innenraumheizenelektrisch_XIX_Zone_VR.Geltungsbereich_E3_2_0.RP_IF_ACT106a_Variante_XIX_ClimateControl_VR_XIX_Innenraumheizenelektrisch_XIX_Zone_VR.DE_ACT106a_Variante, system-signal=ACT106a_Variante
        communication-direction=IN, data-element=ClimateControl_VR_XIX_Innenraumheizenelektrisch_XIX_Zone_VR.Geltungsbereich_E3_2_0.RP_IF_ACT104a_Verfahrrichtung_XIX_ClimateControl_VR_XIX_Innenraumheizenelektrisch_XIX_Zone_VR.DE_ACT104a_Verfahrrichtung, system-signal=ACT104a_Verfahrrichtung
        communication-direction=IN, data-element=ClimateControl_VR_XIX_Innenraumheizenelektrisch_XIX_Zone_VR.Geltungsbereich_E3_2_0.RP_IF_ACT106a_Verfahrrichtung_XIX_ClimateControl_VR_XIX_Innenraumheizenelektrisch_XIX_Zone_VR.DE_ACT106a_Verfahrrichtung, system-signal=ACT106a_Verfahrrichtung
        communication-direction=IN, data-element=ClimateControl_VR_XIX_Innenraumheizenelektrisch_XIX_Zone_VR.Geltungsbereich_E3_2_0.RP_IF_ACT104a_Adresse_Aktuator_XIX_ClimateControl_VR_XIX_Innenraumheizenelektrisch_XIX_Zone_VR.DE_ACT104a_Adresse_Aktuator, system-signal=ACT104a_Adresse_Aktuator
        communication-direction=OUT, data-element=ClimateControl_VR_XIX_Innenraumheizenelektrisch_XIX_Zone_VR.Geltungsbereich_E3_2_0.SP_IF_STRG104a_Spulenhaltebestromung_XIX_ClimateControl_VR_XIX_Innenraumheizenelektrisch_XIX_Zone_VR.DE_STRG104a_Spulenhaltebestromung, system-signal=STRG104a_Spulenhaltebestromung
        communication-direction=IN, data-element=ClimateControl_VR_XIX_Innenraumheizenelektrisch_XIX_Zone_VR.Geltungsbereich_E3_2_0.RP_IF_ACT104a_Selbsthaltemoment_XIX_ClimateControl_VR_XIX_Innenraumheizenelektrisch_XIX_Zone_VR.DE_ACT104a_Selbsthaltemoment, system-signal=ACT104a_Selbsthaltemoment
        communication-direction=IN, data-element=ClimateControl_VR_XIX_Innenraumheizenelektrisch_XIX_Zone_VR.Geltungsbereich_E3_2_0.RP_IF_ACT104a_Variante_XIX_ClimateControl_VR_XIX_Innenraumheizenelektrisch_XIX_Zone_VR.DE_ACT104a_Variante, system-signal=ACT104a_Variante
        communication-direction=IN, data-element=ClimateControl_VR_XIX_Innenraumheizenelektrisch_XIX_Zone_VR.Geltungsbereich_E3_2_0.RP_IF_ACT106a_Adresse_Aktuator_XIX_ClimateControl_VR_XIX_Innenraumheizenelektrisch_XIX_Zone_VR.DE_ACT106a_Adresse_Aktuator, system-signal=ACT106a_Adresse_Aktuator
        communication-direction=IN, data-element=ClimateControl_VR_XIX_Innenraumheizenelektrisch_XIX_Zone_VR.Geltungsbereich_E3_2_0.RP_IF_ACT106a_Positionsvorgabe_Status_XIX_ClimateControl_VR_XIX_Innenraumheizenelektrisch_XIX_Zone_VR.DE_ACT106a_Positionsvorgabe_Status, system-signal=ACT106a_Positionsvorgabe_Status
        communication-direction=OUT, data-element=ClimateControl_VR_XIX_Innenraumheizenelektrisch_XIX_Zone_VR.Geltungsbereich_E3_2_0.SP_IF_STRG104a_Stopmodus_XIX_ClimateControl_VR_XIX_Innenraumheizenelektrisch_XIX_Zone_VR.DE_STRG104a_Stopmodus, system-signal=STRG104a_Stopmodus
        communication-direction=OUT, data-element=ClimateControl_VR_XIX_Innenraumheizenelektrisch_XIX_Zone_VR.Geltungsbereich_E3_2_0.SP_IF_STRG105a_Drehrichtung_XIX_ClimateControl_VR_XIX_Innenraumheizenelektrisch_XIX_Zone_VR.DE_STRG105a_Drehrichtung, system-signal=STRG105a_Drehrichtung
        communication-direction=OUT, data-element=ClimateControl_VR_XIX_Innenraumheizenelektrisch_XIX_Zone_VR.Geltungsbereich_E3_2_0.SP_IF_STRG104a_PrgDaten_speichern_XIX_ClimateControl_VR_XIX_Innenraumheizenelektrisch_XIX_Zone_VR.DE_STRG104a_PrgDaten_speichern, system-signal=STRG104a_PrgDaten_speichern
        communication-direction=OUT, data-element=ClimateControl_VR_XIX_Innenraumheizenelektrisch_XIX_Zone_VR.Geltungsbereich_E3_2_0.SP_IF_STRG109a_Notlauffreigabe_XIX_ClimateControl_VR_XIX_Innenraumheizenelektrisch_XIX_Zone_VR.DE_STRG109a_Notlauffreigabe, system-signal=STRG109a_Notlauffreigabe
        communication-direction=OUT, data-element=ClimateControl_VR_XIX_Innenraumheizenelektrisch_XIX_Zone_VR.Geltungsbereich_E3_2_0.SP_IF_STRG106a_Notlauffreigabe_XIX_ClimateControl_VR_XIX_Innenraumheizenelektrisch_XIX_Zone_VR.DE_STRG106a_Notlauffreigabe, system-signal=STRG106a_Notlauffreigabe
        communication-direction=OUT, data-element=ClimateControl_VR_XIX_Innenraumheizenelektrisch_XIX_Zone_VR.Geltungsbereich_E3_2_0.SP_IF_STRG109a_Freig_Blockiererkennung_XIX_ClimateControl_VR_XIX_Innenraumheizenelektrisch_XIX_Zone_VR.DE_STRG109a_Freig_Blockiererkennung, system-signal=STRG109a_Freig_Blockiererkennung
        communication-direction=OUT, data-element=ClimateControl_VR_XIX_Innenraumheizenelektrisch_XIX_Zone_VR.Geltungsbereich_E3_2_0.SP_IF_STRG106a_Clear_Event_Flags_XIX_ClimateControl_VR_XIX_Innenraumheizenelektrisch_XIX_Zone_VR.DE_STRG106a_Clear_Event_Flags, system-signal=STRG106a_Clear_Event_Flags
        communication-direction=IN, data-element=ClimateControl_VR_XIX_Innenraumheizenelektrisch_XIX_Zone_VR.Geltungsbereich_E3_2_0.RP_IF_ACT105a_Reset_XIX_ClimateControl_VR_XIX_Innenraumheizenelektrisch_XIX_Zone_VR.DE_ACT105a_Reset, system-signal=ACT105a_Reset
        communication-direction=OUT, data-element=ClimateControl_VR_XIX_Innenraumheizenelektrisch_XIX_Zone_VR.Geltungsbereich_E3_2_0.SP_IF_STRG109a_Geschwindigkeitsvorgabe_XIX_ClimateControl_VR_XIX_Innenraumheizenelektrisch_XIX_Zone_VR.DE_STRG109a_Geschwindigkeitsvorgabe, system-signal=STRG109a_Geschwindigkeitsvorgabe
        communication-direction=IN, data-element=ClimateControl_VR_XIX_Innenraumheizenelektrisch_XIX_Zone_VR.Geltungsbereich_E3_2_0.RP_IF_ACT105a_Drehrichtung_XIX_ClimateControl_VR_XIX_Innenraumheizenelektrisch_XIX_Zone_VR.DE_ACT105a_Drehrichtung, system-signal=ACT105a_Drehrichtung
        communication-direction=IN, data-element=ClimateControl_VR_XIX_Innenraumheizenelektrisch_XIX_Zone_VR.Geltungsbereich_E3_2_0.RP_IF_ACT109a_Positionsvorgabe_Status_XIX_ClimateControl_VR_XIX_Innenraumheizenelektrisch_XIX_Zone_VR.DE_ACT109a_Positionsvorgabe_Status, system-signal=ACT109a_Positionsvorgabe_Status
        communication-direction=OUT, data-element=ClimateControl_VR_XIX_Innenraumheizenelektrisch_XIX_Zone_VR.Geltungsbereich_E3_2_0.SP_IF_STRG105a_Geschwindigkeitsvorgabe_XIX_ClimateControl_VR_XIX_Innenraumheizenelektrisch_XIX_Zone_VR.DE_STRG105a_Geschwindigkeitsvorgabe, system-signal=STRG105a_Geschwindigkeitsvorgabe
        communication-direction=IN, data-element=ClimateControl_VR_XIX_Innenraumheizenelektrisch_XIX_Zone_VR.Geltungsbereich_E3_2_0.RP_IF_ACT106a_Drehrichtung_XIX_ClimateControl_VR_XIX_Innenraumheizenelektrisch_XIX_Zone_VR.DE_ACT106a_Drehrichtung, system-signal=ACT106a_Drehrichtung
        communication-direction=IN, data-element=ClimateControl_VR_XIX_Innenraumheizenelektrisch_XIX_Zone_VR.Geltungsbereich_E3_2_0.RP_IF_ACT109a_Reset_XIX_ClimateControl_VR_XIX_Innenraumheizenelektrisch_XIX_Zone_VR.DE_ACT109a_Reset, system-signal=ACT109a_Reset
        communication-direction=OUT, data-element=ClimateControl_VR_XIX_Innenraumheizenelektrisch_XIX_Zone_VR.Geltungsbereich_E3_2_0.SP_IF_STRG109a_Drehrichtung_XIX_ClimateControl_VR_XIX_Innenraumheizenelektrisch_XIX_Zone_VR.DE_STRG109a_Drehrichtung, system-signal=STRG109a_Drehrichtung
        communication-direction=IN, data-element=ClimateControl_VR_XIX_Innenraumheizenelektrisch_XIX_Zone_VR.Geltungsbereich_E3_2_0.RP_IF_ACT104a_Blockierung_aufgetreten_XIX_ClimateControl_VR_XIX_Innenraumheizenelektrisch_XIX_Zone_VR.DE_ACT104a_Blockierung_aufgetreten, system-signal=ACT104a_Blockierung_aufgetreten
        communication-direction=IN, data-element=ClimateControl_VR_XIX_Innenraumheizenelektrisch_XIX_Zone_VR.Geltungsbereich_E3_2_0.RP_IF_ACT104a_Geschwindigkeitsstatus_XIX_ClimateControl_VR_XIX_Innenraumheizenelektrisch_XIX_Zone_VR.DE_ACT104a_Geschwindigkeitsstatus, system-signal=ACT104a_Geschwindigkeitsstatus
        communication-direction=OUT, data-element=ClimateControl_VR_XIX_Innenraumheizenelektrisch_XIX_Zone_VR.Geltungsbereich_E3_2_0.SP_IF_STRG105a_Clear_Event_Flags_XIX_ClimateControl_VR_XIX_Innenraumheizenelektrisch_XIX_Zone_VR.DE_STRG105a_Clear_Event_Flags, system-signal=STRG105a_Clear_Event_Flags
        communication-direction=OUT, data-element=ClimateControl_VR_XIX_Innenraumheizenelektrisch_XIX_Zone_VR.Geltungsbereich_E3_2_0.SP_IF_STRG106a_Drehrichtung_XIX_ClimateControl_VR_XIX_Innenraumheizenelektrisch_XIX_Zone_VR.DE_STRG106a_Drehrichtung, system-signal=STRG106a_Drehrichtung
        communication-direction=OUT, data-element=ClimateControl_VR_XIX_Innenraumheizenelektrisch_XIX_Zone_VR.Geltungsbereich_E3_2_0.SP_IF_STRG104a_Notlaufposition_XIX_ClimateControl_VR_XIX_Innenraumheizenelektrisch_XIX_Zone_VR.DE_STRG104a_Notlaufposition, system-signal=STRG104a_Notlaufposition
        communication-direction=OUT, data-element=ClimateControl_VR_XIX_Innenraumheizenelektrisch_XIX_Zone_VR.Geltungsbereich_E3_2_0.SP_IF_STRG104a_Drehrichtung_XIX_ClimateControl_VR_XIX_Innenraumheizenelektrisch_XIX_Zone_VR.DE_STRG104a_Drehrichtung, system-signal=STRG104a_Drehrichtung
        communication-direction=IN, data-element=ClimateControl_VR_XIX_Innenraumheizenelektrisch_XIX_Zone_VR.Geltungsbereich_E3_2_0.RP_IF_ACT106a_Geschwindigkeitsstatus_XIX_ClimateControl_VR_XIX_Innenraumheizenelektrisch_XIX_Zone_VR.DE_ACT106a_Geschwindigkeitsstatus, system-signal=ACT106a_Geschwindigkeitsstatus
        communication-direction=IN, data-element=ClimateControl_VR_XIX_Innenraumheizenelektrisch_XIX_Zone_VR.Geltungsbereich_E3_2_0.RP_IF_ACT106a_Ist_Position_Aktuator_XIX_ClimateControl_VR_XIX_Innenraumheizenelektrisch_XIX_Zone_VR.DE_ACT106a_Ist_Position_Aktuator, system-signal=ACT106a_Ist_Position_Aktuator
        communication-direction=OUT, data-element=ClimateControl_VR_XIX_Innenraumheizenelektrisch_XIX_Zone_VR.Geltungsbereich_E3_2_0.SP_IF_STRG104a_Geschwindigkeitsvorgabe_XIX_ClimateControl_VR_XIX_Innenraumheizenelektrisch_XIX_Zone_VR.DE_STRG104a_Geschwindigkeitsvorgabe, system-signal=STRG104a_Geschwindigkeitsvorgabe
        communication-direction=OUT, data-element=ClimateControl_VR_XIX_Innenraumheizenelektrisch_XIX_Zone_VR.Geltungsbereich_E3_2_0.SP_IF_STRG105a_Notlauffreigabe_XIX_ClimateControl_VR_XIX_Innenraumheizenelektrisch_XIX_Zone_VR.DE_STRG105a_Notlauffreigabe, system-signal=STRG105a_Notlauffreigabe
        communication-direction=OUT, data-element=ClimateControl_VR_XIX_Innenraumheizenelektrisch_XIX_Zone_VR.Geltungsbereich_E3_2_0.SP_IF_STRG106a_Stopmodus_XIX_ClimateControl_VR_XIX_Innenraumheizenelektrisch_XIX_Zone_VR.DE_STRG106a_Stopmodus, system-signal=STRG106a_Stopmodus
        communication-direction=IN, data-element=ClimateControl_VR_XIX_Innenraumheizenelektrisch_XIX_Zone_VR.Geltungsbereich_E3_2_0.RP_IF_ACT106a_Notlaufposition_XIX_ClimateControl_VR_XIX_Innenraumheizenelektrisch_XIX_Zone_VR.DE_ACT106a_Notlaufposition, system-signal=ACT106a_Notlaufposition
        communication-direction=IN, data-element=ClimateControl_VR_XIX_Innenraumheizenelektrisch_XIX_Zone_VR.Geltungsbereich_E3_2_0.RP_IF_ACT104a_Uebertemperatur_XIX_ClimateControl_VR_XIX_Innenraumheizenelektrisch_XIX_Zone_VR.DE_ACT104a_Uebertemperatur, system-signal=ACT104a_Uebertemperatur
        communication-direction=IN, data-element=ClimateControl_VR_XIX_Innenraumheizenelektrisch_XIX_Zone_VR.Geltungsbereich_E3_2_0.RP_IF_ACT105a_Selbsthaltemoment_XIX_ClimateControl_VR_XIX_Innenraumheizenelektrisch_XIX_Zone_VR.DE_ACT105a_Selbsthaltemoment, system-signal=ACT105a_Selbsthaltemoment
        communication-direction=IN, data-element=ClimateControl_VR_XIX_Innenraumheizenelektrisch_XIX_Zone_VR.Geltungsbereich_E3_2_0.RP_IF_ACT104a_Positionsvorgabe_Status_XIX_ClimateControl_VR_XIX_Innenraumheizenelektrisch_XIX_Zone_VR.DE_ACT104a_Positionsvorgabe_Status, system-signal=ACT104a_Positionsvorgabe_Status
        communication-direction=OUT, data-element=ClimateControl_VR_XIX_Innenraumheizenelektrisch_XIX_Zone_VR.Geltungsbereich_E3_2_0.SP_IF_STRG105a_Stopmodus_XIX_ClimateControl_VR_XIX_Innenraumheizenelektrisch_XIX_Zone_VR.DE_STRG105a_Stopmodus, system-signal=STRG105a_Stopmodus
        communication-direction=OUT, data-element=ClimateControl_VR_XIX_Innenraumheizenelektrisch_XIX_Zone_VR.Geltungsbereich_E3_2_0.SP_IF_STRG106a_Notlaufposition_XIX_ClimateControl_VR_XIX_Innenraumheizenelektrisch_XIX_Zone_VR.DE_STRG106a_Notlaufposition, system-signal=STRG106a_Notlaufposition
        communication-direction=OUT, data-element=ClimateControl_VR_XIX_Innenraumheizenelektrisch_XIX_Zone_VR.Geltungsbereich_E3_2_0.SP_IF_STRG105a_Soll_Position_XIX_ClimateControl_VR_XIX_Innenraumheizenelektrisch_XIX_Zone_VR.DE_STRG105a_Soll_Position, system-signal=STRG105a_Soll_Position
        communication-direction=IN, data-element=ClimateControl_VR_XIX_Innenraumheizenelektrisch_XIX_Zone_VR.Geltungsbereich_E3_2_0.RP_IF_ACT106a_Notlauffreigabe_XIX_ClimateControl_VR_XIX_Innenraumheizenelektrisch_XIX_Zone_VR.DE_ACT106a_Notlauffreigabe, system-signal=ACT106a_Notlauffreigabe
        communication-direction=OUT, data-element=ClimateControl_VR_XIX_Innenraumheizenelektrisch_XIX_Zone_VR.Geltungsbereich_E3_2_0.SP_IF_STRG109a_Spulenhaltebestromung_XIX_ClimateControl_VR_XIX_Innenraumheizenelektrisch_XIX_Zone_VR.DE_STRG109a_Spulenhaltebestromung, system-signal=STRG109a_Spulenhaltebestromung
        communication-direction=OUT, data-element=ClimateControl_VR_XIX_Innenraumheizenelektrisch_XIX_Zone_VR.Geltungsbereich_E3_2_0.SP_IF_STRG105a_Spulenhaltebestromung_XIX_ClimateControl_VR_XIX_Innenraumheizenelektrisch_XIX_Zone_VR.DE_STRG105a_Spulenhaltebestromung, system-signal=STRG105a_Spulenhaltebestromung
        communication-direction=IN, data-element=ClimateControl_VR_XIX_Innenraumheizenelektrisch_XIX_Zone_VR.Geltungsbereich_E3_2_0.RP_IF_ACT109a_Selbsthaltemoment_XIX_ClimateControl_VR_XIX_Innenraumheizenelektrisch_XIX_Zone_VR.DE_ACT109a_Selbsthaltemoment, system-signal=ACT109a_Selbsthaltemoment
        communication-direction=IN, data-element=ClimateControl_VR_XIX_Innenraumheizenelektrisch_XIX_Zone_VR.Geltungsbereich_E3_2_0.RP_IF_ACT104a_Reset_XIX_ClimateControl_VR_XIX_Innenraumheizenelektrisch_XIX_Zone_VR.DE_ACT104a_Reset, system-signal=ACT104a_Reset
        communication-direction=OUT, data-element=ClimateControl_VR_XIX_Innenraumheizenelektrisch_XIX_Zone_VR.Geltungsbereich_E3_2_0.SP_IF_STRG106a_Start_Position_XIX_ClimateControl_VR_XIX_Innenraumheizenelektrisch_XIX_Zone_VR.DE_STRG106a_Start_Position, system-signal=STRG106a_Start_Position
        communication-direction=OUT, data-element=ClimateControl_VR_XIX_Innenraumheizenelektrisch_XIX_Zone_VR.Geltungsbereich_E3_2_0.SP_IF_STRG104a_Clear_Event_Flags_XIX_ClimateControl_VR_XIX_Innenraumheizenelektrisch_XIX_Zone_VR.DE_STRG104a_Clear_Event_Flags, system-signal=STRG104a_Clear_Event_Flags
        communication-direction=IN, data-element=ClimateControl_VR_XIX_Innenraumheizenelektrisch_XIX_Zone_VR.Geltungsbereich_E3_2_0.RP_IF_ACT105a_Versorgungsspannung_XIX_ClimateControl_VR_XIX_Innenraumheizenelektrisch_XIX_Zone_VR.DE_ACT105a_Versorgungsspannung, system-signal=ACT105a_Versorgungsspannung
        communication-direction=IN, data-element=ClimateControl_VR_XIX_Innenraumheizenelektrisch_XIX_Zone_VR.Geltungsbereich_E3_2_0.RP_IF_ACT105a_Geschwindigkeitsstatus_XIX_ClimateControl_VR_XIX_Innenraumheizenelektrisch_XIX_Zone_VR.DE_ACT105a_Geschwindigkeitsstatus, system-signal=ACT105a_Geschwindigkeitsstatus
        communication-direction=IN, data-element=ClimateControl_VR_XIX_Innenraumheizenelektrisch_XIX_Zone_VR.Geltungsbereich_E3_2_0.RP_IF_ACT105a_Positionsvorgabe_Status_XIX_ClimateControl_VR_XIX_Innenraumheizenelektrisch_XIX_Zone_VR.DE_ACT105a_Positionsvorgabe_Status, system-signal=ACT105a_Positionsvorgabe_Status
        communication-direction=IN, data-element=ClimateControl_VR_XIX_Innenraumheizenelektrisch_XIX_Zone_VR.Geltungsbereich_E3_2_0.RP_IF_ACT106a_Notlauf_aufgetreten_XIX_ClimateControl_VR_XIX_Innenraumheizenelektrisch_XIX_Zone_VR.DE_ACT106a_Notlauf_aufgetreten, system-signal=ACT106a_Notlauf_aufgetreten
        communication-direction=IN, data-element=ClimateControl_VR_XIX_Innenraumheizenelektrisch_XIX_Zone_VR.Geltungsbereich_E3_2_0.RP_IF_ACT109a_Notlauffreigabe_XIX_ClimateControl_VR_XIX_Innenraumheizenelektrisch_XIX_Zone_VR.DE_ACT109a_Notlauffreigabe, system-signal=ACT109a_Notlauffreigabe
        communication-direction=IN, data-element=ClimateControl_VR_XIX_Innenraumheizenelektrisch_XIX_Zone_VR.Geltungsbereich_E3_2_0.RP_IF_ACT105a_Sonderfunktionen_XIX_ClimateControl_VR_XIX_Innenraumheizenelektrisch_XIX_Zone_VR.DE_ACT105a_Sonderfunktionen, system-signal=ACT105a_Sonderfunktionen
        communication-direction=IN, data-element=ClimateControl_VR_XIX_Innenraumheizenelektrisch_XIX_Zone_VR.Geltungsbereich_E3_2_0.RP_IF_ACT104a_Notlauf_aufgetreten_XIX_ClimateControl_VR_XIX_Innenraumheizenelektrisch_XIX_Zone_VR.DE_ACT104a_Notlauf_aufgetreten, system-signal=ACT104a_Notlauf_aufgetreten
        communication-direction=IN, data-element=ClimateControl_VR_XIX_Innenraumheizenelektrisch_XIX_Zone_VR.Geltungsbereich_E3_2_0.RP_IF_ACT109a_Uebertemperatur_XIX_ClimateControl_VR_XIX_Innenraumheizenelektrisch_XIX_Zone_VR.DE_ACT109a_Uebertemperatur, system-signal=ACT109a_Uebertemperatur
        communication-direction=IN, data-element=ClimateControl_VR_XIX_Innenraumheizenelektrisch_XIX_Zone_VR.Geltungsbereich_E3_2_0.RP_IF_ACT109a_Variante_XIX_ClimateControl_VR_XIX_Innenraumheizenelektrisch_XIX_Zone_VR.DE_ACT109a_Variante, system-signal=ACT109a_Variante
        communication-direction=OUT, data-element=ClimateControl_VR_XIX_Innenraumheizenelektrisch_XIX_Zone_VR.Geltungsbereich_E3_2_0.SP_IF_STRG109a_Adresse_XIX_ClimateControl_VR_XIX_Innenraumheizenelektrisch_XIX_Zone_VR.DE_STRG109a_Adresse, system-signal=STRG109a_Adresse
        communication-direction=OUT, data-element=ClimateControl_VR_XIX_Innenraumheizenelektrisch_XIX_Zone_VR.Geltungsbereich_E3_2_0.SP_IF_STRG109a_Start_Position_XIX_ClimateControl_VR_XIX_Innenraumheizenelektrisch_XIX_Zone_VR.DE_STRG109a_Start_Position, system-signal=STRG109a_Start_Position
        communication-direction=IN, data-element=ClimateControl_VR_XIX_Innenraumheizenelektrisch_XIX_Zone_VR.Geltungsbereich_E3_2_0.RP_IF_ACT109a_Versorgungsspannung_XIX_ClimateControl_VR_XIX_Innenraumheizenelektrisch_XIX_Zone_VR.DE_ACT109a_Versorgungsspannung, system-signal=ACT109a_Versorgungsspannung
        communication-direction=OUT, data-element=ClimateControl_VR_XIX_Innenraumheizenelektrisch_XIX_Zone_VR.Geltungsbereich_E3_2_0.SP_IF_STRG105a_Adresse_XIX_ClimateControl_VR_XIX_Innenraumheizenelektrisch_XIX_Zone_VR.DE_STRG105a_Adresse, system-signal=STRG105a_Adresse
        communication-direction=OUT, data-element=ClimateControl_VR_XIX_Innenraumheizenelektrisch_XIX_Zone_VR.Geltungsbereich_E3_2_0.SP_IF_STRG109a_Stopmodus_XIX_ClimateControl_VR_XIX_Innenraumheizenelektrisch_XIX_Zone_VR.DE_STRG109a_Stopmodus, system-signal=STRG109a_Stopmodus
        communication-direction=OUT, data-element=ClimateControl_VR_XIX_Innenraumheizenelektrisch_XIX_Zone_VR.Geltungsbereich_E3_2_0.SP_IF_STRG104a_Freig_Blockiererkennung_XIX_ClimateControl_VR_XIX_Innenraumheizenelektrisch_XIX_Zone_VR.DE_STRG104a_Freig_Blockiererkennung, system-signal=STRG104a_Freig_Blockiererkennung
        communication-direction=IN, data-element=ClimateControl_VR_XIX_Innenraumheizenelektrisch_XIX_Zone_VR.Geltungsbereich_E3_2_0.RP_IF_ACT106a_Blockierung_aufgetreten_XIX_ClimateControl_VR_XIX_Innenraumheizenelektrisch_XIX_Zone_VR.DE_ACT106a_Blockierung_aufgetreten, system-signal=ACT106a_Blockierung_aufgetreten
        communication-direction=IN, data-element=ClimateControl_VR_XIX_Innenraumheizenelektrisch_XIX_Zone_VR.Geltungsbereich_E3_2_0.RP_IF_ACT105a_Adresse_Aktuator_XIX_ClimateControl_VR_XIX_Innenraumheizenelektrisch_XIX_Zone_VR.DE_ACT105a_Adresse_Aktuator, system-signal=ACT105a_Adresse_Aktuator
        communication-direction=IN, data-element=ClimateControl_VR_XIX_Innenraumheizenelektrisch_XIX_Zone_VR.Geltungsbereich_E3_2_0.RP_IF_ACT104a_Versorgungsspannung_XIX_ClimateControl_VR_XIX_Innenraumheizenelektrisch_XIX_Zone_VR.DE_ACT104a_Versorgungsspannung, system-signal=ACT104a_Versorgungsspannung
        communication-direction=OUT, data-element=ClimateControl_VR_XIX_Innenraumheizenelektrisch_XIX_Zone_VR.Geltungsbereich_E3_2_0.SP_IF_STRG109a_Clear_Event_Flags_XIX_ClimateControl_VR_XIX_Innenraumheizenelektrisch_XIX_Zone_VR.DE_STRG109a_Clear_Event_Flags, system-signal=STRG109a_Clear_Event_Flags
        communication-direction=OUT, data-element=ClimateControl_VR_XIX_Innenraumheizenelektrisch_XIX_Zone_VR.Geltungsbereich_E3_2_0.SP_IF_STRG106a_Spulenhaltebestromung_XIX_ClimateControl_VR_XIX_Innenraumheizenelektrisch_XIX_Zone_VR.DE_STRG106a_Spulenhaltebestromung, system-signal=STRG106a_Spulenhaltebestromung
        communication-direction=IN, data-element=ClimateControl_VR_XIX_Innenraumheizenelektrisch_XIX_Zone_VR.Geltungsbereich_E3_2_0.RP_IF_BLOWER_UMOTOR_XIX_ClimateControl_VR_XIX_Innenraumheizenelektrisch_XIX_Zone_VR.DE_BLOWER_UMOTOR, system-signal=BLOWER_UMOTOR
        communication-direction=OUT, data-element=ClimateControl_VR_XIX_Innenraumheizenelektrisch_XIX_Zone_VR.Geltungsbereich_E3_2_0.SP_IF_KBT_CODE_VEHICLE_XIX_ClimateControl_VR_XIX_Innenraumheizenelektrisch_XIX_Zone_VR.DE_KBT_CODE_VEHICLE, system-signal=KBT_CODE_VEHICLE
        communication-direction=IN, data-element=ClimateControl_VR_XIX_Innenraumheizenelektrisch_XIX_Zone_VR.Geltungsbereich_E3_2_0.RP_IF_BLOWER_IBATT_XIX_ClimateControl_VR_XIX_Innenraumheizenelektrisch_XIX_Zone_VR.DE_BLOWER_IBATT, system-signal=BLOWER_IBATT
        communication-direction=OUT, data-element=ClimateControl_VR_XIX_Innenraumheizenelektrisch_XIX_Zone_VR.Geltungsbereich_E3_2_0.SP_IF_KBT_SAFETY_SPEED_XIX_ClimateControl_VR_XIX_Innenraumheizenelektrisch_XIX_Zone_VR.DE_KBT_SAFETY_SPEED, system-signal=KBT_SAFETY_SPEED
        communication-direction=IN, data-element=ClimateControl_VR_XIX_Innenraumheizenelektrisch_XIX_Zone_VR.Geltungsbereich_E3_2_0.RP_IF_BLOWER_SUPPLIER_XIX_ClimateControl_VR_XIX_Innenraumheizenelektrisch_XIX_Zone_VR.DE_BLOWER_SUPPLIER, system-signal=BLOWER_SUPPLIER
        communication-direction=IN, data-element=ClimateControl_VR_XIX_Innenraumheizenelektrisch_XIX_Zone_VR.Geltungsbereich_E3_2_0.RP_IF_BLOWER_UBATT_XIX_ClimateControl_VR_XIX_Innenraumheizenelektrisch_XIX_Zone_VR.DE_BLOWER_UBATT, system-signal=BLOWER_UBATT
        communication-direction=IN, data-element=ClimateControl_VR_XIX_Innenraumheizenelektrisch_XIX_Zone_VR.Geltungsbereich_E3_2_0.RP_IF_BLOWER_TORQUE_XIX_ClimateControl_VR_XIX_Innenraumheizenelektrisch_XIX_Zone_VR.DE_BLOWER_TORQUE, system-signal=BLOWER_TORQUE
        communication-direction=IN, data-element=ClimateControl_VR_XIX_Innenraumheizenelektrisch_XIX_Zone_VR.Geltungsbereich_E3_2_0.RP_IF_BLOWER_TEMPERATURE_XIX_ClimateControl_VR_XIX_Innenraumheizenelektrisch_XIX_Zone_VR.DE_BLOWER_TEMPERATURE, system-signal=BLOWER_TEMPERATURE
        communication-direction=OUT, data-element=ClimateControl_VR_XIX_Innenraumheizenelektrisch_XIX_Zone_VR.Geltungsbereich_E3_2_0.SP_IF_KBT_RX_FREQUENCY_XIX_ClimateControl_VR_XIX_Innenraumheizenelektrisch_XIX_Zone_VR.DE_KBT_RX_FREQUENCY, system-signal=KBT_RX_FREQUENCY
        communication-direction=IN, data-element=ClimateControl_VR_XIX_Innenraumheizenelektrisch_XIX_Zone_VR.Geltungsbereich_E3_2_0.RP_IF_BLOWER_DIAG_FLAG1_XIX_ClimateControl_VR_XIX_Innenraumheizenelektrisch_XIX_Zone_VR.DE_BLOWER_DIAG_FLAG1, system-signal=BLOWER_DIAG_FLAG1
        communication-direction=IN, data-element=ClimateControl_VR_XIX_Innenraumheizenelektrisch_XIX_Zone_VR.Geltungsbereich_E3_2_0.RP_IF_BLOWER_ROTATION_SPEED_XIX_ClimateControl_VR_XIX_Innenraumheizenelektrisch_XIX_Zone_VR.DE_BLOWER_ROTATION_SPEED, system-signal=BLOWER_ROTATION_SPEED
        communication-direction=IN, data-element=ClimateControl_VR_XIX_Innenraumheizenelektrisch_XIX_Zone_VR.Geltungsbereich_E3_2_0.RP_IF_BLOWER_STATUS_MOTOR_XIX_ClimateControl_VR_XIX_Innenraumheizenelektrisch_XIX_Zone_VR.DE_BLOWER_STATUS_MOTOR, system-signal=BLOWER_STATUS_MOTOR
        communication-direction=IN, data-element=ClimateControl_VR_XIX_Innenraumheizenelektrisch_XIX_Zone_VR.Geltungsbereich_E3_2_0.RP_IF_BLOWER_DIAG_FLAG2_XIX_ClimateControl_VR_XIX_Innenraumheizenelektrisch_XIX_Zone_VR.DE_BLOWER_DIAG_FLAG2, system-signal=BLOWER_DIAG_FLAG2
        communication-direction=OUT, data-element=ClimateControl_VR_XIX_Innenraumheizenelektrisch_XIX_Zone_VR.Geltungsbereich_E3_2_0.SP_IF_KBT_RAMP_XIX_ClimateControl_VR_XIX_Innenraumheizenelektrisch_XIX_Zone_VR.DE_KBT_RAMP, system-signal=KBT_RAMP
        communication-direction=OUT, data-element=ClimateControl_VR_XIX_Innenraumheizenelektrisch_XIX_Zone_VR.Geltungsbereich_E3_2_0.SP_IF_KBT_SPEED_XIX_ClimateControl_VR_XIX_Innenraumheizenelektrisch_XIX_Zone_VR.DE_KBT_SPEED, system-signal=KBT_SPEED
        communication-direction=OUT, data-element=ClimateControl_VR_XIX_Innenraumheizenelektrisch_XIX_Zone_VR.Geltungsbereich_E3_2_0.SP_IF_KPHe_Funktion_Sync_XIX_ClimateControl_VR_XIX_Innenraumheizenelektrisch_XIX_Zone_VR.DE_KPHe_Funktion_Sync, system-signal=KPHe_Funktion_Sync
        communication-direction=OUT, data-element=ClimateControl_VR_XIX_Innenraumheizenelektrisch_XIX_Zone_VR.Geltungsbereich_E3_2_0.SP_IF_KPHe_Funktion_Umluft_XIX_ClimateControl_VR_XIX_Innenraumheizenelektrisch_XIX_Zone_VR.DE_KPHe_Funktion_Umluft, system-signal=KPHe_Funktion_Umluft
        communication-direction=OUT, data-element=ClimateControl_VR_XIX_Innenraumheizenelektrisch_XIX_Zone_VR.Geltungsbereich_E3_2_0.SP_IF_KPHe_Funktion_Ionisator_XIX_ClimateControl_VR_XIX_Innenraumheizenelektrisch_XIX_Zone_VR.DE_KPHe_Funktion_Ionisator, system-signal=KPHe_Funktion_Ionisator
        communication-direction=OUT, data-element=ClimateControl_VR_XIX_Innenraumheizenelektrisch_XIX_Zone_VR.Geltungsbereich_E3_2_0.SP_IF_KPHe_Sitzlueftung_re_XIX_ClimateControl_VR_XIX_Innenraumheizenelektrisch_XIX_Zone_VR.DE_KPHe_Sitzlueftung_re, system-signal=KPHe_Sitzlueftung_re
        communication-direction=OUT, data-element=ClimateControl_VR_XIX_Innenraumheizenelektrisch_XIX_Zone_VR.Geltungsbereich_E3_2_0.SP_IF_KPHe_Funktion_Beduftung_XIX_ClimateControl_VR_XIX_Innenraumheizenelektrisch_XIX_Zone_VR.DE_KPHe_Funktion_Beduftung, system-signal=KPHe_Funktion_Beduftung
        communication-direction=OUT, data-element=ClimateControl_VR_XIX_Innenraumheizenelektrisch_XIX_Zone_VR.Geltungsbereich_E3_2_0.SP_IF_KPHe_Symbol_Sitzlueftung_li_XIX_ClimateControl_VR_XIX_Innenraumheizenelektrisch_XIX_Zone_VR.DE_KPHe_Symbol_Sitzlueftung_li, system-signal=KPHe_Symbol_Sitzlueftung_li
        communication-direction=OUT, data-element=ClimateControl_VR_XIX_Innenraumheizenelektrisch_XIX_Zone_VR.Geltungsbereich_E3_2_0.SP_IF_KPHe_Sitzheizung_li_XIX_ClimateControl_VR_XIX_Innenraumheizenelektrisch_XIX_Zone_VR.DE_KPHe_Sitzheizung_li, system-signal=KPHe_Sitzheizung_li
        communication-direction=OUT, data-element=ClimateControl_VR_XIX_Innenraumheizenelektrisch_XIX_Zone_VR.Geltungsbereich_E3_2_0.SP_IF_KPHe_Fondbedienung_XIX_ClimateControl_VR_XIX_Innenraumheizenelektrisch_XIX_Zone_VR.DE_KPHe_Fondbedienung, system-signal=KPHe_Fondbedienung
        communication-direction=OUT, data-element=ClimateControl_VR_XIX_Innenraumheizenelektrisch_XIX_Zone_VR.Geltungsbereich_E3_2_0.SP_IF_KPHe_Einheit_XIX_ClimateControl_VR_XIX_Innenraumheizenelektrisch_XIX_Zone_VR.DE_KPHe_Einheit, system-signal=KPHe_Einheit
        communication-direction=OUT, data-element=ClimateControl_VR_XIX_Innenraumheizenelektrisch_XIX_Zone_VR.Geltungsbereich_E3_2_0.SP_IF_KPHe_Funktion_Frontbedienung_XIX_ClimateControl_VR_XIX_Innenraumheizenelektrisch_XIX_Zone_VR.DE_KPHe_Funktion_Frontbedienung, system-signal=KPHe_Funktion_Frontbedienung
        communication-direction=OUT, data-element=ClimateControl_VR_XIX_Innenraumheizenelektrisch_XIX_Zone_VR.Geltungsbereich_E3_2_0.SP_IF_KPHe_Symbol_Sitzheizung_re_XIX_ClimateControl_VR_XIX_Innenraumheizenelektrisch_XIX_Zone_VR.DE_KPHe_Symbol_Sitzheizung_re, system-signal=KPHe_Symbol_Sitzheizung_re
        communication-direction=OUT, data-element=ClimateControl_VR_XIX_Innenraumheizenelektrisch_XIX_Zone_VR.Geltungsbereich_E3_2_0.SP_IF_KPHe_Sitzlueftung_li_XIX_ClimateControl_VR_XIX_Innenraumheizenelektrisch_XIX_Zone_VR.DE_KPHe_Sitzlueftung_li, system-signal=KPHe_Sitzlueftung_li
        communication-direction=OUT, data-element=ClimateControl_VR_XIX_Innenraumheizenelektrisch_XIX_Zone_VR.Geltungsbereich_E3_2_0.SP_IF_KPHe_LCD_XIX_ClimateControl_VR_XIX_Innenraumheizenelektrisch_XIX_Zone_VR.DE_KPHe_LCD, system-signal=KPHe_LCD
        communication-direction=OUT, data-element=ClimateControl_VR_XIX_Innenraumheizenelektrisch_XIX_Zone_VR.Geltungsbereich_E3_2_0.SP_IF_KPHe_Funktion_Flaechenheizung_XIX_ClimateControl_VR_XIX_Innenraumheizenelektrisch_XIX_Zone_VR.DE_KPHe_Funktion_Flaechenheizung, system-signal=KPHe_Funktion_Flaechenheizung
        communication-direction=OUT, data-element=ClimateControl_VR_XIX_Innenraumheizenelektrisch_XIX_Zone_VR.Geltungsbereich_E3_2_0.SP_IF_KPHe_Temp_re_XIX_ClimateControl_VR_XIX_Innenraumheizenelektrisch_XIX_Zone_VR.DE_KPHe_Temp_re, system-signal=KPHe_Temp_re
        communication-direction=OUT, data-element=ClimateControl_VR_XIX_Innenraumheizenelektrisch_XIX_Zone_VR.Geltungsbereich_E3_2_0.SP_IF_KPHe_Funktion_Halbkreis_li_XIX_ClimateControl_VR_XIX_Innenraumheizenelektrisch_XIX_Zone_VR.DE_KPHe_Funktion_Halbkreis_li, system-signal=KPHe_Funktion_Halbkreis_li
        communication-direction=OUT, data-element=ClimateControl_VR_XIX_Innenraumheizenelektrisch_XIX_Zone_VR.Geltungsbereich_E3_2_0.SP_IF_KPHe_Lenker_Position_XIX_ClimateControl_VR_XIX_Innenraumheizenelektrisch_XIX_Zone_VR.DE_KPHe_Lenker_Position, system-signal=KPHe_Lenker_Position
        communication-direction=OUT, data-element=ClimateControl_VR_XIX_Innenraumheizenelektrisch_XIX_Zone_VR.Geltungsbereich_E3_2_0.SP_IF_KPHe_Funktion_Auto_li_XIX_ClimateControl_VR_XIX_Innenraumheizenelektrisch_XIX_Zone_VR.DE_KPHe_Funktion_Auto_li, system-signal=KPHe_Funktion_Auto_li
        communication-direction=OUT, data-element=ClimateControl_VR_XIX_Innenraumheizenelektrisch_XIX_Zone_VR.Geltungsbereich_E3_2_0.SP_IF_KPHe_Suchbeleuchtung_XIX_ClimateControl_VR_XIX_Innenraumheizenelektrisch_XIX_Zone_VR.DE_KPHe_Suchbeleuchtung, system-signal=KPHe_Suchbeleuchtung
        communication-direction=OUT, data-element=ClimateControl_VR_XIX_Innenraumheizenelektrisch_XIX_Zone_VR.Geltungsbereich_E3_2_0.SP_IF_KPHe_Funktion_AC_max_XIX_ClimateControl_VR_XIX_Innenraumheizenelektrisch_XIX_Zone_VR.DE_KPHe_Funktion_AC_max, system-signal=KPHe_Funktion_AC_max
        communication-direction=OUT, data-element=ClimateControl_VR_XIX_Innenraumheizenelektrisch_XIX_Zone_VR.Geltungsbereich_E3_2_0.SP_IF_KPHe_Funktion_Kindersicherung_XIX_ClimateControl_VR_XIX_Innenraumheizenelektrisch_XIX_Zone_VR.DE_KPHe_Funktion_Kindersicherung, system-signal=KPHe_Funktion_Kindersicherung
        communication-direction=OUT, data-element=ClimateControl_VR_XIX_Innenraumheizenelektrisch_XIX_Zone_VR.Geltungsbereich_E3_2_0.SP_IF_KPHe_Temp_li_XIX_ClimateControl_VR_XIX_Innenraumheizenelektrisch_XIX_Zone_VR.DE_KPHe_Temp_li, system-signal=KPHe_Temp_li
        communication-direction=OUT, data-element=ClimateControl_VR_XIX_Innenraumheizenelektrisch_XIX_Zone_VR.Geltungsbereich_E3_2_0.SP_IF_KPHe_Funktion_ECO_XIX_ClimateControl_VR_XIX_Innenraumheizenelektrisch_XIX_Zone_VR.DE_KPHe_Funktion_ECO, system-signal=KPHe_Funktion_ECO
        communication-direction=OUT, data-element=ClimateControl_VR_XIX_Innenraumheizenelektrisch_XIX_Zone_VR.Geltungsbereich_E3_2_0.SP_IF_KPHe_TFT_XIX_ClimateControl_VR_XIX_Innenraumheizenelektrisch_XIX_Zone_VR.DE_KPHe_TFT, system-signal=KPHe_TFT
        communication-direction=OUT, data-element=ClimateControl_VR_XIX_Innenraumheizenelektrisch_XIX_Zone_VR.Geltungsbereich_E3_2_0.SP_IF_KPHe_Symbol_Sitzlueftung_re_XIX_ClimateControl_VR_XIX_Innenraumheizenelektrisch_XIX_Zone_VR.DE_KPHe_Symbol_Sitzlueftung_re, system-signal=KPHe_Symbol_Sitzlueftung_re
        communication-direction=OUT, data-element=ClimateControl_VR_XIX_Innenraumheizenelektrisch_XIX_Zone_VR.Geltungsbereich_E3_2_0.SP_IF_KPHe_Symbol_Sitzheizung_li_XIX_ClimateControl_VR_XIX_Innenraumheizenelektrisch_XIX_Zone_VR.DE_KPHe_Symbol_Sitzheizung_li, system-signal=KPHe_Symbol_Sitzheizung_li
        communication-direction=OUT, data-element=ClimateControl_VR_XIX_Innenraumheizenelektrisch_XIX_Zone_VR.Geltungsbereich_E3_2_0.SP_IF_KPHe_Funktion_Auto_re_XIX_ClimateControl_VR_XIX_Innenraumheizenelektrisch_XIX_Zone_VR.DE_KPHe_Funktion_Auto_re, system-signal=KPHe_Funktion_Auto_re
        communication-direction=OUT, data-element=ClimateControl_VR_XIX_Innenraumheizenelektrisch_XIX_Zone_VR.Geltungsbereich_E3_2_0.SP_IF_KPHe_Funktionsbeleuchtung_XIX_ClimateControl_VR_XIX_Innenraumheizenelektrisch_XIX_Zone_VR.DE_KPHe_Funktionsbeleuchtung, system-signal=KPHe_Funktionsbeleuchtung
        communication-direction=OUT, data-element=ClimateControl_VR_XIX_Innenraumheizenelektrisch_XIX_Zone_VR.Geltungsbereich_E3_2_0.SP_IF_KPHe_Funktion_Halbkreis_re_XIX_ClimateControl_VR_XIX_Innenraumheizenelektrisch_XIX_Zone_VR.DE_KPHe_Funktion_Halbkreis_re, system-signal=KPHe_Funktion_Halbkreis_re
        communication-direction=OUT, data-element=ClimateControl_VR_XIX_Innenraumheizenelektrisch_XIX_Zone_VR.Geltungsbereich_E3_2_0.SP_IF_KPHe_Sitzheizung_re_XIX_ClimateControl_VR_XIX_Innenraumheizenelektrisch_XIX_Zone_VR.DE_KPHe_Sitzheizung_re, system-signal=KPHe_Sitzheizung_re
        communication-direction=OUT, data-element=ClimateControl_VR_XIX_Innenraumheizenelektrisch_XIX_Zone_VR.Geltungsbereich_E3_2_0.SP_IF_KL_KST_KL_15_XIX_ClimateControl_VR_XIX_Innenraumheizenelektrisch_XIX_Zone_VR.DE_KL_KST_KL_15, system-signal=KL_KST_KL_15
        communication-direction=OUT, data-element=ClimateControl_VR_XIX_Innenraumheizenelektrisch_XIX_Zone_VR.Geltungsbereich_E3_2_0.SP_IF_KPHe_Funktion_Off_XIX_ClimateControl_VR_XIX_Innenraumheizenelektrisch_XIX_Zone_VR.DE_KPHe_Funktion_Off, system-signal=KPHe_Funktion_Off
        communication-direction=OUT, data-element=ClimateControl_VR_XIX_Innenraumheizenelektrisch_XIX_Zone_VR.Geltungsbereich_E3_2_0.SP_IF_KPHe_Funktion_AC_XIX_ClimateControl_VR_XIX_Innenraumheizenelektrisch_XIX_Zone_VR.DE_KPHe_Funktion_AC, system-signal=KPHe_Funktion_AC
        communication-direction=OUT, data-element=ClimateControl_VR_XIX_Innenraumheizenelektrisch_XIX_Zone_VR.Geltungsbereich_E3_2_0.SP_IF_KPHe_Radio_Frequenz_XIX_ClimateControl_VR_XIX_Innenraumheizenelektrisch_XIX_Zone_VR.DE_KPHe_Radio_Frequenz, system-signal=KPHe_Radio_Frequenz
        communication-direction=OUT, data-element=ClimateControl_VR_XIX_Innenraumheizenelektrisch_XIX_Zone_VR.Geltungsbereich_E3_2_0.SP_IF_KPHe_Funktion_ECO_Zone_XIX_ClimateControl_VR_XIX_Innenraumheizenelektrisch_XIX_Zone_VR.DE_KPHe_Funktion_ECO_Zone, system-signal=KPHe_Funktion_ECO_Zone
        communication-direction=OUT, data-element=ClimateControl_VR_XIX_Innenraumheizenelektrisch_XIX_Zone_VR.Geltungsbereich_E3_2_0.SP_IF_KPHe_Stellgliedtest_XIX_ClimateControl_VR_XIX_Innenraumheizenelektrisch_XIX_Zone_VR.DE_KPHe_Stellgliedtest, system-signal=KPHe_Stellgliedtest
        communication-direction=OUT, data-element=ClimateControl_VR_XIX_Innenraumheizenelektrisch_XIX_Zone_VR.Geltungsbereich_E3_2_0.SP_IF_KPHe_Luftverteilung_Mitte_li_XIX_ClimateControl_VR_XIX_Innenraumheizenelektrisch_XIX_Zone_VR.DE_KPHe_Luftverteilung_Mitte_li, system-signal=KPHe_Luftverteilung_Mitte_li
        communication-direction=OUT, data-element=ClimateControl_VR_XIX_Innenraumheizenelektrisch_XIX_Zone_VR.Geltungsbereich_E3_2_0.SP_IF_KPHe_Symbol_Luftmenge_li_XIX_ClimateControl_VR_XIX_Innenraumheizenelektrisch_XIX_Zone_VR.DE_KPHe_Symbol_Luftmenge_li, system-signal=KPHe_Symbol_Luftmenge_li
        communication-direction=OUT, data-element=ClimateControl_VR_XIX_Innenraumheizenelektrisch_XIX_Zone_VR.Geltungsbereich_E3_2_0.SP_IF_KPHe_Luftverteilung_Auto_re_XIX_ClimateControl_VR_XIX_Innenraumheizenelektrisch_XIX_Zone_VR.DE_KPHe_Luftverteilung_Auto_re, system-signal=KPHe_Luftverteilung_Auto_re
        communication-direction=OUT, data-element=ClimateControl_VR_XIX_Innenraumheizenelektrisch_XIX_Zone_VR.Geltungsbereich_E3_2_0.SP_IF_KPHe_Luftverteilung_Auto_li_XIX_ClimateControl_VR_XIX_Innenraumheizenelektrisch_XIX_Zone_VR.DE_KPHe_Luftverteilung_Auto_li, system-signal=KPHe_Luftverteilung_Auto_li
        communication-direction=OUT, data-element=ClimateControl_VR_XIX_Innenraumheizenelektrisch_XIX_Zone_VR.Geltungsbereich_E3_2_0.SP_IF_KPHe_Luftverteilung_Unten_re_XIX_ClimateControl_VR_XIX_Innenraumheizenelektrisch_XIX_Zone_VR.DE_KPHe_Luftverteilung_Unten_re, system-signal=KPHe_Luftverteilung_Unten_re
        communication-direction=OUT, data-element=ClimateControl_VR_XIX_Innenraumheizenelektrisch_XIX_Zone_VR.Geltungsbereich_E3_2_0.SP_IF_KPHe_Geblaese_Stufe_li_XIX_ClimateControl_VR_XIX_Innenraumheizenelektrisch_XIX_Zone_VR.DE_KPHe_Geblaese_Stufe_li, system-signal=KPHe_Geblaese_Stufe_li
        communication-direction=OUT, data-element=ClimateControl_VR_XIX_Innenraumheizenelektrisch_XIX_Zone_VR.Geltungsbereich_E3_2_0.SP_IF_KPHe_Symbol_Luftmenge_re_XIX_ClimateControl_VR_XIX_Innenraumheizenelektrisch_XIX_Zone_VR.DE_KPHe_Symbol_Luftmenge_re, system-signal=KPHe_Symbol_Luftmenge_re
        communication-direction=OUT, data-element=ClimateControl_VR_XIX_Innenraumheizenelektrisch_XIX_Zone_VR.Geltungsbereich_E3_2_0.SP_IF_KPHe_Luftverteilung_Mitte_re_XIX_ClimateControl_VR_XIX_Innenraumheizenelektrisch_XIX_Zone_VR.DE_KPHe_Luftverteilung_Mitte_re, system-signal=KPHe_Luftverteilung_Mitte_re
        communication-direction=OUT, data-element=ClimateControl_VR_XIX_Innenraumheizenelektrisch_XIX_Zone_VR.Geltungsbereich_E3_2_0.SP_IF_KPHe_Symbol_Luftverteilung_li_XIX_ClimateControl_VR_XIX_Innenraumheizenelektrisch_XIX_Zone_VR.DE_KPHe_Symbol_Luftverteilung_li, system-signal=KPHe_Symbol_Luftverteilung_li
        communication-direction=OUT, data-element=ClimateControl_VR_XIX_Innenraumheizenelektrisch_XIX_Zone_VR.Geltungsbereich_E3_2_0.SP_IF_KPHe_Luftverteilung_Oben_li_XIX_ClimateControl_VR_XIX_Innenraumheizenelektrisch_XIX_Zone_VR.DE_KPHe_Luftverteilung_Oben_li, system-signal=KPHe_Luftverteilung_Oben_li
        communication-direction=OUT, data-element=ClimateControl_VR_XIX_Innenraumheizenelektrisch_XIX_Zone_VR.Geltungsbereich_E3_2_0.SP_IF_KPHe_Symbol_Luftverteilung_re_XIX_ClimateControl_VR_XIX_Innenraumheizenelektrisch_XIX_Zone_VR.DE_KPHe_Symbol_Luftverteilung_re, system-signal=KPHe_Symbol_Luftverteilung_re
        communication-direction=OUT, data-element=ClimateControl_VR_XIX_Innenraumheizenelektrisch_XIX_Zone_VR.Geltungsbereich_E3_2_0.SP_IF_KPHe_Geblaese_Begrenzung_XIX_ClimateControl_VR_XIX_Innenraumheizenelektrisch_XIX_Zone_VR.DE_KPHe_Geblaese_Begrenzung, system-signal=KPHe_Geblaese_Begrenzung
        communication-direction=OUT, data-element=ClimateControl_VR_XIX_Innenraumheizenelektrisch_XIX_Zone_VR.Geltungsbereich_E3_2_0.SP_IF_KPHe_Luftverteilung_Unten_li_XIX_ClimateControl_VR_XIX_Innenraumheizenelektrisch_XIX_Zone_VR.DE_KPHe_Luftverteilung_Unten_li, system-signal=KPHe_Luftverteilung_Unten_li
        communication-direction=OUT, data-element=ClimateControl_VR_XIX_Innenraumheizenelektrisch_XIX_Zone_VR.Geltungsbereich_E3_2_0.SP_IF_KPHe_Luftverteilung_Oben_re_XIX_ClimateControl_VR_XIX_Innenraumheizenelektrisch_XIX_Zone_VR.DE_KPHe_Luftverteilung_Oben_re, system-signal=KPHe_Luftverteilung_Oben_re
        communication-direction=OUT, data-element=ClimateControl_VR_XIX_Innenraumheizenelektrisch_XIX_Zone_VR.Geltungsbereich_E3_2_0.SP_IF_KPHe_Geblaese_Auto_li_XIX_ClimateControl_VR_XIX_Innenraumheizenelektrisch_XIX_Zone_VR.DE_KPHe_Geblaese_Auto_li, system-signal=KPHe_Geblaese_Auto_li
        communication-direction=OUT, data-element=ClimateControl_VR_XIX_Innenraumheizenelektrisch_XIX_Zone_VR.Geltungsbereich_E3_2_0.SP_IF_KPHe_Auto_Toggle_XIX_ClimateControl_VR_XIX_Innenraumheizenelektrisch_XIX_Zone_VR.DE_KPHe_Auto_Toggle, system-signal=KPHe_Auto_Toggle
        communication-direction=OUT, data-element=ClimateControl_VR_XIX_Innenraumheizenelektrisch_XIX_Zone_VR.Geltungsbereich_E3_2_0.SP_IF_KPHe_Geblaese_Auto_re_XIX_ClimateControl_VR_XIX_Innenraumheizenelektrisch_XIX_Zone_VR.DE_KPHe_Geblaese_Auto_re, system-signal=KPHe_Geblaese_Auto_re
        communication-direction=OUT, data-element=ClimateControl_VR_XIX_Innenraumheizenelektrisch_XIX_Zone_VR.Geltungsbereich_E3_2_0.SP_IF_KPHe_Geblaese_Stufe_re_XIX_ClimateControl_VR_XIX_Innenraumheizenelektrisch_XIX_Zone_VR.DE_KPHe_Geblaese_Stufe_re, system-signal=KPHe_Geblaese_Stufe_re
        communication-direction=OUT, data-element=ClimateControl_VR_XIX_Innenraumheizenelektrisch_XIX_Zone_VR.Geltungsbereich_E3_2_0.SP_IF_KPHe_Funktion_Defrost_XIX_ClimateControl_VR_XIX_Innenraumheizenelektrisch_XIX_Zone_VR.DE_KPHe_Funktion_Defrost, system-signal=KPHe_Funktion_Defrost
        communication-direction=OUT, data-element=ClimateControl_VR_XIX_Innenraumheizenelektrisch_XIX_Zone_VR.Geltungsbereich_E3_2_0.SP_IF_KPHe_QBit_Steigung_XIX_ClimateControl_VR_XIX_Innenraumheizenelektrisch_XIX_Zone_VR.DE_KPHe_QBit_Steigung, system-signal=KPHe_QBit_Steigung
        communication-direction=OUT, data-element=ClimateControl_VR_XIX_Innenraumheizenelektrisch_XIX_Zone_VR.Geltungsbereich_E3_2_0.SP_IF_KPHe_Fzg_Steigung_XIX_ClimateControl_VR_XIX_Innenraumheizenelektrisch_XIX_Zone_VR.DE_KPHe_Fzg_Steigung, system-signal=KPHe_Fzg_Steigung
        communication-direction=IN, data-element=ClimateControl_VR_XIX_Innenraumheizenelektrisch_XIX_Zone_VR.Geltungsbereich_E3_2_0.RP_IF_KPH_Off_XIX_ClimateControl_VR_XIX_Innenraumheizenelektrisch_XIX_Zone_VR.DE_KPH_Off, system-signal=KPH_Off
        communication-direction=IN, data-element=ClimateControl_VR_XIX_Innenraumheizenelektrisch_XIX_Zone_VR.Geltungsbereich_E3_2_0.RP_IF_KPH_Luftverteilung_Mitte_re_XIX_ClimateControl_VR_XIX_Innenraumheizenelektrisch_XIX_Zone_VR.DE_KPH_Luftverteilung_Mitte_re, system-signal=KPH_Luftverteilung_Mitte_re
        communication-direction=IN, data-element=ClimateControl_VR_XIX_Innenraumheizenelektrisch_XIX_Zone_VR.Geltungsbereich_E3_2_0.RP_IF_KPH_Panel_Error_XIX_ClimateControl_VR_XIX_Innenraumheizenelektrisch_XIX_Zone_VR.DE_KPH_Panel_Error, system-signal=KPH_Panel_Error
        communication-direction=IN, data-element=ClimateControl_VR_XIX_Innenraumheizenelektrisch_XIX_Zone_VR.Geltungsbereich_E3_2_0.RP_IF_KPH_Init_XIX_ClimateControl_VR_XIX_Innenraumheizenelektrisch_XIX_Zone_VR.DE_KPH_Init, system-signal=KPH_Init
        communication-direction=IN, data-element=ClimateControl_VR_XIX_Innenraumheizenelektrisch_XIX_Zone_VR.Geltungsbereich_E3_2_0.RP_IF_KPH_Luftverteilung_Unten_re_XIX_ClimateControl_VR_XIX_Innenraumheizenelektrisch_XIX_Zone_VR.DE_KPH_Luftverteilung_Unten_re, system-signal=KPH_Luftverteilung_Unten_re
        communication-direction=IN, data-element=ClimateControl_VR_XIX_Innenraumheizenelektrisch_XIX_Zone_VR.Geltungsbereich_E3_2_0.RP_IF_KPH_ECO_rechts_XIX_ClimateControl_VR_XIX_Innenraumheizenelektrisch_XIX_Zone_VR.DE_KPH_ECO_rechts, system-signal=KPH_ECO_rechts
        communication-direction=IN, data-element=ClimateControl_VR_XIX_Innenraumheizenelektrisch_XIX_Zone_VR.Geltungsbereich_E3_2_0.RP_IF_KPH_Lokalaktiv_XIX_ClimateControl_VR_XIX_Innenraumheizenelektrisch_XIX_Zone_VR.DE_KPH_Lokalaktiv, system-signal=KPH_Lokalaktiv
        communication-direction=IN, data-element=ClimateControl_VR_XIX_Innenraumheizenelektrisch_XIX_Zone_VR.Geltungsbereich_E3_2_0.RP_IF_KPH_Temp_Platine_XIX_ClimateControl_VR_XIX_Innenraumheizenelektrisch_XIX_Zone_VR.DE_KPH_Temp_Platine, system-signal=KPH_Temp_Platine
        communication-direction=IN, data-element=ClimateControl_VR_XIX_Innenraumheizenelektrisch_XIX_Zone_VR.Geltungsbereich_E3_2_0.RP_IF_KPH_Geblaese_Stufe_re_XIX_ClimateControl_VR_XIX_Innenraumheizenelektrisch_XIX_Zone_VR.DE_KPH_Geblaese_Stufe_re, system-signal=KPH_Geblaese_Stufe_re
        communication-direction=IN, data-element=ClimateControl_VR_XIX_Innenraumheizenelektrisch_XIX_Zone_VR.Geltungsbereich_E3_2_0.RP_IF_KPH_Tasten_Fehler_XIX_ClimateControl_VR_XIX_Innenraumheizenelektrisch_XIX_Zone_VR.DE_KPH_Tasten_Fehler, system-signal=KPH_Tasten_Fehler
        communication-direction=IN, data-element=ClimateControl_VR_XIX_Innenraumheizenelektrisch_XIX_Zone_VR.Geltungsbereich_E3_2_0.RP_IF_KPH_Sitzheizung_re_XIX_ClimateControl_VR_XIX_Innenraumheizenelektrisch_XIX_Zone_VR.DE_KPH_Sitzheizung_re, system-signal=KPH_Sitzheizung_re
        communication-direction=IN, data-element=ClimateControl_VR_XIX_Innenraumheizenelektrisch_XIX_Zone_VR.Geltungsbereich_E3_2_0.RP_IF_KPH_Ionisator_XIX_ClimateControl_VR_XIX_Innenraumheizenelektrisch_XIX_Zone_VR.DE_KPH_Ionisator, system-signal=KPH_Ionisator
        communication-direction=IN, data-element=ClimateControl_VR_XIX_Innenraumheizenelektrisch_XIX_Zone_VR.Geltungsbereich_E3_2_0.RP_IF_KPH_AC_XIX_ClimateControl_VR_XIX_Innenraumheizenelektrisch_XIX_Zone_VR.DE_KPH_AC, system-signal=KPH_AC
        communication-direction=IN, data-element=ClimateControl_VR_XIX_Innenraumheizenelektrisch_XIX_Zone_VR.Geltungsbereich_E3_2_0.RP_IF_KPH_Flaechenheizung_XIX_ClimateControl_VR_XIX_Innenraumheizenelektrisch_XIX_Zone_VR.DE_KPH_Flaechenheizung, system-signal=KPH_Flaechenheizung
        communication-direction=IN, data-element=ClimateControl_VR_XIX_Innenraumheizenelektrisch_XIX_Zone_VR.Geltungsbereich_E3_2_0.RP_IF_KPH_ResponseError_XIX_ClimateControl_VR_XIX_Innenraumheizenelektrisch_XIX_Zone_VR.DE_KPH_ResponseError, system-signal=KPH_ResponseError
        communication-direction=IN, data-element=ClimateControl_VR_XIX_Innenraumheizenelektrisch_XIX_Zone_VR.Geltungsbereich_E3_2_0.RP_IF_KPH_Luftverteilung_Oben_re_XIX_ClimateControl_VR_XIX_Innenraumheizenelektrisch_XIX_Zone_VR.DE_KPH_Luftverteilung_Oben_re, system-signal=KPH_Luftverteilung_Oben_re
        communication-direction=IN, data-element=ClimateControl_VR_XIX_Innenraumheizenelektrisch_XIX_Zone_VR.Geltungsbereich_E3_2_0.RP_IF_KPH_Luftverteilung_Mitte_li_XIX_ClimateControl_VR_XIX_Innenraumheizenelektrisch_XIX_Zone_VR.DE_KPH_Luftverteilung_Mitte_li, system-signal=KPH_Luftverteilung_Mitte_li
        communication-direction=IN, data-element=ClimateControl_VR_XIX_Innenraumheizenelektrisch_XIX_Zone_VR.Geltungsbereich_E3_2_0.RP_IF_KPH_Neigungssensor_XIX_ClimateControl_VR_XIX_Innenraumheizenelektrisch_XIX_Zone_VR.DE_KPH_Neigungssensor, system-signal=KPH_Neigungssensor
        communication-direction=IN, data-element=ClimateControl_VR_XIX_Innenraumheizenelektrisch_XIX_Zone_VR.Geltungsbereich_E3_2_0.RP_IF_KPH_Status_Spannung_XIX_ClimateControl_VR_XIX_Innenraumheizenelektrisch_XIX_Zone_VR.DE_KPH_Status_Spannung, system-signal=KPH_Status_Spannung
        communication-direction=IN, data-element=ClimateControl_VR_XIX_Innenraumheizenelektrisch_XIX_Zone_VR.Geltungsbereich_E3_2_0.RP_IF_KPH_Luftverteilung_Auto_li_XIX_ClimateControl_VR_XIX_Innenraumheizenelektrisch_XIX_Zone_VR.DE_KPH_Luftverteilung_Auto_li, system-signal=KPH_Luftverteilung_Auto_li
        communication-direction=IN, data-element=ClimateControl_VR_XIX_Innenraumheizenelektrisch_XIX_Zone_VR.Geltungsbereich_E3_2_0.RP_IF_KPH_Sync_XIX_ClimateControl_VR_XIX_Innenraumheizenelektrisch_XIX_Zone_VR.DE_KPH_Sync, system-signal=KPH_Sync
        communication-direction=IN, data-element=ClimateControl_VR_XIX_Innenraumheizenelektrisch_XIX_Zone_VR.Geltungsbereich_E3_2_0.RP_IF_KPH_Luftverteilung_Oben_li_XIX_ClimateControl_VR_XIX_Innenraumheizenelektrisch_XIX_Zone_VR.DE_KPH_Luftverteilung_Oben_li, system-signal=KPH_Luftverteilung_Oben_li
        communication-direction=IN, data-element=ClimateControl_VR_XIX_Innenraumheizenelektrisch_XIX_Zone_VR.Geltungsbereich_E3_2_0.RP_IF_KPH_Geblaese_Auto_li_XIX_ClimateControl_VR_XIX_Innenraumheizenelektrisch_XIX_Zone_VR.DE_KPH_Geblaese_Auto_li, system-signal=KPH_Geblaese_Auto_li
        communication-direction=IN, data-element=ClimateControl_VR_XIX_Innenraumheizenelektrisch_XIX_Zone_VR.Geltungsbereich_E3_2_0.RP_IF_KPH_Geblaese_Stufe_li_XIX_ClimateControl_VR_XIX_Innenraumheizenelektrisch_XIX_Zone_VR.DE_KPH_Geblaese_Stufe_li, system-signal=KPH_Geblaese_Stufe_li
        communication-direction=IN, data-element=ClimateControl_VR_XIX_Innenraumheizenelektrisch_XIX_Zone_VR.Geltungsbereich_E3_2_0.RP_IF_KPH_Luftverteilung_Auto_re_XIX_ClimateControl_VR_XIX_Innenraumheizenelektrisch_XIX_Zone_VR.DE_KPH_Luftverteilung_Auto_re, system-signal=KPH_Luftverteilung_Auto_re
        communication-direction=IN, data-element=ClimateControl_VR_XIX_Innenraumheizenelektrisch_XIX_Zone_VR.Geltungsbereich_E3_2_0.RP_IF_KPH_Sitzlueftung_re_XIX_ClimateControl_VR_XIX_Innenraumheizenelektrisch_XIX_Zone_VR.DE_KPH_Sitzlueftung_re, system-signal=KPH_Sitzlueftung_re
        communication-direction=IN, data-element=ClimateControl_VR_XIX_Innenraumheizenelektrisch_XIX_Zone_VR.Geltungsbereich_E3_2_0.RP_IF_KPH_Sitzlueftung_li_XIX_ClimateControl_VR_XIX_Innenraumheizenelektrisch_XIX_Zone_VR.DE_KPH_Sitzlueftung_li, system-signal=KPH_Sitzlueftung_li
        communication-direction=IN, data-element=ClimateControl_VR_XIX_Innenraumheizenelektrisch_XIX_Zone_VR.Geltungsbereich_E3_2_0.RP_IF_KPH_Auto_re_XIX_ClimateControl_VR_XIX_Innenraumheizenelektrisch_XIX_Zone_VR.DE_KPH_Auto_re, system-signal=KPH_Auto_re
        communication-direction=IN, data-element=ClimateControl_VR_XIX_Innenraumheizenelektrisch_XIX_Zone_VR.Geltungsbereich_E3_2_0.RP_IF_KPH_ECO_XIX_ClimateControl_VR_XIX_Innenraumheizenelektrisch_XIX_Zone_VR.DE_KPH_ECO, system-signal=KPH_ECO
        communication-direction=IN, data-element=ClimateControl_VR_XIX_Innenraumheizenelektrisch_XIX_Zone_VR.Geltungsbereich_E3_2_0.RP_IF_KPH_Klima_Menue_MMI_XIX_ClimateControl_VR_XIX_Innenraumheizenelektrisch_XIX_Zone_VR.DE_KPH_Klima_Menue_MMI, system-signal=KPH_Klima_Menue_MMI
        communication-direction=IN, data-element=ClimateControl_VR_XIX_Innenraumheizenelektrisch_XIX_Zone_VR.Geltungsbereich_E3_2_0.RP_IF_KPH_Lautsprecher_XIX_ClimateControl_VR_XIX_Innenraumheizenelektrisch_XIX_Zone_VR.DE_KPH_Lautsprecher, system-signal=KPH_Lautsprecher
        communication-direction=IN, data-element=ClimateControl_VR_XIX_Innenraumheizenelektrisch_XIX_Zone_VR.Geltungsbereich_E3_2_0.RP_IF_KPH_Luftverteilung_Unten_li_XIX_ClimateControl_VR_XIX_Innenraumheizenelektrisch_XIX_Zone_VR.DE_KPH_Luftverteilung_Unten_li, system-signal=KPH_Luftverteilung_Unten_li
        communication-direction=IN, data-element=ClimateControl_VR_XIX_Innenraumheizenelektrisch_XIX_Zone_VR.Geltungsbereich_E3_2_0.RP_IF_KPH_Temp_li_XIX_ClimateControl_VR_XIX_Innenraumheizenelektrisch_XIX_Zone_VR.DE_KPH_Temp_li, system-signal=KPH_Temp_li
        communication-direction=IN, data-element=ClimateControl_VR_XIX_Innenraumheizenelektrisch_XIX_Zone_VR.Geltungsbereich_E3_2_0.RP_IF_KPH_Auto_li_XIX_ClimateControl_VR_XIX_Innenraumheizenelektrisch_XIX_Zone_VR.DE_KPH_Auto_li, system-signal=KPH_Auto_li
        communication-direction=IN, data-element=ClimateControl_VR_XIX_Innenraumheizenelektrisch_XIX_Zone_VR.Geltungsbereich_E3_2_0.RP_IF_KPH_ECO_links_XIX_ClimateControl_VR_XIX_Innenraumheizenelektrisch_XIX_Zone_VR.DE_KPH_ECO_links, system-signal=KPH_ECO_links
        communication-direction=IN, data-element=ClimateControl_VR_XIX_Innenraumheizenelektrisch_XIX_Zone_VR.Geltungsbereich_E3_2_0.RP_IF_KPH_Sitzheizung_li_XIX_ClimateControl_VR_XIX_Innenraumheizenelektrisch_XIX_Zone_VR.DE_KPH_Sitzheizung_li, system-signal=KPH_Sitzheizung_li
        communication-direction=IN, data-element=ClimateControl_VR_XIX_Innenraumheizenelektrisch_XIX_Zone_VR.Geltungsbereich_E3_2_0.RP_IF_KPH_Beduftung_XIX_ClimateControl_VR_XIX_Innenraumheizenelektrisch_XIX_Zone_VR.DE_KPH_Beduftung, system-signal=KPH_Beduftung
        communication-direction=IN, data-element=ClimateControl_VR_XIX_Innenraumheizenelektrisch_XIX_Zone_VR.Geltungsbereich_E3_2_0.RP_IF_KPH_Umluft_XIX_ClimateControl_VR_XIX_Innenraumheizenelektrisch_XIX_Zone_VR.DE_KPH_Umluft, system-signal=KPH_Umluft
        communication-direction=IN, data-element=ClimateControl_VR_XIX_Innenraumheizenelektrisch_XIX_Zone_VR.Geltungsbereich_E3_2_0.RP_IF_KPH_Temp_re_XIX_ClimateControl_VR_XIX_Innenraumheizenelektrisch_XIX_Zone_VR.DE_KPH_Temp_re, system-signal=KPH_Temp_re
        communication-direction=IN, data-element=ClimateControl_VR_XIX_Innenraumheizenelektrisch_XIX_Zone_VR.Geltungsbereich_E3_2_0.RP_IF_KPH_AC_max_XIX_ClimateControl_VR_XIX_Innenraumheizenelektrisch_XIX_Zone_VR.DE_KPH_AC_max, system-signal=KPH_AC_max
        communication-direction=IN, data-element=ClimateControl_VR_XIX_Innenraumheizenelektrisch_XIX_Zone_VR.Geltungsbereich_E3_2_0.RP_IF_KPH_Geblaese_Auto_re_XIX_ClimateControl_VR_XIX_Innenraumheizenelektrisch_XIX_Zone_VR.DE_KPH_Geblaese_Auto_re, system-signal=KPH_Geblaese_Auto_re
        communication-direction=IN, data-element=ClimateControl_VR_XIX_Innenraumheizenelektrisch_XIX_Zone_VR.Geltungsbereich_E3_2_0.RP_IF_KL_DI_KL_58xd_XIX_ClimateControl_VR_XIX_Innenraumheizenelektrisch_XIX_Zone_VR.DE_KL_DI_KL_58xd, system-signal=KL_DI_KL_58xd
        communication-direction=IN, data-element=ClimateControl_VR_XIX_Innenraumheizenelektrisch_XIX_Zone_VR.Geltungsbereich_E3_2_0.RP_IF_KL_DI_KL_58xs_XIX_ClimateControl_VR_XIX_Innenraumheizenelektrisch_XIX_Zone_VR.DE_KL_DI_KL_58xs, system-signal=KL_DI_KL_58xs
        communication-direction=OUT, data-element=ClimateControl_VR_XIX_Innenraumheizenelektrisch_XIX_Zone_VR.Geltungsbereich_E3_2_0.SP_IF_KL_DI_KL_58xd_XIX_ClimateControl_VR_XIX_Innenraumheizenelektrisch_XIX_Zone_VR.DE_KL_DI_KL_58xd, system-signal=KL_DI_KL_58xd
        communication-direction=OUT, data-element=ClimateControl_VR_XIX_Innenraumheizenelektrisch_XIX_Zone_VR.Geltungsbereich_E3_2_0.SP_IF_KL_DI_KL_58xs_XIX_ClimateControl_VR_XIX_Innenraumheizenelektrisch_XIX_Zone_VR.DE_KL_DI_KL_58xs, system-signal=KL_DI_KL_58xs
        communication-direction=IN, data-element=ClimateControl_VR_XIX_Innenraumheizenelektrisch_XIX_Zone_VR.Geltungsbereich_E3_2_0.RP_IF_KL_KST_KL_15_XIX_ClimateControl_VR_XIX_Innenraumheizenelektrisch_XIX_Zone_VR.DE_KL_KST_KL_15, system-signal=KL_KST_KL_15
        communication-direction=OUT, data-element=ClimateControl_VR_XIX_Innenraumheizenelektrisch_XIX_Zone_VR.Geltungsbereich_E3_2_0.SP_IF_ClActFan_st_BlowerSt_S_XIX_ClimateControl_VR_XIX_Innenraumheizenelektrisch_XIX_Zone_VR.DE_ClActFan_st_BlowerSt_S, system-signal=ClActFan_st_BlowerSt_S
        communication-direction=OUT, data-element=ClimateControl_VR_XIX_Innenraumheizenelektrisch_XIX_Zone_VR.Geltungsbereich_E3_2_0.SP_IF_ClAct_perc_FlapDfrstCurVal_S_XIX_ClimateControl_VR_XIX_Innenraumheizenelektrisch_XIX_Zone_VR.DE_ClAct_perc_FlapDfrstCurVal_S, system-signal=ClAct_perc_FlapDfrstCurVal_S
        communication-direction=OUT, data-element=ClimateControl_VR_XIX_Innenraumheizenelektrisch_XIX_Zone_VR.Geltungsbereich_E3_2_0.SP_IF_ClAct_st_FlapTempFrntLe_S_XIX_ClimateControl_VR_XIX_Innenraumheizenelektrisch_XIX_Zone_VR.DE_ClAct_st_FlapTempFrntLe_S, system-signal=ClAct_st_FlapTempFrntLe_S
        communication-direction=OUT, data-element=ClimateControl_VR_XIX_Innenraumheizenelektrisch_XIX_Zone_VR.Geltungsbereich_E3_2_0.SP_IF_ClAct_st_FlapTempRearLe_S_XIX_ClimateControl_VR_XIX_Innenraumheizenelektrisch_XIX_Zone_VR.DE_ClAct_st_FlapTempRearLe_S, system-signal=ClAct_st_FlapTempRearLe_S
        communication-direction=OUT, data-element=ClimateControl_VR_XIX_Innenraumheizenelektrisch_XIX_Zone_VR.Geltungsbereich_E3_2_0.SP_IF_ClAct_perc_FlapTRearLeCurVal_XIX_ClimateControl_VR_XIX_Innenraumheizenelektrisch_XIX_Zone_VR.DE_ClAct_perc_FlapTRearLeCurVal, system-signal=ClAct_perc_FlapTRearLeCurVal
        communication-direction=OUT, data-element=ClimateControl_VR_XIX_Innenraumheizenelektrisch_XIX_Zone_VR.Geltungsbereich_E3_2_0.SP_IF_ClSensUIF_T_FilUIF_S_XIX_ClimateControl_VR_XIX_Innenraumheizenelektrisch_XIX_Zone_VR.DE_ClSensUIF_T_FilUIF_S, system-signal=ClSensUIF_T_FilUIF_S
        communication-direction=OUT, data-element=ClimateControl_VR_XIX_Innenraumheizenelektrisch_XIX_Zone_VR.Geltungsbereich_E3_2_0.SP_IF_ClSensUIF_T_ValUIF_S_XIX_ClimateControl_VR_XIX_Innenraumheizenelektrisch_XIX_Zone_VR.DE_ClSensUIF_T_ValUIF_S, system-signal=ClSensUIF_T_ValUIF_S
        communication-direction=OUT, data-element=ClimateControl_VR_XIX_Innenraumheizenelektrisch_XIX_Zone_VR.Geltungsbereich_E3_2_0.SP_IF_ClHmi_SetBit2_S_XIX_ClimateControl_VR_XIX_Innenraumheizenelektrisch_XIX_Zone_VR.DE_ClHmi_SetBit2_S, system-signal=ClHmi_SetBit2_S
        communication-direction=OUT, data-element=ClimateControl_VR_XIX_Innenraumheizenelektrisch_XIX_Zone_VR.Geltungsbereich_E3_2_0.SP_IF_ClCcpRear_T_TarTempLe_XIX_ClimateControl_VR_XIX_Innenraumheizenelektrisch_XIX_Zone_VR.DE_ClCcpRear_T_TarTempLe, system-signal=ClCcpRear_T_TarTempLe
        communication-direction=OUT, data-element=ClimateControl_VR_XIX_Innenraumheizenelektrisch_XIX_Zone_VR.Geltungsbereich_E3_2_0.SP_IF_ClSensUIF_st_State_S_XIX_ClimateControl_VR_XIX_Innenraumheizenelektrisch_XIX_Zone_VR.DE_ClSensUIF_st_State_S, system-signal=ClSensUIF_st_State_S
        communication-direction=OUT, data-element=ClimateControl_VR_XIX_Innenraumheizenelektrisch_XIX_Zone_VR.Geltungsbereich_E3_2_0.SP_IF_ClAct_st_FlapTRearRiDfrst_XIX_ClimateControl_VR_XIX_Innenraumheizenelektrisch_XIX_Zone_VR.DE_ClAct_st_FlapTRearRiDfrst, system-signal=ClAct_st_FlapTRearRiDfrst
        communication-direction=OUT, data-element=ClimateControl_VR_XIX_Innenraumheizenelektrisch_XIX_Zone_VR.Geltungsbereich_E3_2_0.SP_IF_ClAct_perc_FlapTRearRiCurVal_XIX_ClimateControl_VR_XIX_Innenraumheizenelektrisch_XIX_Zone_VR.DE_ClAct_perc_FlapTRearRiCurVal, system-signal=ClAct_perc_FlapTRearRiCurVal
        communication-direction=OUT, data-element=ClimateControl_VR_XIX_Innenraumheizenelektrisch_XIX_Zone_VR.Geltungsbereich_E3_2_0.SP_IF_ClCcpRear_T_TarTempRi_XIX_ClimateControl_VR_XIX_Innenraumheizenelektrisch_XIX_Zone_VR.DE_ClCcpRear_T_TarTempRi, system-signal=ClCcpRear_T_TarTempRi
        communication-direction=OUT, data-element=ClimateControl_VR_XIX_Innenraumheizenelektrisch_XIX_Zone_VR.Geltungsbereich_E3_2_0.SP_IF_ClAct_perc_FlapTFrntLeCurVal_XIX_ClimateControl_VR_XIX_Innenraumheizenelektrisch_XIX_Zone_VR.DE_ClAct_perc_FlapTFrntLeCurVal, system-signal=ClAct_perc_FlapTFrntLeCurVal
        communication-direction=OUT, data-element=ClimateControl_VR_XIX_Innenraumheizenelektrisch_XIX_Zone_VR.Geltungsbereich_E3_2_0.SP_IF_ClCcpRear_no_SetDfrst_S_XIX_ClimateControl_VR_XIX_Innenraumheizenelektrisch_XIX_Zone_VR.DE_ClCcpRear_no_SetDfrst_S, system-signal=ClCcpRear_no_SetDfrst_S
        communication-direction=OUT, data-element=ClimateControl_VR_XIX_Innenraumheizenelektrisch_XIX_Zone_VR.Geltungsbereich_E3_2_0.SP_IF_ClAct_perc_FlapTFrntRiCurVal_XIX_ClimateControl_VR_XIX_Innenraumheizenelektrisch_XIX_Zone_VR.DE_ClAct_perc_FlapTFrntRiCurVal, system-signal=ClAct_perc_FlapTFrntRiCurVal
        communication-direction=OUT, data-element=ClimateControl_VR_XIX_Innenraumheizenelektrisch_XIX_Zone_VR.Geltungsbereich_E3_2_0.SP_IF_ClAct_st_FlapTempFrntRi_S_XIX_ClimateControl_VR_XIX_Innenraumheizenelektrisch_XIX_Zone_VR.DE_ClAct_st_FlapTempFrntRi_S, system-signal=ClAct_st_FlapTempFrntRi_S
        communication-direction=OUT, data-element=ClimateControl_VR_XIX_Innenraumheizenelektrisch_XIX_Zone_VR.Geltungsbereich_E3_2_0.SP_IF_ClActFan_perc_BlowerCurVal_S_XIX_ClimateControl_VR_XIX_Innenraumheizenelektrisch_XIX_Zone_VR.DE_ClActFan_perc_BlowerCurVal_S, system-signal=ClActFan_perc_BlowerCurVal_S
        communication-direction=OUT, data-element=ClimateControl_VR_XIX_Innenraumheizenelektrisch_XIX_Zone_VR.Geltungsbereich_E3_2_0.SP_IF_ClAct_st_FlapDfrst_S_XIX_ClimateControl_VR_XIX_Innenraumheizenelektrisch_XIX_Zone_VR.DE_ClAct_st_FlapDfrst_S, system-signal=ClAct_st_FlapDfrst_S
        communication-direction=OUT, data-element=ClimateControl_VR_XIX_Innenraumheizenelektrisch_XIX_Zone_VR.Geltungsbereich_E3_2_0.SP_IF_ClCcpRear_no_TarDfrst_S_XIX_ClimateControl_VR_XIX_Innenraumheizenelektrisch_XIX_Zone_VR.DE_ClCcpRear_no_TarDfrst_S, system-signal=ClCcpRear_no_TarDfrst_S
        communication-direction=OUT, data-element=ClimateControl_VR_XIX_Innenraumheizenelektrisch_XIX_Zone_VR.Geltungsbereich_E3_2_0.SP_IF_ClSensTemp_T_TempKGFrnt_S_XIX_ClimateControl_VR_XIX_Innenraumheizenelektrisch_XIX_Zone_VR.DE_ClSensTemp_T_TempKGFrnt_S, system-signal=ClSensTemp_T_TempKGFrnt_S
        communication-direction=OUT, data-element=ClimateControl_VR_XIX_Innenraumheizenelektrisch_XIX_Zone_VR.Geltungsbereich_E3_2_0.SP_IF_ClHmi_SetBit1_S_XIX_ClimateControl_VR_XIX_Innenraumheizenelektrisch_XIX_Zone_VR.DE_ClHmi_SetBit1_S, system-signal=ClHmi_SetBit1_S
        communication-direction=IN, data-element=ClimateControl_VR_XIX_Innenraumheizenelektrisch_XIX_Zone_VR.Geltungsbereich_E3_2_0.RP_IF_ClHmi_T_CurTempFrntLe_S_XIX_ClimateControl_VR_XIX_Innenraumheizenelektrisch_XIX_Zone_VR.DE_ClHmi_T_CurTempFrntLe_S, system-signal=ClHmi_T_CurTempFrntLe_S
        communication-direction=IN, data-element=ClimateControl_VR_XIX_Innenraumheizenelektrisch_XIX_Zone_VR.Geltungsbereich_E3_2_0.RP_IF_ClAct_perc_FlapDfrstTarVal_XIX_ClimateControl_VR_XIX_Innenraumheizenelektrisch_XIX_Zone_VR.DE_ClAct_perc_FlapDfrstTarVal, system-signal=ClAct_perc_FlapDfrstTarVal
        communication-direction=IN, data-element=ClimateControl_VR_XIX_Innenraumheizenelektrisch_XIX_Zone_VR.Geltungsbereich_E3_2_0.RP_IF_ClActFan_perc_BlowerTarVal_S_XIX_ClimateControl_VR_XIX_Innenraumheizenelektrisch_XIX_Zone_VR.DE_ClActFan_perc_BlowerTarVal_S, system-signal=ClActFan_perc_BlowerTarVal_S
        communication-direction=IN, data-element=ClimateControl_VR_XIX_Innenraumheizenelektrisch_XIX_Zone_VR.Geltungsbereich_E3_2_0.RP_IF_ClHmi_T_CurTempRearLe_S_XIX_ClimateControl_VR_XIX_Innenraumheizenelektrisch_XIX_Zone_VR.DE_ClHmi_T_CurTempRearLe_S, system-signal=ClHmi_T_CurTempRearLe_S
        communication-direction=IN, data-element=ClimateControl_VR_XIX_Innenraumheizenelektrisch_XIX_Zone_VR.Geltungsbereich_E3_2_0.RP_IF_ClHmi_st_StDfrst_S_XIX_ClimateControl_VR_XIX_Innenraumheizenelektrisch_XIX_Zone_VR.DE_ClHmi_st_StDfrst_S, system-signal=ClHmi_st_StDfrst_S
        communication-direction=IN, data-element=ClimateControl_VR_XIX_Innenraumheizenelektrisch_XIX_Zone_VR.Geltungsbereich_E3_2_0.RP_IF_ClSens_SetBit1_S_XIX_ClimateControl_VR_XIX_Innenraumheizenelektrisch_XIX_Zone_VR.DE_ClSens_SetBit1_S, system-signal=ClSens_SetBit1_S
        communication-direction=IN, data-element=ClimateControl_VR_XIX_Innenraumheizenelektrisch_XIX_Zone_VR.Geltungsbereich_E3_2_0.RP_IF_ClHmi_T_CurTempFrntRi_S_XIX_ClimateControl_VR_XIX_Innenraumheizenelektrisch_XIX_Zone_VR.DE_ClHmi_T_CurTempFrntRi_S, system-signal=ClHmi_T_CurTempFrntRi_S
        communication-direction=IN, data-element=ClimateControl_VR_XIX_Innenraumheizenelektrisch_XIX_Zone_VR.Geltungsbereich_E3_2_0.RP_IF_ClAct_perc_FlapTFrntRiTarVal_XIX_ClimateControl_VR_XIX_Innenraumheizenelektrisch_XIX_Zone_VR.DE_ClAct_perc_FlapTFrntRiTarVal, system-signal=ClAct_perc_FlapTFrntRiTarVal
        communication-direction=IN, data-element=ClimateControl_VR_XIX_Innenraumheizenelektrisch_XIX_Zone_VR.Geltungsbereich_E3_2_0.RP_IF_ClHmi_T_CurTempRearRi_S_XIX_ClimateControl_VR_XIX_Innenraumheizenelektrisch_XIX_Zone_VR.DE_ClHmi_T_CurTempRearRi_S, system-signal=ClHmi_T_CurTempRearRi_S
        communication-direction=IN, data-element=ClimateControl_VR_XIX_Innenraumheizenelektrisch_XIX_Zone_VR.Geltungsbereich_E3_2_0.RP_IF_ClSens_SetBit2_S_XIX_ClimateControl_VR_XIX_Innenraumheizenelektrisch_XIX_Zone_VR.DE_ClSens_SetBit2_S, system-signal=ClSens_SetBit2_S
        communication-direction=IN, data-element=ClimateControl_VR_XIX_Innenraumheizenelektrisch_XIX_Zone_VR.Geltungsbereich_E3_2_0.RP_IF_ClAct_perc_FlapTFrntLeTarVal_XIX_ClimateControl_VR_XIX_Innenraumheizenelektrisch_XIX_Zone_VR.DE_ClAct_perc_FlapTFrntLeTarVal, system-signal=ClAct_perc_FlapTFrntLeTarVal
        communication-direction=IN, data-element=ClimateControl_VR_XIX_Innenraumheizenelektrisch_XIX_Zone_VR.Geltungsbereich_E3_2_0.RP_IF_ClStm_OpState_XIX_ClimateControl_VR_XIX_Innenraumheizenelektrisch_XIX_Zone_VR.DE_ClStm_OpState, system-signal=ClStm_OpState
        communication-direction=IN, data-element=ClimateControl_VR_XIX_Innenraumheizenelektrisch_XIX_Zone_VR.Geltungsbereich_E3_2_0.RP_IF_ClAct_perc_FlapTRearLeTarVal_XIX_ClimateControl_VR_XIX_Innenraumheizenelektrisch_XIX_Zone_VR.DE_ClAct_perc_FlapTRearLeTarVal, system-signal=ClAct_perc_FlapTRearLeTarVal
        communication-direction=IN, data-element=ClimateControl_VR_XIX_Innenraumheizenelektrisch_XIX_Zone_VR.Geltungsbereich_E3_2_0.RP_IF_ClAct_perc_FlapTRearRiTarVal_XIX_ClimateControl_VR_XIX_Innenraumheizenelektrisch_XIX_Zone_VR.DE_ClAct_perc_FlapTRearRiTarVal, system-signal=ClAct_perc_FlapTRearRiTarVal
        communication-direction=OUT, data-element=ClimateControl_VR_XIX_Innenraumheizenelektrisch_XIX_Zone_VR.Geltungsbereich_E3_2_0.SP_IF_STRG100a_Stopmodus_XIX_ClimateControl_VR_XIX_Innenraumheizenelektrisch_XIX_Zone_VR.DE_STRG100a_Stopmodus, system-signal=STRG100a_Stopmodus
        communication-direction=OUT, data-element=ClimateControl_VR_XIX_Innenraumheizenelektrisch_XIX_Zone_VR.Geltungsbereich_E3_2_0.SP_IF_STRG100a_Soll_Position_XIX_ClimateControl_VR_XIX_Innenraumheizenelektrisch_XIX_Zone_VR.DE_STRG100a_Soll_Position, system-signal=STRG100a_Soll_Position
        communication-direction=OUT, data-element=ClimateControl_VR_XIX_Innenraumheizenelektrisch_XIX_Zone_VR.Geltungsbereich_E3_2_0.SP_IF_STRG100a_Drehrichtung_XIX_ClimateControl_VR_XIX_Innenraumheizenelektrisch_XIX_Zone_VR.DE_STRG100a_Drehrichtung, system-signal=STRG100a_Drehrichtung
        communication-direction=OUT, data-element=ClimateControl_VR_XIX_Innenraumheizenelektrisch_XIX_Zone_VR.Geltungsbereich_E3_2_0.SP_IF_STRG100a_Freig_Blockiererkennung_XIX_ClimateControl_VR_XIX_Innenraumheizenelektrisch_XIX_Zone_VR.DE_STRG100a_Freig_Blockiererkennung, system-signal=STRG100a_Freig_Blockiererkennung
        communication-direction=OUT, data-element=ClimateControl_VR_XIX_Innenraumheizenelektrisch_XIX_Zone_VR.Geltungsbereich_E3_2_0.SP_IF_STRG100a_Geschwindigkeitsvorgabe_XIX_ClimateControl_VR_XIX_Innenraumheizenelektrisch_XIX_Zone_VR.DE_STRG100a_Geschwindigkeitsvorgabe, system-signal=STRG100a_Geschwindigkeitsvorgabe
        communication-direction=OUT, data-element=ClimateControl_VR_XIX_Innenraumheizenelektrisch_XIX_Zone_VR.Geltungsbereich_E3_2_0.SP_IF_STRG100a_Adresse_XIX_ClimateControl_VR_XIX_Innenraumheizenelektrisch_XIX_Zone_VR.DE_STRG100a_Adresse, system-signal=STRG100a_Adresse
        communication-direction=OUT, data-element=ClimateControl_VR_XIX_Innenraumheizenelektrisch_XIX_Zone_VR.Geltungsbereich_E3_2_0.SP_IF_STRG100a_PrgDaten_speichern_XIX_ClimateControl_VR_XIX_Innenraumheizenelektrisch_XIX_Zone_VR.DE_STRG100a_PrgDaten_speichern, system-signal=STRG100a_PrgDaten_speichern
        communication-direction=OUT, data-element=ClimateControl_VR_XIX_Innenraumheizenelektrisch_XIX_Zone_VR.Geltungsbereich_E3_2_0.SP_IF_STRG100a_Notlaufposition_XIX_ClimateControl_VR_XIX_Innenraumheizenelektrisch_XIX_Zone_VR.DE_STRG100a_Notlaufposition, system-signal=STRG100a_Notlaufposition
        communication-direction=OUT, data-element=ClimateControl_VR_XIX_Innenraumheizenelektrisch_XIX_Zone_VR.Geltungsbereich_E3_2_0.SP_IF_STRG100a_Clear_Event_Flags_XIX_ClimateControl_VR_XIX_Innenraumheizenelektrisch_XIX_Zone_VR.DE_STRG100a_Clear_Event_Flags, system-signal=STRG100a_Clear_Event_Flags
        communication-direction=OUT, data-element=ClimateControl_VR_XIX_Innenraumheizenelektrisch_XIX_Zone_VR.Geltungsbereich_E3_2_0.SP_IF_STRG100a_Notlauffreigabe_XIX_ClimateControl_VR_XIX_Innenraumheizenelektrisch_XIX_Zone_VR.DE_STRG100a_Notlauffreigabe, system-signal=STRG100a_Notlauffreigabe
        communication-direction=OUT, data-element=ClimateControl_VR_XIX_Innenraumheizenelektrisch_XIX_Zone_VR.Geltungsbereich_E3_2_0.SP_IF_STRG100a_Start_Position_XIX_ClimateControl_VR_XIX_Innenraumheizenelektrisch_XIX_Zone_VR.DE_STRG100a_Start_Position, system-signal=STRG100a_Start_Position
        communication-direction=OUT, data-element=ClimateControl_VR_XIX_Innenraumheizenelektrisch_XIX_Zone_VR.Geltungsbereich_E3_2_0.SP_IF_STRG100a_Select_Positionsvorgabe_XIX_ClimateControl_VR_XIX_Innenraumheizenelektrisch_XIX_Zone_VR.DE_STRG100a_Select_Positionsvorgabe, system-signal=STRG100a_Select_Positionsvorgabe
        communication-direction=OUT, data-element=ClimateControl_VR_XIX_Innenraumheizenelektrisch_XIX_Zone_VR.Geltungsbereich_E3_2_0.SP_IF_STRG100a_Spulenhaltebestromung_XIX_ClimateControl_VR_XIX_Innenraumheizenelektrisch_XIX_Zone_VR.DE_STRG100a_Spulenhaltebestromung, system-signal=STRG100a_Spulenhaltebestromung
        communication-direction=OUT, data-element=ClimateControl_VR_XIX_Innenraumheizenelektrisch_XIX_Zone_VR.Geltungsbereich_E3_2_0.SP_IF_STRG100f_Soll_Position_XIX_ClimateControl_VR_XIX_Innenraumheizenelektrisch_XIX_Zone_VR.DE_STRG100f_Soll_Position, system-signal=STRG100f_Soll_Position
        communication-direction=OUT, data-element=ClimateControl_VR_XIX_Innenraumheizenelektrisch_XIX_Zone_VR.Geltungsbereich_E3_2_0.SP_IF_STRG100f_Geschwindigkeitsvorgabe_XIX_ClimateControl_VR_XIX_Innenraumheizenelektrisch_XIX_Zone_VR.DE_STRG100f_Geschwindigkeitsvorgabe, system-signal=STRG100f_Geschwindigkeitsvorgabe
        communication-direction=OUT, data-element=ClimateControl_VR_XIX_Innenraumheizenelektrisch_XIX_Zone_VR.Geltungsbereich_E3_2_0.SP_IF_STRG100f_Adresse_XIX_ClimateControl_VR_XIX_Innenraumheizenelektrisch_XIX_Zone_VR.DE_STRG100f_Adresse, system-signal=STRG100f_Adresse
        communication-direction=OUT, data-element=ClimateControl_VR_XIX_Innenraumheizenelektrisch_XIX_Zone_VR.Geltungsbereich_E3_2_0.SP_IF_STRG100f_Spulenhaltebestromung_XIX_ClimateControl_VR_XIX_Innenraumheizenelektrisch_XIX_Zone_VR.DE_STRG100f_Spulenhaltebestromung, system-signal=STRG100f_Spulenhaltebestromung
        communication-direction=OUT, data-element=ClimateControl_VR_XIX_Innenraumheizenelektrisch_XIX_Zone_VR.Geltungsbereich_E3_2_0.SP_IF_STRG100f_Clear_Event_Flags_XIX_ClimateControl_VR_XIX_Innenraumheizenelektrisch_XIX_Zone_VR.DE_STRG100f_Clear_Event_Flags, system-signal=STRG100f_Clear_Event_Flags
        communication-direction=OUT, data-element=ClimateControl_VR_XIX_Innenraumheizenelektrisch_XIX_Zone_VR.Geltungsbereich_E3_2_0.SP_IF_STRG100f_Drehrichtung_XIX_ClimateControl_VR_XIX_Innenraumheizenelektrisch_XIX_Zone_VR.DE_STRG100f_Drehrichtung, system-signal=STRG100f_Drehrichtung
        communication-direction=OUT, data-element=ClimateControl_VR_XIX_Innenraumheizenelektrisch_XIX_Zone_VR.Geltungsbereich_E3_2_0.SP_IF_STRG100f_Notlauffreigabe_XIX_ClimateControl_VR_XIX_Innenraumheizenelektrisch_XIX_Zone_VR.DE_STRG100f_Notlauffreigabe, system-signal=STRG100f_Notlauffreigabe
        communication-direction=OUT, data-element=ClimateControl_VR_XIX_Innenraumheizenelektrisch_XIX_Zone_VR.Geltungsbereich_E3_2_0.SP_IF_STRG100f_Notlaufposition_XIX_ClimateControl_VR_XIX_Innenraumheizenelektrisch_XIX_Zone_VR.DE_STRG100f_Notlaufposition, system-signal=STRG100f_Notlaufposition
        communication-direction=OUT, data-element=ClimateControl_VR_XIX_Innenraumheizenelektrisch_XIX_Zone_VR.Geltungsbereich_E3_2_0.SP_IF_STRG100f_Start_Position_XIX_ClimateControl_VR_XIX_Innenraumheizenelektrisch_XIX_Zone_VR.DE_STRG100f_Start_Position, system-signal=STRG100f_Start_Position
        communication-direction=OUT, data-element=ClimateControl_VR_XIX_Innenraumheizenelektrisch_XIX_Zone_VR.Geltungsbereich_E3_2_0.SP_IF_STRG100f_Stopmodus_XIX_ClimateControl_VR_XIX_Innenraumheizenelektrisch_XIX_Zone_VR.DE_STRG100f_Stopmodus, system-signal=STRG100f_Stopmodus
        communication-direction=OUT, data-element=ClimateControl_VR_XIX_Innenraumheizenelektrisch_XIX_Zone_VR.Geltungsbereich_E3_2_0.SP_IF_STRG100f_Freig_Blockiererkennung_XIX_ClimateControl_VR_XIX_Innenraumheizenelektrisch_XIX_Zone_VR.DE_STRG100f_Freig_Blockiererkennung, system-signal=STRG100f_Freig_Blockiererkennung
        communication-direction=OUT, data-element=ClimateControl_VR_XIX_Innenraumheizenelektrisch_XIX_Zone_VR.Geltungsbereich_E3_2_0.SP_IF_STRG100f_Select_Positionsvorgabe_XIX_ClimateControl_VR_XIX_Innenraumheizenelektrisch_XIX_Zone_VR.DE_STRG100f_Select_Positionsvorgabe, system-signal=STRG100f_Select_Positionsvorgabe
        communication-direction=OUT, data-element=ClimateControl_VR_XIX_Innenraumheizenelektrisch_XIX_Zone_VR.Geltungsbereich_E3_2_0.SP_IF_STRG100f_PrgDaten_speichern_XIX_ClimateControl_VR_XIX_Innenraumheizenelektrisch_XIX_Zone_VR.DE_STRG100f_PrgDaten_speichern, system-signal=STRG100f_PrgDaten_speichern
        communication-direction=OUT, data-element=ThermalManagement_VR_XIX_BereitstellungAuentemperatursignal_XIX_Zone_VR.Geltungsbereich_E3_2_0.SP_IF_TME_T_OutsideAirTemp_raw_XIX_ThermalManagement_VR_XIX_BereitstellungAuentemperatursignal_XIX_Zone_VR.DE_TME_T_OutsideAirTemp_raw, system-signal=TME_T_OutsideAirTemp_raw
        communication-direction=OUT, data-element=Grundumfang_XIX_Zone_VR.Geltungsbereich_E3_2_0.SP_IF_Zone_VR_SNI_10_XIX_Grundumfang_XIX_Zone_VR.DE_Zone_VR_SNI_10, system-signal=Zone_VR_SNI_10
      sw-mappings:
        swc to ecu mapping MAPPING_ClimateControl_VR_XIX_Innenraumheizenelektrisch_XIX_Zone_VR: component=Geltungsbereich_E3_2_0.ClimateControl_VR_XIX_Innenraumheizenelektrisch_XIX_Zone_VR, ecu-instance=Zone_VR
        swc to ecu mapping MAPPING_ThermalManagement_VR_XIX_BereitstellungAuentemperatursignal_XIX_Zone_VR: component=Geltungsbereich_E3_2_0.ThermalManagement_VR_XIX_BereitstellungAuentemperatursignal_XIX_Zone_VR, ecu-instance=Zone_VR
        swc to ecu mapping MAPPING_Grundumfang_XIX_Zone_VR: component=Geltungsbereich_E3_2_0.Grundumfang_XIX_Zone_VR, ecu-instance=Zone_VR
    root-software-compositions:
      root sw composition prototype Geltungsbereich_E3_2_0: software-composition=Geltungsbereich_E3_2_0
package /ECU
  ecu instance Zone_VR: associated-com-i-pdu-group=[Zone_VR_XIX_Zone_VR_LIN12_Tx, Zone_VR_XIX_Zone_VR_LIN12_Rx, Zone_VR_XIX_VLAN_FAS_Tx, Zone_VR_XIX_VLAN_FAS_Rx, Zone_VR_XIX_Zone_VR_LIN11_Tx, Zone_VR_XIX_Zone_VR_LIN11_Rx, Zone_VR_XIX_Zone_VR_LIN06_Tx, Zone_VR_XIX_Zone_VR_LIN06_Rx], pn-reset-time=0.5, pnc-prepare-sleep-timer=0, sleep-mode-supported=true, wake-up-over-bus-supported=false
    lin master CT_Zone_VR_LIN12: protocol-version=2.0, time-base=0.01, time-base-jitter=9.0E-4
    ethernet communication controller CT_VLAN_FAS: wake-up-by-controller-supported=true
      coupling port CP_Zone_VR_XIX_CPUPort_VLAN_FAS: connection-negotiation-behavior=SLAVE, physical-layer-type=100BASE-T1, vlan-membership{send-activity=SENT-TAGGED, vlan=VLAN_FAS}
        coupling-port-details last-egress-scheduler=Schedule_CPUPort_VLAN_FAS_7:
          coupling-port-structural-elements:
            8 x coupling port fifo:
              Fifo_CPUPort_VLAN_FAS_{0..7}
            8 x coupling port scheduler, all with port-scheduler=STRICT-PRIORITY:
              Schedule_CPUPort_VLAN_FAS_{0..7}
          8 x ethernet priority regeneration:
            IngressPrio_CPUPort_VLAN_FAS_{0..7}: ingress-priority={0..7}, regenerated-priority={0..7}
    lin master CT_Zone_VR_LIN11: protocol-version=2.0, time-base=0.01, time-base-jitter=9.0E-4
    lin master CT_Zone_VR_LIN06: protocol-version=2.0, time-base=0.01, time-base-jitter=9.0E-4
    lin communication connector CN_Zone_VR_LIN12: comm-controller=CT_Zone_VR_LIN12
    ethernet communication connector CN_VLAN_FAS: comm-controller=CT_VLAN_FAS, pnc-gateway-type=NONE, maximum-transmission-unit=1500, network-endpoint=NE_ff14_0000_0000_0000_0000_0000_0000_0061
    lin communication connector CN_Zone_VR_LIN11: comm-controller=CT_Zone_VR_LIN11
    lin communication connector CN_Zone_VR_LIN06: comm-controller=CT_Zone_VR_LIN06
