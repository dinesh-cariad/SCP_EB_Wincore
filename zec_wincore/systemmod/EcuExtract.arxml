AUTOSAR XML (schema 00046)
package /EcuExtract
  composition sw component type TopLevelComposition
  system ECU: category=ECU_EXTRACT, system-version=1.0.0
    system mapping DummyEcuExtractSysMapping
    root-software-compositions:
      root sw composition prototype TopLevelCompositionPrototype: software-composition=TopLevelComposition
