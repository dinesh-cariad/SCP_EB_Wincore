[part 3 of 3: package /AUTOSAR]
AUTOSAR XML (schema 2.1.2)
# Following the completion of the development of the AUTOSAR specifications
# commercial exploitation licenses will be made available to end users by way of
# written License Agreement only.
# No part of this publication may be reproduced or utilized in any form or by any
# means, electronic or mechanical, including photocopying and microfilm, without
# permission in writing from the publisher.
# The word AUTOSAR and the AUTOSAR logo are registered trademarks.
# Copyright 2004-2007 AUTOSAR Development Partnership. All rights reserved.
# exemplary items are licensed under the same rules as applicable to the AUTOSAR
package /AUTOSAR  (continued)
  module definition IoHwAbstraction [0..1]  # Configuration of IO HW Abstraction.
    container CommonPublishedInformation  # Common container, aggregated by all modules. It contains published information about vendor and versions.
      integer ArMajorVersion: implementation-config-class=PUBLISHED-INFORMATION, origin=AUTOSAR_ECUC V1.0.0  # Major version number of AUTOSAR specification on which the appropriate implementation is based on.
      integer ArMinorVersion: implementation-config-class=PUBLISHED-INFORMATION, origin=AUTOSAR_ECUC V1.0.0  # Minor version number of AUTOSAR specification on which the appropriate implementation is based on.
      integer ArPatchVersion: implementation-config-class=PUBLISHED-INFORMATION, origin=AUTOSAR_ECUC V1.0.0  # Patch level version number of AUTOSAR specification on which the appropriate implementation is based on.
      integer ModuleId: implementation-config-class=PUBLISHED-INFORMATION, origin=AUTOSAR_ECUC V1.0.0  # Module ID of this module from Module List
      integer SwMajorVersion: implementation-config-class=PUBLISHED-INFORMATION, origin=AUTOSAR_ECUC V1.0.0  # Major version number of the vendor specific implementation of the module. The numbering is vendor specific.
      integer SwMinorVersion: implementation-config-class=PUBLISHED-INFORMATION, origin=AUTOSAR_ECUC V1.0.0  # Minor version number of the vendor specific implementation of the module. The numbering is vendor specific.
      integer SwPatchVersion: implementation-config-class=PUBLISHED-INFORMATION, origin=AUTOSAR_ECUC V1.0.0  # Patch level version number of the vendor specific implementation of the module. The numbering is vendor specific.
      string VendorApiInfix [0..1]: implementation-config-class=PUBLISHED-INFORMATION, origin=AUTOSAR_ECUC V1.0.0  # In driver modules which can be instantiated several times on a single ECU, BSW00347 requires that the name of APIs is extended by the VendorId and a vendor specific name. This parameter is used to specify the vendor specific name. In total, the implementation specific name is generated as follows: <ModuleName>_>VendorId>_<VendorApiInfix><Api name from SWS>. E.g. assuming that the VendorId of the implementor is 123 and the implementer chose a VendorApiInfix of "v11r456" a api name Can_Write defined in the SWS will translate to Can_123_v11r456Write. This parameter is mandatory for all modules with upper multiplicity > 1. It shall not be used for modules with upper multiplicity =1.
      integer VendorId: implementation-config-class=PUBLISHED-INFORMATION, origin=AUTOSAR_ECUC V1.0.0  # Vendor ID of the dedicated implementation of this module according to the AUTOSAR vendor list
    container IoHwAbEcuSignalGroup [0..*]  # This container contains the configuration (parameters) of all ECU signals groups implemented in the IO Hardware Abstraction Module
      container IoHwAbDiscSigGrpInput [0..*]  # This container contains the description of a discrete ECU signal group. The container IoHwAb_Discrete_SignalGroup contains several IoHwAb_Class_Discrete_Input sub-containers
        reference def IoHwAbDiscSigGrpInMember: lower-multiplicity=1, upper-multiplicity=*, origin=AUTOSAR_ECUC V1.0.0, destination=IoHwAbDiscreteInput  # Each member of the signal group is referenced by an instance of tthis element. In the IO HW Abstraction SWS, individual signals are aggregated by the signal group instead of referenced, but by using references it is still possible to have the same signal being par of several signal groups, as intended in the SWS.
      container IoHwAbDiscSigGrpOutput [0..*]  # This container contains the description of a discrete ECU signal group. The container IoHwAb_Discrete_SignalGroup contains several IoHwAb_Class_Discrete_Output sub-containers.
        reference def IoHwAbDiscSigGrpOutMember: lower-multiplicity=1, upper-multiplicity=*, origin=AUTOSAR_ECUC V1.0.0, destination=IoHwAbDiscreteOutput  # Each member of the signal group is referenced by an instance of tthis element. In the IO HW Abstraction SWS, individual signals are aggregated by the signal group instead of referenced, but by using references it is still possible to have the same signal being par of several signal groups, as intended in the SWS.
    container IoHwAbEcuSignals [0..*]  # This container contains the configuration (parameters) of all ECU signals implemented in the IO Hardware Abstraction Module. Remarks: - The IO Hardware Abstraction module is an ECU firmware module. That means that the implementation shall fit only to the ECU hardware. The implementer has to develop only the functionality needed (eg: if there is no pulse width ECU signal configurated, the pulse width abstraction will not be available. - At least one ECU signal shall be configurated to have the module.
      container IoHwAbAnalogInput [0..*]  # This container contains the description of an analog ECU signal used as input. The operation available through the Port is a OP_GET.
        boolean IoHwAbAnaInputFilter: origin=AUTOSAR_ECUC V1.0.0  # This parameter specifies if the ECU analog signal is filtered
        boolean IoHwAbAnaInputReport: origin=AUTOSAR_ECUC V1.0.0  # This parameter specifies if the report features is activated
        integer IoHwAbAnaInputSamplingRate: origin=AUTOSAR_ECUC V1.0.0  # This parameter specifies the sampling rate for an analog input
        container IoHwAbAnalog  # This container contains common description of a all ECU signals from class analog.
          integer IoHwAbAnalogBswRange: 0.., origin=AUTOSAR_ECUC V1.0.0  # This parameter gives the BSW Range used for an analog signal, according to the datatype
          string IoHwAbAnalogBswResolution: origin=AUTOSAR_ECUC V1.0.0  # This parameter gives the resolution used for an analog signal
          string IoHwAbAnalogDataType: origin=AUTOSAR_ECUC V1.0.0  # This parameter gives the DataType used for an analog signal
          integer IoHwAbAnalogMaxAge: origin=AUTOSAR_ECUC V1.0.0  # This parameter gives the maximum age of an ECU analog signal
          string IoHwAbAnalogUnit: origin=AUTOSAR_ECUC V1.0.0  # This parameter gives the unit used for an analog signal
      container IoHwAbAnalogOutput [0..*]  # This container contains the description of an analog ECU signal used as output. The operation available through the Port is a OP_SET.
        boolean IoHwAbAnaOutputFailureMoni: origin=AUTOSAR_ECUC V1.0.0  # This parameter specifies if the ECU analog Output is monitored, to detect failure
        boolean IoHwAbAnaOutputPulseTest: origin=AUTOSAR_ECUC V1.0.0  # This parameter specifies if an test pulse is used to detect failure on the ECU analog Output
        container IoHwAbAnalog  # This container contains common description of a all ECU signals from class analog.
          integer IoHwAbAnalogBswRange: 0.., origin=AUTOSAR_ECUC V1.0.0  # This parameter gives the BSW Range used for an analog signal, according to the datatype
          string IoHwAbAnalogBswResolution: origin=AUTOSAR_ECUC V1.0.0  # This parameter gives the resolution used for an analog signal
          string IoHwAbAnalogDataType: origin=AUTOSAR_ECUC V1.0.0  # This parameter gives the DataType used for an analog signal
          integer IoHwAbAnalogMaxAge: origin=AUTOSAR_ECUC V1.0.0  # This parameter gives the maximum age of an ECU analog signal
          string IoHwAbAnalogUnit: origin=AUTOSAR_ECUC V1.0.0  # This parameter gives the unit used for an analog signal
      container IoHwAbDiscreteDiagnosis [0..*]  # This container contains the description of a discrete ECU signal used as diagnosis.
        container IoHwAbDiscrete  # This container contains common description of a all ECU signals from class discrete
          boolean IoHwAbDiscreteBswRange: origin=AUTOSAR_ECUC V1.0.0  # This parameter gives all possible values of an ECU discrete signal
          boolean IoHwAbDiscreteDatatype: origin=AUTOSAR_ECUC V1.0.0  # This parameter gives the DataType used for a discrete signal
          integer IoHwAbDiscreteMaxAge: origin=AUTOSAR_ECUC V1.0.0  # This parameter gives the maximum age of an ECU discrete signal
      container IoHwAbDiscreteInput [0..*]  # This container contains the description of a discrete ECU signal used as input. The operation available through the Port is an OP_GET.
        integer IoHwAbDiscInputDebounce: origin=AUTOSAR_ECUC V1.0.0  # This parameter specifies if the ECU discrete signal is filtered / debounced 0 represents Debouncing deactivated N represents Debouncing activated, N values sampled before value is available
        boolean IoHwAbDiscInputReport: origin=AUTOSAR_ECUC V1.0.0  # This parameter specifies if the report features is activated FALSE represents no report if a significant change occurs TRUE represents repot if a significant change occurs
        boolean IoHwAbDiscInputWakeup: origin=AUTOSAR_ECUC V1.0.0  # This parameter specifies if the ECU pin is a wakeup input TRUE represents a wakeup Input. During sleep mode, a change is reported to the module. In case of a valid reason, the ECU state manager will be restarted to validate the wakeup. FALSE represents a simple discrete Input.
        container IoHwAbDiscrete  # This container contains common description of a all ECU signals from class discrete
          boolean IoHwAbDiscreteBswRange: origin=AUTOSAR_ECUC V1.0.0  # This parameter gives all possible values of an ECU discrete signal
          boolean IoHwAbDiscreteDatatype: origin=AUTOSAR_ECUC V1.0.0  # This parameter gives the DataType used for a discrete signal
          integer IoHwAbDiscreteMaxAge: origin=AUTOSAR_ECUC V1.0.0  # This parameter gives the maximum age of an ECU discrete signal
      container IoHwAbDiscreteOutput [0..*]  # This container contains the description of a discrete ECU signal used as Output. The operation available through the Port is a OP_SET.
        boolean IoHwAbDiscOutputFailureMoni: origin=AUTOSAR_ECUC V1.0.0  # This parameter specifies if the ECU discrete Output is monitored, to detect failure TRUE represents that the ECU Signal is a monitored Output. Failures on this Output are detected and managed by the module FALSE represents that the ECU Signal is a simple discrete Output.
        boolean IoHwAbDiscOutputPulseTest: origin=AUTOSAR_ECUC V1.0.0  # This parameter specifies if an test pulse is used to detect failure on the ECU discrete Output TRUE represents that a Test Pulse is used for failure monitoring FALSE represents that no Test Pulse is used for failure monitoring
        container IoHwAbDiscrete  # This container contains common description of a all ECU signals from class discrete
          boolean IoHwAbDiscreteBswRange: origin=AUTOSAR_ECUC V1.0.0  # This parameter gives all possible values of an ECU discrete signal
          boolean IoHwAbDiscreteDatatype: origin=AUTOSAR_ECUC V1.0.0  # This parameter gives the DataType used for a discrete signal
          integer IoHwAbDiscreteMaxAge: origin=AUTOSAR_ECUC V1.0.0  # This parameter gives the maximum age of an ECU discrete signal
      container IoHwAbPwDutyCycleInput [0..*]  # This container contains specific description for an input ECU signal from class pulse width, handling especially the characteristic DutyCycle The operation available through the Port is a OP_GET
        boolean IoHwAbPwdcInputWakeup: origin=AUTOSAR_ECUC V1.0.0  # This parameter specifies if the ECU pin is a wakeup input
        container IoHwAbPwDutyCycle  # This container contains common description of a all ECU signals from class pulse width, handling especially the characteristic duty cycle
          integer IoHwAbPwdcBswRange: 0..100, origin=AUTOSAR_ECUC V1.0.0  # This parameter gives the BSW Range for a pulse width signal
          string IoHwAbPwdcUnit: origin=AUTOSAR_ECUC V1.0.0  # This parameter gives the unit for an ECU signal, handling especially the characteristic period
          container IoHwAbPulseWidth  # This container contains common description of a all ECU signals from class pulse width
            integer IoHwAbPwBswResolution: origin=AUTOSAR_ECUC V1.0.0  # This parameter gives the resolution used for a pulse width ECU signal
            string IoHwAbPwDatatype: origin=AUTOSAR_ECUC V1.0.0  # This parameter gives the DataType used for a pulse width signal
            integer IoHwAbPwMaxAge: origin=AUTOSAR_ECUC V1.0.0  # This parameter gives the maximum age for a pulse width ECU signal
      container IoHwAbPwDutyCycleOutput [0..*]  # This container contains specific description for an output ECU signal from class pulse width, handling especially the characteristic DutyCycle. The operation available through the Port is a OP_SET.
        boolean IoHwAbPwdcOutputFailureMoni: origin=AUTOSAR_ECUC V1.0.0  # This parameter specifies if the ECU Output is monitored, to detect failure
        boolean IoHwAbPwdcOutputPulseTest: origin=AUTOSAR_ECUC V1.0.0  # This parameter specifies if an test pulse is used to detect failure on the ECU Output
        container IoHwAbPwDutyCycle  # This container contains common description of a all ECU signals from class pulse width, handling especially the characteristic duty cycle
          integer IoHwAbPwdcBswRange: 0..100, origin=AUTOSAR_ECUC V1.0.0  # This parameter gives the BSW Range for a pulse width signal
          string IoHwAbPwdcUnit: origin=AUTOSAR_ECUC V1.0.0  # This parameter gives the unit for an ECU signal, handling especially the characteristic period
          container IoHwAbPulseWidth  # This container contains common description of a all ECU signals from class pulse width
            integer IoHwAbPwBswResolution: origin=AUTOSAR_ECUC V1.0.0  # This parameter gives the resolution used for a pulse width ECU signal
            string IoHwAbPwDatatype: origin=AUTOSAR_ECUC V1.0.0  # This parameter gives the DataType used for a pulse width signal
            integer IoHwAbPwMaxAge: origin=AUTOSAR_ECUC V1.0.0  # This parameter gives the maximum age for a pulse width ECU signal
      container IoHwAbPwPeriodInput [0..*]  # This container contains specific description for an input ECU signal from class pulse width, handling especially the characteristic period
        boolean IoHwAbPwpInputWakeup: origin=AUTOSAR_ECUC V1.0.0  # This parameter specifies if the ECU pin is a wakeup input
        container IoHwAbPwPeriod  # This container contains common description of a all ECU signals from class pulse width, handling especially the characteristic period
          integer IoHwAbPwpBswRange: -100..100, origin=AUTOSAR_ECUC V1.0.0  # This parameter gives the BSW Range for a pulse width signal (in percent)
          string IoHwAbPwpUnit: origin=AUTOSAR_ECUC V1.0.0  # This parameter gives the unit for an ECU signal, handling especially the characteristic period
          container IoHwAbPulseWidth  # This container contains common description of a all ECU signals from class pulse width
            integer IoHwAbPwBswResolution: origin=AUTOSAR_ECUC V1.0.0  # This parameter gives the resolution used for a pulse width ECU signal
            string IoHwAbPwDatatype: origin=AUTOSAR_ECUC V1.0.0  # This parameter gives the DataType used for a pulse width signal
            integer IoHwAbPwMaxAge: origin=AUTOSAR_ECUC V1.0.0  # This parameter gives the maximum age for a pulse width ECU signal
      container IoHwAbPwPeriodOutput [0..*]  # This container contains specific description for an output ECU signal from class pulse width, handling especially the characteristic period The operation available through the Port is a OP_SET.
        boolean IoHwAbPwpOutputFailureMoni: origin=AUTOSAR_ECUC V1.0.0  # This parameter specifies if the ECU Output is monitored, to detect failure
        boolean IoHwAbPwpOutputPulseTest: origin=AUTOSAR_ECUC V1.0.0  # This parameter specifies if an test pulse is used to detect failure on the ECU Output
        container IoHwAbPwPeriod  # This container contains common description of a all ECU signals from class pulse width, handling especially the characteristic period
          integer IoHwAbPwpBswRange: -100..100, origin=AUTOSAR_ECUC V1.0.0  # This parameter gives the BSW Range for a pulse width signal (in percent)
          string IoHwAbPwpUnit: origin=AUTOSAR_ECUC V1.0.0  # This parameter gives the unit for an ECU signal, handling especially the characteristic period
          container IoHwAbPulseWidth  # This container contains common description of a all ECU signals from class pulse width
            integer IoHwAbPwBswResolution: origin=AUTOSAR_ECUC V1.0.0  # This parameter gives the resolution used for a pulse width ECU signal
            string IoHwAbPwDatatype: origin=AUTOSAR_ECUC V1.0.0  # This parameter gives the DataType used for a pulse width signal
            integer IoHwAbPwMaxAge: origin=AUTOSAR_ECUC V1.0.0  # This parameter gives the maximum age for a pulse width ECU signal
    container IoHwAbGeneral  # This container contains common description for the IO Hardware Abstraction module
      boolean IoHwAbDevErrorDetect: origin=AUTOSAR_ECUC V1.0.0  # Switches the Development Error Detection and Notification ON or OFF
      boolean IoHwAbVersionInfoApi: origin=AUTOSAR_ECUC V1.0.0  # Pre-processor switch to enable / disable the API to read out the modules version information.
  module definition Lin [0..*]  # Configuration of the Lin (LIN driver) module.
    container CommonPublishedInformation  # Common container, aggregated by all modules. It contains published information about vendor and versions.
      integer ArMajorVersion: implementation-config-class=PUBLISHED-INFORMATION, origin=AUTOSAR_ECUC V1.0.0  # Major version number of AUTOSAR specification on which the appropriate implementation is based on.
      integer ArMinorVersion: implementation-config-class=PUBLISHED-INFORMATION, origin=AUTOSAR_ECUC V1.0.0  # Minor version number of AUTOSAR specification on which the appropriate implementation is based on.
      integer ArPatchVersion: implementation-config-class=PUBLISHED-INFORMATION, origin=AUTOSAR_ECUC V1.0.0  # Patch level version number of AUTOSAR specification on which the appropriate implementation is based on.
      integer ModuleId: implementation-config-class=PUBLISHED-INFORMATION, origin=AUTOSAR_ECUC V1.0.0  # Module ID of this module from Module List
      integer SwMajorVersion: implementation-config-class=PUBLISHED-INFORMATION, origin=AUTOSAR_ECUC V1.0.0  # Major version number of the vendor specific implementation of the module. The numbering is vendor specific.
      integer SwMinorVersion: implementation-config-class=PUBLISHED-INFORMATION, origin=AUTOSAR_ECUC V1.0.0  # Minor version number of the vendor specific implementation of the module. The numbering is vendor specific.
      integer SwPatchVersion: implementation-config-class=PUBLISHED-INFORMATION, origin=AUTOSAR_ECUC V1.0.0  # Patch level version number of the vendor specific implementation of the module. The numbering is vendor specific.
      string VendorApiInfix [0..1]: implementation-config-class=PUBLISHED-INFORMATION, origin=AUTOSAR_ECUC V1.0.0  # In driver modules which can be instantiated several times on a single ECU, BSW00347 requires that the name of APIs is extended by the VendorId and a vendor specific name. This parameter is used to specify the vendor specific name. In total, the implementation specific name is generated as follows: <ModuleName>_>VendorId>_<VendorApiInfix><Api name from SWS>. E.g. assuming that the VendorId of the implementor is 123 and the implementer chose a VendorApiInfix of "v11r456" a api name Can_Write defined in the SWS will translate to Can_123_v11r456Write. This parameter is mandatory for all modules with upper multiplicity > 1. It shall not be used for modules with upper multiplicity =1.
      integer VendorId: implementation-config-class=PUBLISHED-INFORMATION, origin=AUTOSAR_ECUC V1.0.0  # Vendor ID of the dedicated implementation of this module according to the AUTOSAR vendor list
    container LinGeneral
      boolean LinDevErrorDetect: origin=AUTOSAR_ECUC V1.0.0  # Switches the Development Error Detection and Notification ON or OFF.
      integer LinTimeoutDuration: origin=AUTOSAR_ECUC V1.0.0  # Specifies the maximum number of loops for blocking function until a timeout is raised in short term wait loops
      boolean LinVersionInfoApi: origin=AUTOSAR_ECUC V1.0.0  # Switches the Lin_GetVersionInfo function ON or OFF.
    container LinGlobalConfig  # This container contains the global configuration parameter of the Lin driver. This container is a MultipleConfigurationContainer, i.e. this container and its sub-containers exit once per configuration set.
      container LinChannel [1..*]  # This container contains teh configuration (parameters) of the LIN Controller(s).
        boolean LinChannelActivation: origin=AUTOSAR_ECUC V1.0.0  # Defines if a LIN channel is used in the configuration.
        integer LinChannelBaudRate: 1000..20000, origin=AUTOSAR_ECUC V1.0.0  # Specifies the baud rate of the LIN channel
        integer LinChannelId: origin=AUTOSAR_ECUC V1.0.0, symbolic-name-value=true  # Identifies the LIN channel. Replaces LIN_CHANNEL_INDEX_NAME from the LIN SWS.
        boolean LinChannelWakeUpSupport: origin=AUTOSAR_ECUC V1.0.0  # Specifies if the LIN hardware channel supports wake up functionality
        reference def LinClockRef: lower-multiplicity=1, upper-multiplicity=1, origin=AUTOSAR_ECUC V1.0.0, destination=McuClockReferencePoint  # Reference to the LIN clock source configuration, which is set in the MCU driver configuration.
  module definition LinIf [0..1]  # Configuration of the LinIf (LIN Interface) module.
    container CommonPublishedInformation  # Common container, aggregated by all modules. It contains published information about vendor and versions.
      integer ArMajorVersion: implementation-config-class=PUBLISHED-INFORMATION, origin=AUTOSAR_ECUC V1.0.0  # Major version number of AUTOSAR specification on which the appropriate implementation is based on.
      integer ArMinorVersion: implementation-config-class=PUBLISHED-INFORMATION, origin=AUTOSAR_ECUC V1.0.0  # Minor version number of AUTOSAR specification on which the appropriate implementation is based on.
      integer ArPatchVersion: implementation-config-class=PUBLISHED-INFORMATION, origin=AUTOSAR_ECUC V1.0.0  # Patch level version number of AUTOSAR specification on which the appropriate implementation is based on.
      integer ModuleId: implementation-config-class=PUBLISHED-INFORMATION, origin=AUTOSAR_ECUC V1.0.0  # Module ID of this module from Module List
      integer SwMajorVersion: implementation-config-class=PUBLISHED-INFORMATION, origin=AUTOSAR_ECUC V1.0.0  # Major version number of the vendor specific implementation of the module. The numbering is vendor specific.
      integer SwMinorVersion: implementation-config-class=PUBLISHED-INFORMATION, origin=AUTOSAR_ECUC V1.0.0  # Minor version number of the vendor specific implementation of the module. The numbering is vendor specific.
      integer SwPatchVersion: implementation-config-class=PUBLISHED-INFORMATION, origin=AUTOSAR_ECUC V1.0.0  # Patch level version number of the vendor specific implementation of the module. The numbering is vendor specific.
      string VendorApiInfix [0..1]: implementation-config-class=PUBLISHED-INFORMATION, origin=AUTOSAR_ECUC V1.0.0  # In driver modules which can be instantiated several times on a single ECU, BSW00347 requires that the name of APIs is extended by the VendorId and a vendor specific name. This parameter is used to specify the vendor specific name. In total, the implementation specific name is generated as follows: <ModuleName>_>VendorId>_<VendorApiInfix><Api name from SWS>. E.g. assuming that the VendorId of the implementor is 123 and the implementer chose a VendorApiInfix of "v11r456" a api name Can_Write defined in the SWS will translate to Can_123_v11r456Write. This parameter is mandatory for all modules with upper multiplicity > 1. It shall not be used for modules with upper multiplicity =1.
      integer VendorId: implementation-config-class=PUBLISHED-INFORMATION, origin=AUTOSAR_ECUC V1.0.0  # Vendor ID of the dedicated implementation of this module according to the AUTOSAR vendor list
    container LinIfGeneral
      boolean LinIfDevErrorDetect: origin=AUTOSAR_ECUC V1.0.0  # Switches the Development Error Detection and Notification ON or OFF.
      boolean LinIfMultipleDriversSupported: origin=AUTOSAR_ECUC V1.0.0  # States if multiple drivers are included in the LIN Interface or not. The reason for this parameter is to reduce the size of LIN Interface if multiple drivers are not used.
      boolean LinIfNcOptionalRequestSupported: origin=AUTOSAR_ECUC V1.0.0  # States if the node configuration commands Assign NAD and Conditional Change NAD are supported.
      boolean LinIfTpSupported: origin=AUTOSAR_ECUC V1.0.0  # States if the TP is included in the LIN Interface or not. The reason for this parameter is to reduce the size of LIN Interface if the TP is not used.
      boolean LinIfVersionInfoApi: origin=AUTOSAR_ECUC V1.0.0  # Switches the LinIf_GetVersionInfo function ON or OFF.
    container LinIfGlobalConfig  # This container contains the global configuration parameter of the LinIf. It is a MultipleConfigurationContainer, i.e. this container and its sub-containers exit once per configuration set.
      container LinIfChannel [1..*]
        integer LinIfBitrate: 1000..20000, origin=AUTOSAR_ECUC V1.0.0  # Bitrate of the channel. This parameter is needed to calculate the delays in the schedule tables.
        integer LinIfChannelId: origin=AUTOSAR_ECUC V1.0.0, symbolic-name-value=true  # Internal ID for the channel on LIN Interface level
        integer LinIfScheduleRequestQueueLength: 1..255, origin=AUTOSAR_ECUC V1.0.0  # Number of schedule requests the schedule table manager can handle for this channel.
        float LinIfTimeBase: origin=AUTOSAR_ECUC V1.0.0  # The time-base for this channel in [s]. (Usually 0.002, 0.005 or 0.010 s)
        enumeration LinIfWakeupSource: {ECUM_WKSOURCE_ALL_SOURCES, ECUM_WKSOURCE_EXTERNAL_WDG, ECUM_WKSOURCE_INTERNAL_RESET, ECUM_WKSOURCE_INTERNAL_WDG, ECUM_WKSOURCE_POWER, ECUM_WKSOURCE_RESET}, origin=AUTOSAR_ECUC V1.0.0  # Bit-field with one unique bit set for each channel. This is used when indicating a wakeup to the ECU State Manager. Open discussion: how to model wakeup sources?
        symbolic name reference LinIfChannelRef: origin=AUTOSAR_ECUC V1.0.0, destination=LinChannel  # Reference to the used channel in Lin. Replaces LINIF_CHANNEL_INDEX
        container LinIfFrame [0..*]  # Generic container for all types of LIN frames.
          enumeration LinIfChecksumType: {Classic, Enhanced}, origin=AUTOSAR_ECUC V1.0.0  # Type of checksum that the frame is using.
          integer LinIfFixedFrameSdu [0..1]: origin=AUTOSAR_ECUC V1.0.0  # In case this is a fixed frame this is the SDU (response). This value should represent an eight byte array.
          enumeration LinIfFrameType: {Assign, AssignNAD, Conditional, EventTriggered, Free, MRF, SRF, Sporadic, Unassign, Unconditional}, origin=AUTOSAR_ECUC V1.0.0  # Type of frame that is described (e.g. sporadic frame). Note that types 7-11 are the fixed MRF types. The sporadic slot is not found among the frame types. A sporadic slot is a set of sporadic frames.
          integer LinIfLength: 1..8, origin=AUTOSAR_ECUC V1.0.0  # Length of the LIN SDU in bytes.
          integer LinIfPid: 0.., origin=AUTOSAR_ECUC V1.0.0  # Protected ID of the LIN frame. There is no reason to calculate the Parity in run-time.
          choice container LinIfPduDirection  # Direction of the frame
            container LinIfRxPdu [0..1]  # represents a received PDU/frame
              reference def LinIfRxPduRef: lower-multiplicity=1, upper-multiplicity=1, origin=AUTOSAR_ECUC V1.0.0, destination=Pdu  # Reference to the PDU that is received in this frame.
            container LinIfSlaveToSlavePdu [0..1]  # represents a slave-to-slave PDU/frame. Master does only send the header but doesn't receive the response. Added for completeness
            container LinIfTxPdu [0..1]  # represents a transmitted PDU/frame
              integer LinIfTxPduId: origin=AUTOSAR_ECUC V1.0.0, symbolic-name-value=true  # Identifier of the frame for the upper layer. This id is only relevant for sporadic frames.
              reference def LinIfTxPduRef: lower-multiplicity=1, upper-multiplicity=1, origin=AUTOSAR_ECUC V1.0.0, destination=Pdu  # Reference to the PDU that is transmitted in this frame.
        container LinIfScheduleTable [1..*]  # Describes a schedule table. Each LinIfChannel may have several schedule tables.
          integer LinIfPriority: 0..255, origin=AUTOSAR_ECUC V1.0.0  # Priority of the schedule table. The priority is used in the schedule table manager. The RUN_ONCE run mode schedules shall not have equal priority. Priority 0 is reserved for the NULL_SCHEDULE. Priority 255 is reserved for the RUN_CONTINUOUS run mode.
          enumeration LinIfRunMode: {RUN_CONTINUOUS, RUN_ONCE}, origin=AUTOSAR_ECUC V1.0.0  # The schedule table can be executed in two different modes.
          integer LinIfScheduleTableIndex: origin=AUTOSAR_ECUC V1.0.0, symbolic-name-value=true  # This is the unique index used by upper layers to identify a schedule. Note that the NULL_SCHEDULE for each channel has index 0.
          container LinIfEntry [0..*]  # Describes an entry in the schedule table (also known as Frame Slot).
            float LinIfDelay: 0.., origin=AUTOSAR_ECUC V1.0.0  # Delay to next frame in schedule table in [s]
            reference def LinIfFrameRef: lower-multiplicity=1, upper-multiplicity=*, origin=AUTOSAR_ECUC V1.0.0, destination=LinIfFrame  # Reference to the frames that belong to this schedule table entry.
  module definition LinTp [0..1]  # Singleton descriptor for the LIN Transport Protocol.
    container CommonPublishedInformation  # Common container, aggregated by all modules. It contains published information about vendor and versions.
      integer ArMajorVersion: implementation-config-class=PUBLISHED-INFORMATION, origin=AUTOSAR_ECUC V1.0.0  # Major version number of AUTOSAR specification on which the appropriate implementation is based on.
      integer ArMinorVersion: implementation-config-class=PUBLISHED-INFORMATION, origin=AUTOSAR_ECUC V1.0.0  # Minor version number of AUTOSAR specification on which the appropriate implementation is based on.
      integer ArPatchVersion: implementation-config-class=PUBLISHED-INFORMATION, origin=AUTOSAR_ECUC V1.0.0  # Patch level version number of AUTOSAR specification on which the appropriate implementation is based on.
      integer ModuleId: implementation-config-class=PUBLISHED-INFORMATION, origin=AUTOSAR_ECUC V1.0.0  # Module ID of this module from Module List
      integer SwMajorVersion: implementation-config-class=PUBLISHED-INFORMATION, origin=AUTOSAR_ECUC V1.0.0  # Major version number of the vendor specific implementation of the module. The numbering is vendor specific.
      integer SwMinorVersion: implementation-config-class=PUBLISHED-INFORMATION, origin=AUTOSAR_ECUC V1.0.0  # Minor version number of the vendor specific implementation of the module. The numbering is vendor specific.
      integer SwPatchVersion: implementation-config-class=PUBLISHED-INFORMATION, origin=AUTOSAR_ECUC V1.0.0  # Patch level version number of the vendor specific implementation of the module. The numbering is vendor specific.
      string VendorApiInfix [0..1]: implementation-config-class=PUBLISHED-INFORMATION, origin=AUTOSAR_ECUC V1.0.0  # In driver modules which can be instantiated several times on a single ECU, BSW00347 requires that the name of APIs is extended by the VendorId and a vendor specific name. This parameter is used to specify the vendor specific name. In total, the implementation specific name is generated as follows: <ModuleName>_>VendorId>_<VendorApiInfix><Api name from SWS>. E.g. assuming that the VendorId of the implementor is 123 and the implementer chose a VendorApiInfix of "v11r456" a api name Can_Write defined in the SWS will translate to Can_123_v11r456Write. This parameter is mandatory for all modules with upper multiplicity > 1. It shall not be used for modules with upper multiplicity =1.
      integer VendorId: implementation-config-class=PUBLISHED-INFORMATION, origin=AUTOSAR_ECUC V1.0.0  # Vendor ID of the dedicated implementation of this module according to the AUTOSAR vendor list
    container LinTpGeneral  # Container that holds all LIN transport protocol general parameters.
      boolean LinTpVersionInfoApi: origin=AUTOSAR_ECUC V1.0.0  # Switches the LinTp_GetVersionInfo function ON or OFF.
    container LinTpGlobalConfig  # This container contains the global configuration parameter of the LinTp. It is a MultipleConfigurationContainer, i.e. this container and its sub-containers exit once per configuration set.
      integer LinTpNumberOfRxNSdu: origin=AUTOSAR_ECUC V1.0.0  # Number of transport protocol messages that can be received for all channels this node is connected to. Can't that be calculated from the NSdus?
      integer LinTpNumberOfTxNSdu: origin=AUTOSAR_ECUC V1.0.0  # Number of transport protocol messages that can be transmitted for all channels this node is connected to.
      container LinTpRxNSdu [0..*]  # For each received N-SDU on any channel the node is connected to.
        integer LinTpDl: origin=AUTOSAR_ECUC V1.0.0  # Data Length Code of this RxNsdu. In case of variable length message, this value indicates the minimum data length. Range of minimum length is 1 to 4095. Note that this is not relevant for Tx. The reason for this is to have identical structures for Tx and Rx.
        integer LinTpRxNSduNad: origin=AUTOSAR_ECUC V1.0.0  # A N-SDU transported on LIN is identified using the NAD for the specific slave.
        reference def LinTpRxNSduPduRef: lower-multiplicity=1, upper-multiplicity=1, origin=AUTOSAR_ECUC V1.0.0, destination=Pdu  # Reference to the global PDU
        symbolic name reference LinTpRxNSduChannelRef: origin=AUTOSAR_ECUC V1.0.0, destination=LinIfChannel  # Index of the channel this N-SDU belongs to.
      container LinTpTxNSdu [0..*]  # For each transmitted N-SDU on any channel the node is connected to.
        integer LinTpTxNSduId: origin=AUTOSAR_ECUC V1.0.0, symbolic-name-value=true  # The identifier of the Transport Protocol message. This ID will be the one that is communicated with upper layers.
        integer LinTpTxNSduNad: origin=AUTOSAR_ECUC V1.0.0  # A N-SDU transported on LIN is identified using the NAD for the specific slave.
        reference def LinTpTxNSduPduRef: lower-multiplicity=1, upper-multiplicity=1, origin=AUTOSAR_ECUC V1.0.0, destination=Pdu  # Reference to the global PDU
        symbolic name reference LinTpTxNSduChannelRef: origin=AUTOSAR_ECUC V1.0.0, destination=LinIfChannel  # Index of the channel this N-SDU belongs to.
  module definition Mcu [0..1]  # Configuration of the Mcu (Microcontroler Unit) module.
    container CommonPublishedInformation  # Common container, aggregated by all modules. It contains published information about vendor and versions.
      integer ArMajorVersion: implementation-config-class=PUBLISHED-INFORMATION, origin=AUTOSAR_ECUC V1.0.0  # Major version number of AUTOSAR specification on which the appropriate implementation is based on.
      integer ArMinorVersion: implementation-config-class=PUBLISHED-INFORMATION, origin=AUTOSAR_ECUC V1.0.0  # Minor version number of AUTOSAR specification on which the appropriate implementation is based on.
      integer ArPatchVersion: implementation-config-class=PUBLISHED-INFORMATION, origin=AUTOSAR_ECUC V1.0.0  # Patch level version number of AUTOSAR specification on which the appropriate implementation is based on.
      integer ModuleId: implementation-config-class=PUBLISHED-INFORMATION, origin=AUTOSAR_ECUC V1.0.0  # Module ID of this module from Module List
      integer SwMajorVersion: implementation-config-class=PUBLISHED-INFORMATION, origin=AUTOSAR_ECUC V1.0.0  # Major version number of the vendor specific implementation of the module. The numbering is vendor specific.
      integer SwMinorVersion: implementation-config-class=PUBLISHED-INFORMATION, origin=AUTOSAR_ECUC V1.0.0  # Minor version number of the vendor specific implementation of the module. The numbering is vendor specific.
      integer SwPatchVersion: implementation-config-class=PUBLISHED-INFORMATION, origin=AUTOSAR_ECUC V1.0.0  # Patch level version number of the vendor specific implementation of the module. The numbering is vendor specific.
      string VendorApiInfix [0..1]: implementation-config-class=PUBLISHED-INFORMATION, origin=AUTOSAR_ECUC V1.0.0  # In driver modules which can be instantiated several times on a single ECU, BSW00347 requires that the name of APIs is extended by the VendorId and a vendor specific name. This parameter is used to specify the vendor specific name. In total, the implementation specific name is generated as follows: <ModuleName>_>VendorId>_<VendorApiInfix><Api name from SWS>. E.g. assuming that the VendorId of the implementor is 123 and the implementer chose a VendorApiInfix of "v11r456" a api name Can_Write defined in the SWS will translate to Can_123_v11r456Write. This parameter is mandatory for all modules with upper multiplicity > 1. It shall not be used for modules with upper multiplicity =1.
      integer VendorId: implementation-config-class=PUBLISHED-INFORMATION, origin=AUTOSAR_ECUC V1.0.0  # Vendor ID of the dedicated implementation of this module according to the AUTOSAR vendor list
    container McuGeneralConfiguration  # This container contains the configuration (parameters) of the MCU driver.
      boolean McuDevErrorDetect: origin=AUTOSAR_ECUC V1.0.0  # Pre-processor switch for enabling the development error detection and reporting.
      boolean McuPerformResetApi: origin=AUTOSAR_ECUC V1.1.0  # TRUE: Mcu_PerformReset() API is used FALSE: Mcu_PerformReset() API is not used
      boolean McuReportWakeupReason: origin=AUTOSAR_ECUC V1.0.0  # Pre-processor switch for enabling Wake-up reason notification.
      boolean McuVersionInfoApi: origin=AUTOSAR_ECUC V1.0.0  # Pre-processor switch to enable / disable the API to read out the modules version information.
    container McuModuleConfiguration  # This container contains the configuration (parameters) of the MCU driver
      enumeration McuClockSrcFailureNotification: origin=AUTOSAR_ECUC V1.0.0  # Enables/Disables clock failure notification
      derived integer McuRamSectors: origin=AUTOSAR_ECUC V1.0.0  # This parameter shall represent the number of RAM sectors available for the MCU. calculationFormula = Number of configured McuRamSectorSettingConf
      integer McuResetSetting: origin=AUTOSAR_ECUC V1.0.0  # This parameter relates to the MCU specific reset configuration. This applies to the function Mcu_PerformReset, which performs a microcontroller reset using the hardware feature of the microcontroller.
      symbolic name reference McuWakeupReasonRef: origin=AUTOSAR_ECUC V1.0.0, destination=EcuMWakeupSourceConfig
      container McuClockSettingConfig  # This container contains the configuration (parameters) for the Clock settings of the MCU. Please see MCU031 for more information on the MCU clock settings.
        container McuClockReferencePoint [1..*]  # This container defines a reference point in the Mcu Clock tree. It defines the frequency which then can be used by other modules as an input value. Lower multiplictiy is 1, as even in the simpliest case (only one frequency is used), there is one frequency to be defined.
          float McuClockReferencePointFrequency: origin=AUTOSAR_ECUC V1.1.0  # This is the frequency for the specific instance of the McuClockReferencePoint container. It shall be givn in Hz.
      container McuModeSettingConf [1..*]
        integer McuMode: origin=AUTOSAR_ECUC V1.1.0  # The parameter is to represent the different MCU Modes available to an MCU
      container McuRamSectorSettingConf [1..*]
        integer McuRamDefaultValue: origin=AUTOSAR_ECUC V1.0.0  # This parameter shall represent the Data pre-setting to be initialized
        integer McuRamSectionBaseAddress: origin=AUTOSAR_ECUC V1.0.0  # This parameter shall represent the MCU RAM section base address
        integer McuRamSectionSize: origin=AUTOSAR_ECUC V1.0.0  # This parameter shall represent the MCU RAM Section size
  module definition MemIf [0..1]  # Configuration of the MemIf (Memory Abstraction Interface) module.
    container CommonPublishedInformation  # Common container, aggregated by all modules. It contains published information about vendor and versions.
      integer ArMajorVersion: implementation-config-class=PUBLISHED-INFORMATION, origin=AUTOSAR_ECUC V1.0.0  # Major version number of AUTOSAR specification on which the appropriate implementation is based on.
      integer ArMinorVersion: implementation-config-class=PUBLISHED-INFORMATION, origin=AUTOSAR_ECUC V1.0.0  # Minor version number of AUTOSAR specification on which the appropriate implementation is based on.
      integer ArPatchVersion: implementation-config-class=PUBLISHED-INFORMATION, origin=AUTOSAR_ECUC V1.0.0  # Patch level version number of AUTOSAR specification on which the appropriate implementation is based on.
      integer ModuleId: implementation-config-class=PUBLISHED-INFORMATION, origin=AUTOSAR_ECUC V1.0.0  # Module ID of this module from Module List
      integer SwMajorVersion: implementation-config-class=PUBLISHED-INFORMATION, origin=AUTOSAR_ECUC V1.0.0  # Major version number of the vendor specific implementation of the module. The numbering is vendor specific.
      integer SwMinorVersion: implementation-config-class=PUBLISHED-INFORMATION, origin=AUTOSAR_ECUC V1.0.0  # Minor version number of the vendor specific implementation of the module. The numbering is vendor specific.
      integer SwPatchVersion: implementation-config-class=PUBLISHED-INFORMATION, origin=AUTOSAR_ECUC V1.0.0  # Patch level version number of the vendor specific implementation of the module. The numbering is vendor specific.
      string VendorApiInfix [0..1]: implementation-config-class=PUBLISHED-INFORMATION, origin=AUTOSAR_ECUC V1.0.0  # In driver modules which can be instantiated several times on a single ECU, BSW00347 requires that the name of APIs is extended by the VendorId and a vendor specific name. This parameter is used to specify the vendor specific name. In total, the implementation specific name is generated as follows: <ModuleName>_>VendorId>_<VendorApiInfix><Api name from SWS>. E.g. assuming that the VendorId of the implementor is 123 and the implementer chose a VendorApiInfix of "v11r456" a api name Can_Write defined in the SWS will translate to Can_123_v11r456Write. This parameter is mandatory for all modules with upper multiplicity > 1. It shall not be used for modules with upper multiplicity =1.
      integer VendorId: implementation-config-class=PUBLISHED-INFORMATION, origin=AUTOSAR_ECUC V1.0.0  # Vendor ID of the dedicated implementation of this module according to the AUTOSAR vendor list
    container MemIfGeneral  # Container for general configuration parameters of the module which are always pre-compile.
      boolean MemIfDevErrorDetect: origin=AUTOSAR_ECUC V1.0.0  # Pre-processor switch to enable or disable development error detection.
      derived integer MemIfNumberOfDevices: 1..255, origin=AUTOSAR_ECUC V1.0.0  # Actual number of underlying memory memory abstraction modules.
      boolean MemIfVersionInfoApi: origin=AUTOSAR_ECUC V1.0.0  # Pre-processor switch to enable or disable the API to read out the modules version information.
  module definition Nm [0..1]  # The Nm Interface module
    container CommonPublishedInformation  # Common container, aggregated by all modules. It contains published information about vendor and versions.
      integer ArMajorVersion: implementation-config-class=PUBLISHED-INFORMATION, origin=AUTOSAR_ECUC V1.0.0  # Major version number of AUTOSAR specification on which the appropriate implementation is based on.
      integer ArMinorVersion: implementation-config-class=PUBLISHED-INFORMATION, origin=AUTOSAR_ECUC V1.0.0  # Minor version number of AUTOSAR specification on which the appropriate implementation is based on.
      integer ArPatchVersion: implementation-config-class=PUBLISHED-INFORMATION, origin=AUTOSAR_ECUC V1.0.0  # Patch level version number of AUTOSAR specification on which the appropriate implementation is based on.
      integer ModuleId: implementation-config-class=PUBLISHED-INFORMATION, origin=AUTOSAR_ECUC V1.0.0  # Module ID of this module from Module List
      integer SwMajorVersion: implementation-config-class=PUBLISHED-INFORMATION, origin=AUTOSAR_ECUC V1.0.0  # Major version number of the vendor specific implementation of the module. The numbering is vendor specific.
      integer SwMinorVersion: implementation-config-class=PUBLISHED-INFORMATION, origin=AUTOSAR_ECUC V1.0.0  # Minor version number of the vendor specific implementation of the module. The numbering is vendor specific.
      integer SwPatchVersion: implementation-config-class=PUBLISHED-INFORMATION, origin=AUTOSAR_ECUC V1.0.0  # Patch level version number of the vendor specific implementation of the module. The numbering is vendor specific.
      string VendorApiInfix [0..1]: implementation-config-class=PUBLISHED-INFORMATION, origin=AUTOSAR_ECUC V1.0.0  # In driver modules which can be instantiated several times on a single ECU, BSW00347 requires that the name of APIs is extended by the VendorId and a vendor specific name. This parameter is used to specify the vendor specific name. In total, the implementation specific name is generated as follows: <ModuleName>_>VendorId>_<VendorApiInfix><Api name from SWS>. E.g. assuming that the VendorId of the implementor is 123 and the implementer chose a VendorApiInfix of "v11r456" a api name Can_Write defined in the SWS will translate to Can_123_v11r456Write. This parameter is mandatory for all modules with upper multiplicity > 1. It shall not be used for modules with upper multiplicity =1.
      integer VendorId: implementation-config-class=PUBLISHED-INFORMATION, origin=AUTOSAR_ECUC V1.0.0  # Vendor ID of the dedicated implementation of this module according to the AUTOSAR vendor list
    container NmGlobalConfig  # This container contains all global configuration parameters of the Nm Interface.
      boolean NmBusSynchronizationEnabled: origin=AUTOSAR_ECUC V1.1.0  # This feature is required for gateway nodes only.
      boolean NmComControlEnabled: origin=AUTOSAR_ECUC V1.1.0  # Pre-processor switch for enabling the Communication Control support.
      boolean NmNodeDetectionEnabled: origin=AUTOSAR_ECUC V1.1.0  # Pre-processor switch for enabling the Request Repeat Message Request support.
      boolean NmNodeIdEnabled: origin=AUTOSAR_ECUC V1.1.0  # Pre-processor switch for enabling the source node identifier.
      integer NmNumberOfChannels: 1..255, origin=AUTOSAR_ECUC V1.1.0  # Number of NM channels allowed within one ECU.
      boolean NmPassiveModeEnabled: origin=AUTOSAR_ECUC V1.1.0  # Pre-processor switch for enabling support of the Passive Mode.
      boolean NmPduRxIndicationEnabled: origin=AUTOSAR_ECUC V1.1.0  # Pre-processor switch for enabling the PDU Rx Indication.
      boolean NmRemoteSleepIndEnabled: origin=AUTOSAR_ECUC V1.1.0  # This feature is required for gateway nodes only.
      boolean NmRepeatMessageBitEnabled: origin=AUTOSAR_ECUC V1.1.0  # Pre-processor switch for enabling support for repeat message
      boolean NmStateChangeIndEnabled: origin=AUTOSAR_ECUC V1.1.0  # Pre-processor switch for enabling the CAN Generic NM state change notification.
      boolean NmUserDataEnabled: origin=AUTOSAR_ECUC V1.1.0  # Pre-processor switch for enabling user data support.
      boolean NmVersionInfoApi: origin=AUTOSAR_ECUC V1.1.0  # Pre-processor switch for enabling version info API support.
  module definition NvM [0..1]  # Configuration of the NvM (NvRam Manager) module.
    container CommonPublishedInformation  # Common container, aggregated by all modules. It contains published information about vendor and versions.
      integer ArMajorVersion: implementation-config-class=PUBLISHED-INFORMATION, origin=AUTOSAR_ECUC V1.0.0  # Major version number of AUTOSAR specification on which the appropriate implementation is based on.
      integer ArMinorVersion: implementation-config-class=PUBLISHED-INFORMATION, origin=AUTOSAR_ECUC V1.0.0  # Minor version number of AUTOSAR specification on which the appropriate implementation is based on.
      integer ArPatchVersion: implementation-config-class=PUBLISHED-INFORMATION, origin=AUTOSAR_ECUC V1.0.0  # Patch level version number of AUTOSAR specification on which the appropriate implementation is based on.
      integer ModuleId: implementation-config-class=PUBLISHED-INFORMATION, origin=AUTOSAR_ECUC V1.0.0  # Module ID of this module from Module List
      integer SwMajorVersion: implementation-config-class=PUBLISHED-INFORMATION, origin=AUTOSAR_ECUC V1.0.0  # Major version number of the vendor specific implementation of the module. The numbering is vendor specific.
      integer SwMinorVersion: implementation-config-class=PUBLISHED-INFORMATION, origin=AUTOSAR_ECUC V1.0.0  # Minor version number of the vendor specific implementation of the module. The numbering is vendor specific.
      integer SwPatchVersion: implementation-config-class=PUBLISHED-INFORMATION, origin=AUTOSAR_ECUC V1.0.0  # Patch level version number of the vendor specific implementation of the module. The numbering is vendor specific.
      string VendorApiInfix [0..1]: implementation-config-class=PUBLISHED-INFORMATION, origin=AUTOSAR_ECUC V1.0.0  # In driver modules which can be instantiated several times on a single ECU, BSW00347 requires that the name of APIs is extended by the VendorId and a vendor specific name. This parameter is used to specify the vendor specific name. In total, the implementation specific name is generated as follows: <ModuleName>_>VendorId>_<VendorApiInfix><Api name from SWS>. E.g. assuming that the VendorId of the implementor is 123 and the implementer chose a VendorApiInfix of "v11r456" a api name Can_Write defined in the SWS will translate to Can_123_v11r456Write. This parameter is mandatory for all modules with upper multiplicity > 1. It shall not be used for modules with upper multiplicity =1.
      integer VendorId: implementation-config-class=PUBLISHED-INFORMATION, origin=AUTOSAR_ECUC V1.0.0  # Vendor ID of the dedicated implementation of this module according to the AUTOSAR vendor list
    container NvmBlockDescriptor [1..65536]  # Container for a management structure to configure the composition of a given NVRAM Block Management Type. Its multiplicity describes thenumber of configured NVRAM blocks, one block is required to be configured. The NVRAM block descriptors are condensed in the NVRAM block descriptor table. The start address of the table is configured in the NVMCommon parameters.
      enumeration NvmBlockCRCType: {NVM_CRC16, NVM_CRC32}, origin=AUTOSAR_ECUC V1.0.0  # Defines CRC data width for the NVRAM block. Default: NVM_CRC16, i.e. CRC16 will be used if NVM_BLOCK_USE_CRC==TRUE
      integer NvmBlockJobPriority: 0..255, origin=AUTOSAR_ECUC V1.0.0  # Defines the job priority for a NVRAM block
      enumeration NvmBlockManagementType: {NVM_BLOCK_DATASET, NVM_BLOCK_NATIVE, NVM_BLOCK_REDUNDANT}, origin=AUTOSAR_ECUC V1.0.0  # Defines the block management type for the NVRAM block.[NVM137]
      boolean NvmBlockUseCrc: origin=AUTOSAR_ECUC V1.0.0  # Defines CRC usage for the NVRAM block, i.e. memory space for CRC is reserved in RAM and NV memory.
      boolean NvmBlockWriteProt: origin=AUTOSAR_ECUC V1.0.0  # Defines an initial write protection of the NV block
      boolean NvmCalcRamBlockCrc: origin=AUTOSAR_ECUC V1.0.0  # Defines CRC (re)calculation for the permanent RAM block
      function name NvmInitBlockCallback: origin=AUTOSAR_ECUC V1.0.0  # Entry address of a block specific callback routine which shall be called if no ROM data is available for initialization of the NVRAM block. If a NULL pointer is configured, no specific callback routine shall be called for initialization of the NVRAM block with default data.
      integer NvmNvBlockLength: 1..65535, origin=AUTOSAR_ECUC V1.0.0  # Defines the NV block data length in bytes
      integer NvmNvBlockNum: 1..255, origin=AUTOSAR_ECUC V1.0.0  # Defines the number of multiple NV blocks in a contiguous area according to the given block management type. 1-255 For NVRAM blocks to be configured of block management type NVM_BLOCK_DATASET 1 For NVRAM blocks to be configured of block management type NVM_BLOCK_NATIVE 2 For NVRAM blocks to be configured of block management type NVM_BLOCK_REDUNDANT
      integer NvmNvramBlockIdentifier: origin=AUTOSAR_ECUC V1.0.0, symbolic-name-value=true  # The SW-C invoke the NVRAM manager with a handle denoting a certain NVRAM block.
      string NvmRamBlockDataAddress: origin=AUTOSAR_ECUC V1.0.0  # Defines the start address of the RAM block data. If a NULL pointer is configured, no permanent RAM data block is available for the selected block management type.
      boolean NvmResistantToChangedSw: origin=AUTOSAR_ECUC V1.0.0  # Defines whether a NVRAM block shall be treated resistant to configuration changes or not. If there is no default data available at configuration time then the application shall be responsible for providing the default initialization data. In this case the application has to use NvM_GetErrorStatus()to be able to distinguish between first initialization and corrupted data.
      string NvmRomBlockDataAddress: origin=AUTOSAR_ECUC V1.0.0  # Defines the start address of the ROM block data. If a NULL pointer is configured, no ROM block is available for the selected block management type.
      boolean NvmSelectBlockForReadall: origin=AUTOSAR_ECUC V1.0.0  # Defines whether a NVRAM block shall be processed during NvM_ReadAll or not. This configuration parameter has only influence on those NVRAM blocks which are configured to have a permanent RAM block.
      function name NvmSingleBlockCallback: origin=AUTOSAR_ECUC V1.0.0  # Entry address of the block specific callback routine which shall be invoked on termination of each asynchronous single block request.
      boolean NvmWriteBlockOnce: origin=AUTOSAR_ECUC V1.0.0  # Defines write protection after first write. The NVRAM manager sets the write protection bit after the NV block was written the first time. This means that some of the NV blocks in the NVRAM should never be erased nor be replaced with the default ROM data after first initialization. [NVM276]
      choice container NvmNvBlockBaseNumber  # The NV block base number shall be used to access a certain block via the memory abstraction interface. It is needed to make the link between the NVM_NVRAM_BLOCK_IDENTIFIER used by the SW-Cs and the FEE_BLOCK_NUMBER expected by the memory abstraction modules.
        container EaRef [0..1]  # EEPROM Abstraction
          symbolic name reference NameOfEaBlock: origin=AUTOSAR_ECUC V1.0.0, destination=EaBlockConfiguration  # reference to EaBlock
        container FeeRef [0..1]  # Flash EEPROM Emulation
          symbolic name reference NameOfFeeBlock: origin=AUTOSAR_ECUC V1.0.0, destination=FeeBlockConfiguration  # reference to FeeBlock
    container NvmCommon  # Container for common configuration options.
      enumeration NvmApiConfigClass: {NvmApiConfigClass1, NvmApiConfigClass2, NvmApiConfigClass3}, origin=AUTOSAR_ECUC V1.0.0  # Preprocessor switch to enable some API calls which are related to NVM API configuration classes.
      integer NvmCompiledConfigId: 0..65535, origin=AUTOSAR_ECUC V1.0.0  # Configuration ID regarding the NV memory layout. This configuration ID shall be published as e.g. a SW-C shall have the possibility to write it to NV memory.
      integer NvmCrcNumOfBytes: 0..65535, origin=AUTOSAR_ECUC V1.0.0  # If CRC is configured for at least one NVRAM block, this parameter defines the maximum number of bytes which shall be processed within one cycle of job processing.
      integer NvmDatasetSelectionBits: 0..8, origin=AUTOSAR_ECUC V1.0.0  # Defines the number of least significant bits which shall be used to address a certain dataset of a NVRAM block within the interface to the memory hardware abstraction. 0..8: Number of bits which are used for dataset or redundant block addressing. 0: No dataset or redundant NVRAM blocks are configured at all, no selection bits required. 1: In case of redundant NVRAM blocks are configured, but no dataset NVRAM blocks.
      boolean NvmDevErrorDetect: origin=AUTOSAR_ECUC V1.0.0  # Preprocessor switch to enable the development error detection
      boolean NvmDrvModeSwitch: origin=AUTOSAR_ECUC V1.0.0  # Preprocessor switch to enable switching memory drivers to fast mode during performing NvM_ReadAll and NvM_WriteAll
      boolean NvmDynamicConfiguration: origin=AUTOSAR_ECUC V1.0.0  # Preprocessor switch to enable the dynamic configuration management handling by the NvM_ReadAll request
      boolean NvmJobPrioritization: origin=AUTOSAR_ECUC V1.0.0  # Preprocessor switch to enable job prioritization handling
      integer NvmMaxNoOfWriteRetries: 0..7, origin=AUTOSAR_ECUC V1.0.0  # Defines the maximum number of write retries for a NVRAM block with [NVM061]. Regardless of configuration a consistency check (and maybe write retries) are always forced for each block which is processed by the request NvM_WriteAll.
      function name NvmMulitBlockCallback: origin=AUTOSAR_ECUC V1.0.0  # Entry address of the common callback routine which shall be invoked on termination of each asynchronous multi block request
      boolean NvmPollingMode: origin=AUTOSAR_ECUC V1.0.0  # Preprocessor switch to enable/disable the polling mode in the NVRAM Manager and at the same time disable/enable the callback functions useable by lower layers ON Polling mode enabled/ callbacks disabled OFF Polling mode disabled/callbacks enabled
      boolean NvmSetRamBlockStatusApi: origin=AUTOSAR_ECUC V1.0.0  # Preprocessor switch to enable the API NvM_SetRamBlockStatus.
      integer NvmSizeImmediateJobQueue: 0..255, origin=AUTOSAR_ECUC V1.0.0  # Defines the number of queue entries for the immediate priority job queue. If NVM_JOB_PRIORITIZATION is switched OFF this parameter shall be out of scope.
      integer NvmSizeStandardJobQueue: 0..255, origin=AUTOSAR_ECUC V1.0.0  # Defines the number of queue entries for the standard job queue.
      derived integer NvmTotalNumOfNvramBlocks: origin=AUTOSAR_ECUC V1.0.0  # This parameter shall publish the total number of configured NVRAM blocks to offer the possibility to do an over-all block handling, e.g. during start-up by a single SW-C.
      boolean NvmVersionInfoApi: origin=AUTOSAR_ECUC V1.0.0  # Preprocessor switch to enable the version info API [NVM285], [NVM286].
  module definition Os [0..1]  # Configuration of the Os (Operating System) module.
    container CommonPublishedInformation  # Common container, aggregated by all modules. It contains published information about vendor and versions.
      integer ArMajorVersion: implementation-config-class=PUBLISHED-INFORMATION, origin=AUTOSAR_ECUC V1.0.0  # Major version number of AUTOSAR specification on which the appropriate implementation is based on.
      integer ArMinorVersion: implementation-config-class=PUBLISHED-INFORMATION, origin=AUTOSAR_ECUC V1.0.0  # Minor version number of AUTOSAR specification on which the appropriate implementation is based on.
      integer ArPatchVersion: implementation-config-class=PUBLISHED-INFORMATION, origin=AUTOSAR_ECUC V1.0.0  # Patch level version number of AUTOSAR specification on which the appropriate implementation is based on.
      integer ModuleId: implementation-config-class=PUBLISHED-INFORMATION, origin=AUTOSAR_ECUC V1.0.0  # Module ID of this module from Module List
      integer SwMajorVersion: implementation-config-class=PUBLISHED-INFORMATION, origin=AUTOSAR_ECUC V1.0.0  # Major version number of the vendor specific implementation of the module. The numbering is vendor specific.
      integer SwMinorVersion: implementation-config-class=PUBLISHED-INFORMATION, origin=AUTOSAR_ECUC V1.0.0  # Minor version number of the vendor specific implementation of the module. The numbering is vendor specific.
      integer SwPatchVersion: implementation-config-class=PUBLISHED-INFORMATION, origin=AUTOSAR_ECUC V1.0.0  # Patch level version number of the vendor specific implementation of the module. The numbering is vendor specific.
      string VendorApiInfix [0..1]: implementation-config-class=PUBLISHED-INFORMATION, origin=AUTOSAR_ECUC V1.0.0  # In driver modules which can be instantiated several times on a single ECU, BSW00347 requires that the name of APIs is extended by the VendorId and a vendor specific name. This parameter is used to specify the vendor specific name. In total, the implementation specific name is generated as follows: <ModuleName>_>VendorId>_<VendorApiInfix><Api name from SWS>. E.g. assuming that the VendorId of the implementor is 123 and the implementer chose a VendorApiInfix of "v11r456" a api name Can_Write defined in the SWS will translate to Can_123_v11r456Write. This parameter is mandatory for all modules with upper multiplicity > 1. It shall not be used for modules with upper multiplicity =1.
      integer VendorId: implementation-config-class=PUBLISHED-INFORMATION, origin=AUTOSAR_ECUC V1.0.0  # Vendor ID of the dedicated implementation of this module according to the AUTOSAR vendor list
    container OsAlarm [0..*]  # An OsAlarm may be used to asynchronously inform or activate a specific task. It is possible to start alarms automatically at system start-up depending on the application mode.
      reference def OsAlarmCounterRef: lower-multiplicity=1, upper-multiplicity=1, origin=AUTOSAR_ECUC V1.0.0, destination=OsCounter  # Reference to the assigned counter for that alarm
      choice container OsAlarmAction  # This container defines which type of notification is used when the alarm expires.
        container OsAlarmActivateTask [0..1]
          reference def OsAlarmActivateTaskRef: lower-multiplicity=1, upper-multiplicity=1, origin=AUTOSAR_ECUC V1.0.0, destination=OsTask  # Reference to the task that will be activated by that alarm action
        container OsAlarmCallback [0..1]  # Callback function that is executed when this alarm is triggered
          function name OsAlarmCallbackName: origin=AUTOSAR_ECUC V1.0.0  # Name of the function that is called when this alarm callback is triggered.
        container OsAlarmIncrementCounter [0..1]
          reference def OsAlarmIncrementCounterRef: lower-multiplicity=1, upper-multiplicity=1, origin=AUTOSAR_ECUC V1.0.0, destination=OsCounter  # Reference to the counter that will be incremented by that alarm action
        container OsAlarmSetEvent [0..1]
          reference def OsAlarmSetEventRef: lower-multiplicity=1, upper-multiplicity=1, origin=AUTOSAR_ECUC V1.0.0, destination=OsEvent  # Reference to the event that will be set by that alarm action
          reference def OsAlarmSetEventTaskRef: lower-multiplicity=1, upper-multiplicity=1, origin=AUTOSAR_ECUC V1.0.0, destination=OsTask  # Reference to the task that will be activated by that event
      container OsAlarmAutostart [0..1]  # If present this container defines if an alarm is started automatically at system start-up depending on the application mode.
        float OsAlarmAlarmTime: origin=AUTOSAR_ECUC V1.0.0  # when shall the alarm expire first, specified in [s]
        float OsAlarmCycleTime: origin=AUTOSAR_ECUC V1.0.0  # cycle time of a cyclic alarm, specified in [s]
        reference def OsAlarmAppModeRef: lower-multiplicity=0, upper-multiplicity=*, origin=AUTOSAR_ECUC V1.0.0, destination=OsAppMode  # Reference to the application modes for which the AUTOSTART shall be performed
    container OsAppMode [1..*]  # OsAppMode is the object used to define OSEK OS properties for an OSEK OS application mode. No standard attributes are defined for AppMode. In a CPU, at least one AppMode object has to be defined. [source: OSEK OIL Spec. 2.5]
      integer OsAppModeId: origin=AUTOSAR_ECUC V1.0.0, symbolic-name-value=true  # Internal ID of an AppMode. Necessary, so that an AppMode is addressable by other modules.
    container OsApplication [0..*]  # An AUTOSAR OS must be capable of supporting a collection of OS objects (tasks, interrupts, alarms, hooks etc.) that form a cohesive functional unit. This collection of objects is termed an OS-Application. All objects which belong to the same OS-Application have access to each other. Access means to allow to use these objects within API services. Access by other applications can be granted separately.
      boolean OsTrusted: origin=AUTOSAR_ECUC V1.0.0, default-value=false  # true: OS-Application is trusted false: OS-Application is not trusted (default)
      function name OsTrustedFunction [0..*]: origin=AUTOSAR_ECUC V1.0.0  # Trusted function (as part of a trusted OS-Application) available to other OS-Applications. This also supersedes the OSEK OIL attribute TRUSTED in APPLICATION because the optionality of this parameter is describing that already.
      reference def OsAppAlarmRef: lower-multiplicity=0, upper-multiplicity=*, origin=AUTOSAR_ECUC V1.0.0, destination=OsAlarm  # Specifies the OsAlarms that belong to the OsApplication.
      reference def OsAppCounterRef: lower-multiplicity=0, upper-multiplicity=*, origin=AUTOSAR_ECUC V1.0.0, destination=OsCounter  # References the OsCounters that belong to the OsApplication.
      reference def OsAppIsrRef: lower-multiplicity=0, upper-multiplicity=*, origin=AUTOSAR_ECUC V1.0.0, destination=OsIsr  # references which OsIsrs belong to the OsApplication
      reference def OsAppMessageRef: lower-multiplicity=0, upper-multiplicity=*, origin=AUTOSAR_ECUC V1.0.0, destination=OsMessage  # References the OsMessages that belong to the OsApplication.
      reference def OsAppResourceRef: lower-multiplicity=0, upper-multiplicity=*, origin=AUTOSAR_ECUC V1.0.0, destination=OsResource  # References the OsResources that belong to the OsApplication.
      reference def OsAppScheduleTableRef: lower-multiplicity=0, upper-multiplicity=*, origin=AUTOSAR_ECUC V1.0.0, destination=OsScheduleTable  # References the OsScheduleTables that belong to the OsApplication.
      reference def OsAppTaskRef: lower-multiplicity=0, upper-multiplicity=*, origin=AUTOSAR_ECUC V1.0.0, destination=OsTask  # references which OsTasks belong to the OsApplication
      reference def OsRestartTask: lower-multiplicity=0, upper-multiplicity=1, origin=AUTOSAR_ECUC V1.0.0, destination=OsTask  # Optionally one task of an OS-Application may be defined as Re-start Task.
      container OsAppHooks  # Container to structure the OS-Application-specific hooks
        boolean OsAppErrorHook: origin=AUTOSAR_ECUC V1.0.0  # Select the OS-Application error hook.
        boolean OsAppShutdownHook: origin=AUTOSAR_ECUC V1.0.0  # Select the OS-Application specific shutdown hook for the OS-Application.
        boolean OsAppStartupHook: origin=AUTOSAR_ECUC V1.0.0  # Select the OS-Application specific startup hook for the OS-Application.
    container OsCom
      string ComAppMode [0..*]: origin=AUTOSAR_ECUC V1.0.0
      boolean ComErrorHook: origin=AUTOSAR_ECUC V1.0.0, default-value=false
      boolean ComStartComExtension: origin=AUTOSAR_ECUC V1.0.0, default-value=false
      boolean ComUseGetServiceId: origin=AUTOSAR_ECUC V1.0.0, default-value=false
      boolean ComUseParameterAccess: origin=AUTOSAR_ECUC V1.0.0, default-value=false
      enumeration OsComStatus: {COMEXTENDED, COMSTANDARD}, origin=AUTOSAR_ECUC V1.0.0, default-value=COMSTANDARD
    container OsCounter [0..*]  # Configuration information for the counters that belong to the OsApplication.
      integer OsCounterMaxAllowedValue: origin=AUTOSAR_ECUC V1.0.0  # As defined by OSEK
      integer OsCounterMinCycle: origin=AUTOSAR_ECUC V1.0.0  # As defined by OSEK
      integer OsCounterTicksPerBase: origin=AUTOSAR_ECUC V1.0.0
      enumeration OsCounterType: {HARDWARE, SOFTWARE}, origin=AUTOSAR_ECUC V1.0.0  # This parameter contains the natural type or unit of the counter.
      enumeration OsCounterUnit: {SECONDS, TICKS}, origin=AUTOSAR_ECUC V1.0.0  # This parameter contains the unit type of the counter.
    container OsEvent [0..*]  # Representation of OS events in the configuration context. Adopted from the OSEK OIL specification.
      integer OsEventMask [0..1]: origin=AUTOSAR_ECUC V1.1.0  # If event mask would be set to AUTO in OIL, this parameter should be omitted here.
    container OsIsr [0..*]  # The OsISR container represents an OSEK interrupt service routine.
      enumeration OsIsrCategory: {Category_1, Category_2}, origin=AUTOSAR_ECUC V1.0.0  # This attribute specifies the category of this ISR. Only values of 1 and 2 are allowed.
      integer OsIsrCountLimit: origin=AUTOSAR_ECUC V1.0.0  # OS223: The Configuration language shall allow th user to define the maximum arrival rate for each ISR. =COUNTLIMIT times in TIMELIMIT seconds
      float OsIsrExecutionBudget: origin=AUTOSAR_ECUC V1.0.0
      float OsIsrTimeLimit: origin=AUTOSAR_ECUC V1.0.0  # OS223: The Configuration language shall allow th user to define the maximum arrival rate for each ISR. =COUNTLIMIT times in TIMELIMIT seconds
      reference def OsIsrMessageRef: lower-multiplicity=0, upper-multiplicity=*, origin=AUTOSAR_ECUC V1.0.0, destination=OsMessage  # This reference defines the list of messages accessed by this ISR.
      reference def OsIsrResourceRef: lower-multiplicity=0, upper-multiplicity=*, origin=AUTOSAR_ECUC V1.0.0, destination=OsResource  # This reference defines the resources accessed by this ISR.
      container OsIsrInterruptLock [0..*]  # This parameter contains the time of the task in which the task has disabled either category 1 and 2 interrupts or only category 2 interrupts.
        float OsIsrAllInterruptLockTime: origin=AUTOSAR_ECUC V1.0.0  # specified in [s]
        float OsIsrOsInterruptLockTime: origin=AUTOSAR_ECUC V1.0.0  # specified in [s]
      container OsIsrResourceLock [0..*]  # This parameter contains the worst case time between getting and releasing a given resource.
        float OsIsrResourceLockTime: origin=AUTOSAR_ECUC V1.0.0  # specified in [s]
        reference def OsIsrResourceLockResourceRef: lower-multiplicity=1, upper-multiplicity=1, origin=AUTOSAR_ECUC V1.0.0, destination=OsResource  # Reference to the resource the locking time is depending on
    container OsMessage [0..*]  # An OsMessage container represents an OSEK message. The OSEK network messages are not handled in the AUTOSAR environment.
      choice container OsMessageProperty  # Property of the message object.
        container OsMsgReceiveQueuedInternal [0..1]  # [pending]
          integer QueueSize: 1.., origin=AUTOSAR_ECUC V1.0.0  # Defines the maximum number of message that the queue for a queued message can store.
          reference def SendingMessage: lower-multiplicity=1, upper-multiplicity=1, origin=AUTOSAR_ECUC V1.0.0, destination=OsMessage  # SendingMessage is used by a receiver of an internal message to identify the sender of the message. Therefore, this is a reference to a sent message.
        container OsMsgReceiveUnqueuedInternal [0..1]  # [pending]
          integer InitialValue: origin=AUTOSAR_ECUC V1.0.0, default-value=0  # This parameter specifies the initial value of the message.
          reference def SendingMessage: lower-multiplicity=1, upper-multiplicity=1, origin=AUTOSAR_ECUC V1.0.0, destination=OsMessage  # SendingMessage is used by a receiver of an internal message to identify the sender of the message. Therefore, this is a reference to a sent message.
        container OsMsgSendStaticInternal [0..1]  # [pending]
          string CDataType: origin=AUTOSAR_ECUC V1.0.0  # This describes the data type of the message data using C language types (e.g. int or a structure name). The purpose of this parameter is the representation of the message in a form that is meaningful to the application.
      choice container OsMsgNotification [0..1]  # Depending on the message property this is either a send or a receive notification. a Multiplicity == 0 translates to a NOTIFICATION = NONE in OSEK OS.
        container OsMsgActivateTask [0..1]  # To perform the required notification a task is activated. The task is referenced by TaskRef.
          reference def TaskRef: lower-multiplicity=1, upper-multiplicity=1, origin=AUTOSAR_ECUC V1.0.0, destination=OsTask  # Reference to the OsTask that is triggered by that OsMessage.
        container OsMsgComCallback [0..1]  # To perform the required notification a callback routine is called. The name of the callback routine is specified in the CallbackRoutineName parameter. The reference message (MessageRef) must list all the messages that are sent and/or received by this callback routine.
          function name CallbackRoutineName: origin=AUTOSAR_ECUC V1.0.0  # This is the name of the callback routine in C notation.
          reference def MessageRef: lower-multiplicity=1, upper-multiplicity=*, origin=AUTOSAR_ECUC V1.0.0, destination=OsMessage  # Messages sent and/or received by the callback routine.
        container OsMsgFlag [0..1]  # To perform the required notification a OsMsgFlag is set.
          string FlagName: origin=AUTOSAR_ECUC V1.0.0  # Name of the OsMsgFlag
        container OsMsgSetEvent [0..1]  # To perform a required notification an event is set for a task. The event and task are referenced by EventRef and TaskRef.
          reference def EventRef: lower-multiplicity=1, upper-multiplicity=1, origin=AUTOSAR_ECUC V1.0.0, destination=OsEvent  # Reference to the OsEvent that is triggered by that OsMessage.
          reference def TaskRef: lower-multiplicity=1, upper-multiplicity=1, origin=AUTOSAR_ECUC V1.0.0, destination=OsTask  # Reference to the OsTask that is triggered by that OsMessage.
    container OsNm  # [pending]
    container OsOS  # OS is the object used to define OSEK OS properties for an OSEK application. Per CPU exactly one OS object has to be defined.
      enumeration OsScalabilityClass [0..1]: {SC1, SC2, SC3, SC4}, origin=AUTOSAR_ECUC V1.0.0  # A scalability class for each System Object "OS" has to be selected. In order to customize the operating system to the needs of the user and to take full advantage of the processor features the operating system can be scaled according to the scalability classes. If the scalability class is omitted this translates to the OIL AUTO mechanism.
      boolean OsStackMonitoring: origin=AUTOSAR_ECUC V1.0.0  # Select stack monitoring of Tasks/Category 2 ISRs
      enumeration OsStatus: {EXTENDED, STANDARD}, origin=AUTOSAR_ECUC V1.0.0  # The Status attribute specifies whether a system with standard or extended status has to be used. Automatic assigment is not supported for this attribute.
      boolean OsUseGetServiceId: origin=AUTOSAR_ECUC V1.0.0  # As defined by OSEK
      boolean OsUseParameterAccess: origin=AUTOSAR_ECUC V1.0.0  # As defined by OSEK
      boolean OsUseResScheduler: origin=AUTOSAR_ECUC V1.0.0, default-value=true  # The OsUseResScheduler attribute defines whether the resource RES_SCHEDULER is used within the application.
      container OsHooks  # Container to structure all hooks belonging to the OS
        boolean OsErrorHook: origin=AUTOSAR_ECUC V1.0.0  # Error hook as defined by OSEK
        boolean OsPostTaskHook: origin=AUTOSAR_ECUC V1.0.0  # Post-task hook as defined by OSEK
        boolean OsPreTaskHook: origin=AUTOSAR_ECUC V1.0.0  # Pre-task hook as defined by OSEK
        boolean OsProtectionHook: origin=AUTOSAR_ECUC V1.0.0  # Switch to enable/disable the call to the (user supplied) protection hook
        boolean OsShutdownHook: origin=AUTOSAR_ECUC V1.0.0  # Shutdown hook as defined by OSEK
        boolean OsStartupHook: origin=AUTOSAR_ECUC V1.0.0  # Startup hook as defined by OSEK
    container OsResource [0..*]  # An OsResource object is used to co-ordinate the concurrent access by tasks and ISRs to a shared resource, e.g. the scheduler, any program sequence, memory or any hardware area.
      enumeration OsResourceProperty: {INTERNAL, LINKED, STANDARD}, origin=AUTOSAR_ECUC V1.0.0
      reference def OsResourceLinkedResource: lower-multiplicity=0, upper-multiplicity=1, origin=AUTOSAR_ECUC V1.0.0, destination=OsResource  # Is there a better solution?
    container OsScheduleTable [0..*]  # An OsScheduleTable addresses the synchronization issue by providing an encapsulation of a statically defined set of alarms that cannot be modified at runtime.
      float OsScheduleTableLength: origin=AUTOSAR_ECUC V1.0.0  # Defines the length of the schedule table. The unit is depending on the related counter type.
      boolean OsScheduleTablePeriodic: origin=AUTOSAR_ECUC V1.0.0  # Defines if the schedule table is periodic or not.
      reference def OsScheduleTableCounterRef: lower-multiplicity=1, upper-multiplicity=1, origin=AUTOSAR_ECUC V1.0.0, destination=OsCounter  # OS145: The Configuration language shall allow the user to define the counter which drives the schedule table.
      choice container OsScheduleTableAction [1..*]  # Choice of actions that can be triggered by a OsScheduleTable.
        container OsScheduleTableActivateTask [0..1]  # Task that is triggered by that schedule table.
          float OsScheduleTblActionOffset: origin=AUTOSAR_ECUC V1.0.0  # [s] relative to the start of the period
          reference def OsScheduleTableActivateTaskRef: lower-multiplicity=1, upper-multiplicity=1, origin=AUTOSAR_ECUC V1.0.0, destination=OsTask  # Reference to task that will be activated by action
        container OsScheduleTableSetEvent [0..1]  # Event that is triggered by that schedule table.
          float OsScheduleTblActionOffset: origin=AUTOSAR_ECUC V1.0.0  # [s] relative to the start of the period
          reference def OsScheduleTableActivateTaskRef: lower-multiplicity=1, upper-multiplicity=1, origin=AUTOSAR_ECUC V1.0.0, destination=OsTask  # Reference to task that will be activated by action
          reference def OsScheduleTableSetEventRef: lower-multiplicity=1, upper-multiplicity=1, origin=AUTOSAR_ECUC V1.0.0, destination=OsEvent  # Reference to event that will be set by action
      container OsScheduleTableAutostart [0..1]  # This parameter specifies if the schedule table is started on startup of the Operating System with a given relative offset.
        integer OsScheduleTableOffset: origin=AUTOSAR_ECUC V1.0.0  # Relative autostart offset of the schedule table
        reference def OsScheduleTableAppModeRef: lower-multiplicity=1, upper-multiplicity=1, origin=AUTOSAR_ECUC V1.0.0, destination=OsAppMode  # Reference in which application modes the schedule table should be started during startup
      container OsScheduleTblTimeSync [0..1]  # This parameter specifies he synchronization parameters of the schedule table. The sub parameters define the startup behavior and the maximal adjustments. The timing parameters are given in seconds.
        float OsScheduleTableSyncMaxDec: origin=AUTOSAR_ECUC V1.0.0  # specified in [s]
        float OsScheduleTableSyncMaxDecAsync: origin=AUTOSAR_ECUC V1.0.0  # specified in [s]
        float OsScheduleTableSyncMaxInc: origin=AUTOSAR_ECUC V1.0.0  # specified in [s]
        float OsScheduleTableSyncMaxIncAsync: origin=AUTOSAR_ECUC V1.0.0  # specified in [s]
        float OsScheduleTableSyncPrecision: origin=AUTOSAR_ECUC V1.0.0  # specified in [s]
        enumeration OsScheduleTblSyncStrategy: {HARD, SMOOTH}, origin=AUTOSAR_ECUC V1.1.0, default-value="HARD"  # This parameter specifies how OS should synchronize that OsScheduleTable with a global time.
    container OsTask [0..*]  # This container represents an OSEK task.
      integer OsTaskActivation: origin=AUTOSAR_ECUC V1.0.0  # This attribute defines the maximum number of queued activation requests for the task. A value equal to "1" means that at any time only a single activation is permitted for this task.
      float OsTaskExecutionBudget [0..1]: origin=AUTOSAR_ECUC V1.0.0  # This parameter contains the worst case execution time of the task in seconds. Only available in scalability class 2 and 4
      integer OsTaskPriority: origin=AUTOSAR_ECUC V1.0.0  # The priority of a task is defined by the value of this attribute. This value has to be understood as a relative value, i.e. the values show only the relative ordering of the tasks. OSEK OS defines the lowest priority as zero (0); larger values correspond to higher priorities.
      enumeration OsTaskSchedule: {FULL, NON}, origin=AUTOSAR_ECUC V1.0.0  # The OsTaskSchedule attribute defines the preemptability of the task. If this attribute is set to NON, no internal resources may be assigned to this task.
      float OsTaskTimeFrame [0..1]: origin=AUTOSAR_ECUC V1.0.0  # These two parameters contain the allowed inter-arrival time of the task. The time is specified as a time budget (TIMELIMIT) in a defined time frame (TIMEFRAME). Only available in scalability class 2 and 4
      float OsTaskTimeLimit [0..1]: origin=AUTOSAR_ECUC V1.0.0  # These two parameters contain the allowed inter-arrival time of the task. The time is specified as a time budget (TIMELIMIT) in a defined time frame (TIMEFRAME). Only available in scalability class 2 and 4
      reference def OsTaskEventRef: lower-multiplicity=0, upper-multiplicity=*, origin=AUTOSAR_ECUC V1.0.0, destination=OsEvent  # This reference defines the list of events the extended task may react on.
      reference def OsTaskMessageRef: lower-multiplicity=0, upper-multiplicity=*, origin=AUTOSAR_ECUC V1.0.0, destination=OsMessage  # This reference defines the list of messages accessed by this task.
      reference def OsTaskResourceRef: lower-multiplicity=0, upper-multiplicity=*, origin=AUTOSAR_ECUC V1.0.0, destination=OsResource  # This reference defines a list of resources accessed by this task.
      container OsTaskAutostart [0..1]  # This container determines whether the task is activated during the system start-up procedure or not for some specific application modes. If the task shall be activated during the system start-up, this container is present and holds the references to the application modes in which the task is auto-started.
        reference def OsTaskAppModeRef: lower-multiplicity=0, upper-multiplicity=*, origin=AUTOSAR_ECUC V1.0.0, destination=OsAppMode  # Reference to application modes in which that task is activated on startup of the OS
      container OsTaskInterruptLock [0..*]  # This parameter contains the time of the task in which the task has disabled either category 1 and 2 interrupts (ALLINTERRUPTLOCKTIME) or only category 2 (OSINTERRUPTLOCKTIME) interrupts.
        float OsTaskAllInterruptLocktime: origin=AUTOSAR_ECUC V1.0.0  # interrupt lock time in [s]
        float OsTaskInterruptLockTime: origin=AUTOSAR_ECUC V1.0.0  # interrupt lock time in [s]
      container OsTaskResourceLock [0..*]  # This parameter contains the worst case time between getting and releasing a given resource (in seconds).
        float OsTaskResourceLockTime: origin=AUTOSAR_ECUC V1.0.0  # resource lock time in [s]
        reference def OsTaskResourceLockResourceRef: lower-multiplicity=1, upper-multiplicity=1, origin=AUTOSAR_ECUC V1.0.0, destination=OsResource  # Reference to the resource the locking time is depending on
  module definition PduR [0..1]  # Configuration of the PduR (PDU Router) module.
    container CommonPublishedInformation  # Common container, aggregated by all modules. It contains published information about vendor and versions.
      integer ArMajorVersion: implementation-config-class=PUBLISHED-INFORMATION, origin=AUTOSAR_ECUC V1.0.0  # Major version number of AUTOSAR specification on which the appropriate implementation is based on.
      integer ArMinorVersion: implementation-config-class=PUBLISHED-INFORMATION, origin=AUTOSAR_ECUC V1.0.0  # Minor version number of AUTOSAR specification on which the appropriate implementation is based on.
      integer ArPatchVersion: implementation-config-class=PUBLISHED-INFORMATION, origin=AUTOSAR_ECUC V1.0.0  # Patch level version number of AUTOSAR specification on which the appropriate implementation is based on.
      integer ModuleId: implementation-config-class=PUBLISHED-INFORMATION, origin=AUTOSAR_ECUC V1.0.0  # Module ID of this module from Module List
      integer SwMajorVersion: implementation-config-class=PUBLISHED-INFORMATION, origin=AUTOSAR_ECUC V1.0.0  # Major version number of the vendor specific implementation of the module. The numbering is vendor specific.
      integer SwMinorVersion: implementation-config-class=PUBLISHED-INFORMATION, origin=AUTOSAR_ECUC V1.0.0  # Minor version number of the vendor specific implementation of the module. The numbering is vendor specific.
      integer SwPatchVersion: implementation-config-class=PUBLISHED-INFORMATION, origin=AUTOSAR_ECUC V1.0.0  # Patch level version number of the vendor specific implementation of the module. The numbering is vendor specific.
      string VendorApiInfix [0..1]: implementation-config-class=PUBLISHED-INFORMATION, origin=AUTOSAR_ECUC V1.0.0  # In driver modules which can be instantiated several times on a single ECU, BSW00347 requires that the name of APIs is extended by the VendorId and a vendor specific name. This parameter is used to specify the vendor specific name. In total, the implementation specific name is generated as follows: <ModuleName>_>VendorId>_<VendorApiInfix><Api name from SWS>. E.g. assuming that the VendorId of the implementor is 123 and the implementer chose a VendorApiInfix of "v11r456" a api name Can_Write defined in the SWS will translate to Can_123_v11r456Write. This parameter is mandatory for all modules with upper multiplicity > 1. It shall not be used for modules with upper multiplicity =1.
      integer VendorId: implementation-config-class=PUBLISHED-INFORMATION, origin=AUTOSAR_ECUC V1.0.0  # Vendor ID of the dedicated implementation of this module according to the AUTOSAR vendor list
    container PduRGeneral  # This container is a subcontainer of PduR and specifies the general configuration parameters of the PDU Router.
      boolean PduRCanIfSupport: origin=AUTOSAR_ECUC V1.0.0  # Configuration parameter to enable or disable PDU Router support for CAN interface.
      boolean PduRCanTpSupport: origin=AUTOSAR_ECUC V1.0.0  # Configuration parameter to enable or disable PDU Router support for CAN TP.
      boolean PduRComSupport: origin=AUTOSAR_ECUC V1.0.0  # Configuration parameter to enable or disable PDU Router support for COM.
      boolean PduRDcmSupport: origin=AUTOSAR_ECUC V1.0.0  # Configuration parameter to enable or disable PDU Router support for DCM.
      boolean PduRDevErrorDetect: origin=AUTOSAR_ECUC V1.0.0  # Switches the Development Error Detection and Notification ON or OFF.
      boolean PduRFifoTxBufferSupport: origin=AUTOSAR_ECUC V1.0.0  # Configuration parameter to enable or disable PDU Router support for FIFOs as PDU transmit buffers; if PDUR_GATEWAY_OPERATION is disabled, this parameter has to be disabled.
      boolean PduRFrIfSupport: origin=AUTOSAR_ECUC V1.0.0  # Configuration parameter to enable or disable PDU Router support for FlexRay interface.
      boolean PduRFrTpSupport: origin=AUTOSAR_ECUC V1.0.0  # Configuration parameter to enable or disable PDU Router support for FlexRay TP.
      boolean PduRGatewayOperation: origin=AUTOSAR_ECUC V1.0.0  # Configuration parameter to enable or disable PDU Router gateway operation; if PDUR_ZERO_COST_OPERATION is enabled, this parameter has to be disabled.
      boolean PduRIPduMSupport: origin=AUTOSAR_ECUC V1.0.0  # Configuration parameter to enable or disable PDU Router support for IPDUM; if PDUR_ZERO_COST_OPERATION is enabled, this parameter has to be disabled.
      boolean PduRLinIfSupport: origin=AUTOSAR_ECUC V1.0.0  # Configuration parameter to enable or disable PDU Router support for LIN interface.
      boolean PduRLinTpSupport: origin=AUTOSAR_ECUC V1.0.0  # Configuration parameter to enable or disable PDU Router support for LIN TP.
      integer PduRMemorySize: 0..4294967295, origin=AUTOSAR_ECUC V1.0.0  # Memory size reserved for PDU Router buffers. Only required for gateway operation.
      enumeration PduRMinimumRoutingLoModule [0..1]: {CanIf, CanTp, FrIf, FrTp, LinIf, LinTp}, origin=AUTOSAR_ECUC V1.0.0  # Lower layer module to be used for minimum routing; this parameter shall be used if PDUR_ZERO_COST_OPERATION is disabled; otherwise it shall not be used.
      integer PduRMinimumRoutingLoRxPduId [0..1]: 0..65535, origin=AUTOSAR_ECUC V1.0.0  # Receive PDU identifier of the lower layer module which shall be used at the PDU Router interface to the lower layer module specified by PDUR_MINIMUM_ROUTING_LO_MODULE for minimum routing; this parameter shall be used if PDUR_ZERO_COST_OPERATION is disabled; otherwise it shall not be used.
      integer PduRMinimumRoutingLoTxPduId [0..1]: 0..65535, origin=AUTOSAR_ECUC V1.0.0  # Transmit PDU identifier of the lower layer module which shall be used at the PDU Router interface to the lower layer module specified by PDUR_MINIMUM_ROUTING_LO_MODULE for minimum routing; this parameter shall be used if PDUR_ZERO_COST_OPERATION is disabled; otherwise it shall not be used.
      enumeration PduRMinimumRoutingUpModule [0..1]: {Com, Dcm}, origin=AUTOSAR_ECUC V1.0.0  # Upper layer module to be used for minimum routing; this parameter shall be used if PDUR_ZERO_COST_OPERATION is disabled; otherwise it shall not be used.
      integer PduRMinimumRoutingUpRxPduId [0..1]: 0..65535, origin=AUTOSAR_ECUC V1.0.0  # Receive PDU identifier of the upper layer module which shall be used at the PDU Router interface to the upper layer module specified by PDUR_MINIMUM_ROUTING_UP_MODULE for minimum routing; this parameter shall be used if PDUR_ZERO_COST_OPERATION is disabled; otherwise it shall not be used.
      integer PduRMinimumRoutingUpTxPduId [0..1]: 0..65535, origin=AUTOSAR_ECUC V1.0.0  # Transmit PDU identifier of the upper layer module which shall be used at the PDU Router interface to the upper layer module specified by PDUR_MINIMUM_ROUTING_UP_MODULE for minimum routing; this parameter shall be used if PDUR_ZERO_COST_OPERATION is disabled; otherwise it shall not be used.
      boolean PduRMulticastFromIfSupport: origin=AUTOSAR_ECUC V1.0.0  # Configuration parameter to enable or disable PDU Router support for multicasts from an interface module to upper layer modules or lower layer interface modules; if PDUR_ZERO_COST_OPERATION is enabled, this parameter has to be disabled.
      boolean PduRMulticastFromTpSupport: origin=AUTOSAR_ECUC V1.0.0  # Configuration parameter to enable or disable PDU Router support for multicasts from a TP module to upper layer modules or lower layer TP modules; if PDUR_ZERO_COST_OPERATION is enabled, this parameter has to be disabled.
      boolean PduRMulticastToIfSupport: origin=AUTOSAR_ECUC V1.0.0  # Configuration parameter to enable or disable PDU Router support for multicasts from an upper layer module to interface modules; if PDUR_ZERO_COST_OPERATION is enabled, this parameter has to be disabled.
      boolean PduRMulticastToTpSupport: origin=AUTOSAR_ECUC V1.0.0  # Configuration parameter to enable or disable PDU Router support for multicasts from an upper layer module to TP modules; if PDUR_ZERO_COST_OPERATION is enabled, this parameter has to be disabled.
      boolean PduRSbTxBufferSupport: origin=AUTOSAR_ECUC V1.0.0  # Configuration parameter to enable or disable PDU Router support for single buffers as PDU transmit buffers; if PDUR_GATEWAY_OPERATION is disabled, this parameter has to be disabled.
      enumeration PduRSingleIf [0..1]: {CanIf, FrIf, LinIf}, origin=AUTOSAR_ECUC V1.0.0  # Single interface module in case zero cost operation is enabled (PDUR_ZERO_COST_OPERATION).
      enumeration PduRSingleTp [0..1]: {CanTp, FrTp, LinTp}, origin=AUTOSAR_ECUC V1.0.0  # Single transport protocol module in case zero cost operation is enabled (PDUR_ZERO_COST_OPERATION).
      boolean PduRVersionInfoApi: origin=AUTOSAR_ECUC V1.0.0  # Activates/Deactivates the Version Info API.
      boolean PduRZeroCostOperation: origin=AUTOSAR_ECUC V1.0.0  # If all conditions stated in PDUR165 are fulfilled, all routing paths are implicitly defined and the communication modules directly above or below the PDU Router shall directly call each other without using PDU Router functions (zero cost operation). The configuration parameters PDUR_SINGLE_IF and PDUR_SINGLE_TP are used to specify the related lower layer module.
    container PduRGlobalConfig  # This container contains the global configuration parameter of the PduR. It is a MultipleConfigurationContainer, i.e. this container and its sub-containers exit once per configuration set.
      integer PduRConfigurationId [0..1]: 1..4294967295, origin=AUTOSAR_ECUC V1.0.0  # unique configuration identifier of post-build time configuration; this parameter shall be used if PDUR_ZERO_COST_OPERATION is disabled; otherwise it shall not be used.
      container PduRRoutingTable  # PDU Router routing table is a subcontainer ofPduR. This container shall only be considered by the PDU Router Configuration Generator if PduRGeneral/PDUR_ZERO_COST_OPERATION is disabled.
        container PduRRoutingPath [0..*]  # This container is a subcontainer of PduRRoutingTable and specifies the routing path of a PDU.
          integer SduLength [0..1]: 0..255, origin=AUTOSAR_ECUC V1.0.0  # Length of PDU data (SDU). Only required if a TX buffer is configured.
          integer TpChunkSize [0..1]: 1..65535, origin=AUTOSAR_ECUC V1.0.0  # Chunk size for routing on the fly. Defines the number of bytes which shall be received before transmission on the destination bus may start. Only required for TP gateway PDUs. The TpChunkSize shall not be larger than the length of the related TP Buffer.
          container PduRDefaultValue [0..1]  # This container is a subcontainer of PduRRoutingPath and specifies the default value of the I-PDU. Only required for gateway operation and if at least one PDU specified by PduRDestPdu uses TriggerTransmit Data provision. Represented as an array of IntegerParamDef. Each element is one Byte of the default value.
            integer DefaultValueElement [1..*]: 0..255, origin=AUTOSAR_ECUC V1.0.0  # The default value consists of a number of elements. Each element is one byte long and the number of elements is specified by SduLength. The position of this parameter in the container specifies the byte position of the element within the default value.
          container PduRDestPdu [1..*]  # This container is a subcontainer of PduRRoutingPath and specifies one destination for the PDU to be routed.
            enumeration DataProvision [0..1]: {Direct, TriggerTransmit}, origin=AUTOSAR_ECUC V1.0.0  # Specifies how data are provided: direct (as part of the Transmit call) or via the TriggerTransmit callback function. Only required for non-TP gateway PDUs.
            reference def DestPduRef: lower-multiplicity=1, upper-multiplicity=1, origin=AUTOSAR_ECUC V1.0.0, destination=Pdu  # Destination PDU reference; reference to unique PDU identifier which shall be used by the PDU Router instead of the source PDU ID when calling the related function of the destination module.
            reference def TxBufferRef: lower-multiplicity=0, upper-multiplicity=1, origin=AUTOSAR_ECUC V1.0.0, destination=PduRTxBuffer  # Specifies the assigned transmit buffer. Only required for specific non-TP gateway PDUs.
          container PduRSrcPdu  # This container is a subcontainer of PduRRoutingPath and specifies the source of the PDU to be routed.
            integer HandleId: 0..65535, origin=AUTOSAR_ECUC V1.0.0, symbolic-name-value=true  # PDU identifier assigned by PDU Router.
            reference def SrcPduRef: lower-multiplicity=1, upper-multiplicity=1, origin=AUTOSAR_ECUC V1.0.0, destination=Pdu  # Source PDU reference; reference to unique PDU identifier which shall be used for the requested PDU Router operation.
      container PduRTpBufferTable [0..1]  # This container is a subcontainer of PduR and contains the definition of all TP buffers (only required for PDU Router gateway operation). This container shall only be considered by the PDU Router Configuration Generator if PduRGeneral/PDUR_GATEWAY_OPERATION is enabled.
        integer PduRMaxTpBufferNumber: 0..65535, origin=AUTOSAR_ECUC V1.0.0  # maximum number of TP buffers.
        container PduRTpBuffer [0..*]  # This container is a subcontainer of PduRTpBufferTable and specifies a TP buffer.
          integer Length: 1..65535, origin=AUTOSAR_ECUC V1.0.0  # Length of the buffer.
      container PduRTxBufferTable [0..1]  # This container is a subcontainer of PduR and contains the definition of all transmit buffers (used by specific non-TP PDUs; only required for PDU Router gateway operation). This container shall only be considered by the PDU Router Configuration Generator if PduRGeneral/PDUR_GATEWAY_OPERATION is enabled.
        integer PduRMaxTxBufferNumber: 0..65535, origin=AUTOSAR_ECUC V1.0.0  # maximum number of transmit buffers
        container PduRTxBuffer [0..*]  # This container is a subcontainer of PduRTxBufferTable and specifies a transmit buffer for a non-TP PDU.
          integer Depth: 0..255, origin=AUTOSAR_ECUC V1.0.0  # Specifies the depth of the buffer
          integer Length: 1..255, origin=AUTOSAR_ECUC V1.0.0  # Length of the buffer.
  module definition Port [0..1]  # Configuration of the Port module.
    container CommonPublishedInformation  # Common container, aggregated by all modules. It contains published information about vendor and versions.
      integer ArMajorVersion: implementation-config-class=PUBLISHED-INFORMATION, origin=AUTOSAR_ECUC V1.0.0  # Major version number of AUTOSAR specification on which the appropriate implementation is based on.
      integer ArMinorVersion: implementation-config-class=PUBLISHED-INFORMATION, origin=AUTOSAR_ECUC V1.0.0  # Minor version number of AUTOSAR specification on which the appropriate implementation is based on.
      integer ArPatchVersion: implementation-config-class=PUBLISHED-INFORMATION, origin=AUTOSAR_ECUC V1.0.0  # Patch level version number of AUTOSAR specification on which the appropriate implementation is based on.
      integer ModuleId: implementation-config-class=PUBLISHED-INFORMATION, origin=AUTOSAR_ECUC V1.0.0  # Module ID of this module from Module List
      integer SwMajorVersion: implementation-config-class=PUBLISHED-INFORMATION, origin=AUTOSAR_ECUC V1.0.0  # Major version number of the vendor specific implementation of the module. The numbering is vendor specific.
      integer SwMinorVersion: implementation-config-class=PUBLISHED-INFORMATION, origin=AUTOSAR_ECUC V1.0.0  # Minor version number of the vendor specific implementation of the module. The numbering is vendor specific.
      integer SwPatchVersion: implementation-config-class=PUBLISHED-INFORMATION, origin=AUTOSAR_ECUC V1.0.0  # Patch level version number of the vendor specific implementation of the module. The numbering is vendor specific.
      string VendorApiInfix [0..1]: implementation-config-class=PUBLISHED-INFORMATION, origin=AUTOSAR_ECUC V1.0.0  # In driver modules which can be instantiated several times on a single ECU, BSW00347 requires that the name of APIs is extended by the VendorId and a vendor specific name. This parameter is used to specify the vendor specific name. In total, the implementation specific name is generated as follows: <ModuleName>_>VendorId>_<VendorApiInfix><Api name from SWS>. E.g. assuming that the VendorId of the implementor is 123 and the implementer chose a VendorApiInfix of "v11r456" a api name Can_Write defined in the SWS will translate to Can_123_v11r456Write. This parameter is mandatory for all modules with upper multiplicity > 1. It shall not be used for modules with upper multiplicity =1.
      integer VendorId: implementation-config-class=PUBLISHED-INFORMATION, origin=AUTOSAR_ECUC V1.0.0  # Vendor ID of the dedicated implementation of this module according to the AUTOSAR vendor list
    container PortConfigSet  # This container is the base of a multiple configuration set
      container PortPin [1..*]  # Configuration of the individual port pins.
        enumeration PortPinDirection: {PortPinDirectionIn, PortPinDirectionOut}, origin=AUTOSAR_ECUC V1.0.0  # The initial direction of the pin (IN or OUT). If the direction is not changeable, the value configured here is fixed. The direction must match the pin mode. E.g. a pin used for an ADC must be configured to be an in port.
        boolean PortPinDirectionChangeable: origin=AUTOSAR_ECUC V1.0.0  # Parameter to indicate if the direction is changeable on a port pin during runtime.
        integer PortPinId: 0.., origin=AUTOSAR_ECUC V1.0.0, symbolic-name-value=true  # Pin Id of the port pin. This value will be assigned to the symbolic name derived from the port pin container short name.
        enumeration PortPinLevelValue: {PortPinLevelHigh, PortPinLevelLow}, origin=AUTOSAR_ECUC V1.0.0  # Port Pin Level value from Port pin list.
        enumeration PortPinMode: {PortPinModeAdc, PortPinModeCan, PortPinModeDio, PortPinModeDioGpt, PortPinModeDioWdg, PortPinModeFlexray, PortPinModeIcu, PortPinModeLin, PortPinModeMem, PortPinModePwm, PortPinModeSpi}, origin=AUTOSAR_ECUC V1.0.0  # Port pin mode from mode list. Note that more than one mode is allowed by default. That way it is e.g. possible to combine DIO with another mode such as ICU. More HW specific literals may be added by module implementor. E.g. SPI may be further broken down into SpiCsHw, SpiCsSw, etc. if necessary.
    container PortGeneral  # Module wide configuration parameters of the PORT driver.
      boolean PortDevErrorDetect: origin=AUTOSAR_ECUC V1.0.0  # Switches the Development Error Detection and Notification ON or OFF.
      boolean PortPinDirectionChangesAllowed: origin=AUTOSAR_ECUC V1.0.0  # Pre-processor switch to enable / disable the use of the function Port_SetPinDirection().
      boolean PortVersionInfoApi: origin=AUTOSAR_ECUC V1.0.0  # Pre-processor switch to enable / disable the API to read out the modules version information.
  module definition Pwm [0..*]  # Configuration of Pwm (Pulse Width Modulation) module.
    container CommonPublishedInformation  # Common container, aggregated by all modules. It contains published information about vendor and versions.
      integer ArMajorVersion: implementation-config-class=PUBLISHED-INFORMATION, origin=AUTOSAR_ECUC V1.0.0  # Major version number of AUTOSAR specification on which the appropriate implementation is based on.
      integer ArMinorVersion: implementation-config-class=PUBLISHED-INFORMATION, origin=AUTOSAR_ECUC V1.0.0  # Minor version number of AUTOSAR specification on which the appropriate implementation is based on.
      integer ArPatchVersion: implementation-config-class=PUBLISHED-INFORMATION, origin=AUTOSAR_ECUC V1.0.0  # Patch level version number of AUTOSAR specification on which the appropriate implementation is based on.
      integer ModuleId: implementation-config-class=PUBLISHED-INFORMATION, origin=AUTOSAR_ECUC V1.0.0  # Module ID of this module from Module List
      integer SwMajorVersion: implementation-config-class=PUBLISHED-INFORMATION, origin=AUTOSAR_ECUC V1.0.0  # Major version number of the vendor specific implementation of the module. The numbering is vendor specific.
      integer SwMinorVersion: implementation-config-class=PUBLISHED-INFORMATION, origin=AUTOSAR_ECUC V1.0.0  # Minor version number of the vendor specific implementation of the module. The numbering is vendor specific.
      integer SwPatchVersion: implementation-config-class=PUBLISHED-INFORMATION, origin=AUTOSAR_ECUC V1.0.0  # Patch level version number of the vendor specific implementation of the module. The numbering is vendor specific.
      string VendorApiInfix [0..1]: implementation-config-class=PUBLISHED-INFORMATION, origin=AUTOSAR_ECUC V1.0.0  # In driver modules which can be instantiated several times on a single ECU, BSW00347 requires that the name of APIs is extended by the VendorId and a vendor specific name. This parameter is used to specify the vendor specific name. In total, the implementation specific name is generated as follows: <ModuleName>_>VendorId>_<VendorApiInfix><Api name from SWS>. E.g. assuming that the VendorId of the implementor is 123 and the implementer chose a VendorApiInfix of "v11r456" a api name Can_Write defined in the SWS will translate to Can_123_v11r456Write. This parameter is mandatory for all modules with upper multiplicity > 1. It shall not be used for modules with upper multiplicity =1.
      integer VendorId: implementation-config-class=PUBLISHED-INFORMATION, origin=AUTOSAR_ECUC V1.0.0  # Vendor ID of the dedicated implementation of this module according to the AUTOSAR vendor list
    container PwmChannelConfigSet
      container PwmChannel [1..*]  # Configuration of an individual PWM channel.
        enumeration PwmChannelClass: {PwmFixedPeriod, PwmFixedPeriodShifted, PwmVariablePeriod}, origin=AUTOSAR_ECUC V1.0.0  # Class of PWM Channel.
        integer PwmChannelId: 0.., origin=AUTOSAR_ECUC V1.0.0, symbolic-name-value=true  # Channel Id of the PWM channel. This value will be assigned to the symbolic name derived of the PwmChannel container short name.
        integer PwmDutycycleDefault: 0..32768, origin=AUTOSAR_ECUC V1.0.0  # Value of duty cycle used for Initialization 0, represents 0% 0x8000 represents 100%
        enumeration PwmIdleState: {PwmIdleStateHigh, PwmIdleStateLow}, origin=AUTOSAR_ECUC V1.0.0  # Value of PWM output signal used for Initialization.
        function name PwmNotification: origin=AUTOSAR_ECUC V1.0.0, default-value="NULL"  # Definition of the Callback function.
        float PwmPeriodDefault: 0.., origin=AUTOSAR_ECUC V1.0.0  # Value of period used for Initialization.(in seconds).
        enumeration PwmPolarity: {PwmPolarityHigh, PwmPolarityLow}, origin=AUTOSAR_ECUC V1.0.0  # Defines the starting polarity of each PWM channel.
    container PwmConfigurationOfOptApiServices
      boolean PwmGetOutputState: origin=AUTOSAR_ECUC V1.1.0
      boolean PwmSetDutyCycle: origin=AUTOSAR_ECUC V1.1.0
      boolean PwmSetOutputToIdle: origin=AUTOSAR_ECUC V1.1.0
      boolean PwmSetPeriodAndDuty: origin=AUTOSAR_ECUC V1.1.0
    container PwmGeneral
      boolean PwmDevErorDetect: origin=AUTOSAR_ECUC V1.0.0  # Switch for enabling the development error detection.
      boolean PwmDutycycleUpdatedEndperiod: origin=AUTOSAR_ECUC V1.0.0  # Switch for enabling the update of the duty cycle parameter at the end of the current period
      boolean PwmNotificationSupported: origin=AUTOSAR_ECUC V1.0.0  # Switch to indicate that the notifications are supported
      boolean PwmPeriodUpdatedEndperiod: origin=AUTOSAR_ECUC V1.0.0  # Switch for enabling the update of the period parameter at the end of the current period
      boolean PwmVersionInfoApi: origin=AUTOSAR_ECUC V1.0.0  # Switch to indicate that the Pwm_ GetVersionInfo is supported
  module definition RamTst [0..1]  # Configuration of the RamTst module.
    container CommonPublishedInformation  # Common container, aggregated by all modules. It contains published information about vendor and versions.
      integer ArMajorVersion: implementation-config-class=PUBLISHED-INFORMATION, origin=AUTOSAR_ECUC V1.0.0  # Major version number of AUTOSAR specification on which the appropriate implementation is based on.
      integer ArMinorVersion: implementation-config-class=PUBLISHED-INFORMATION, origin=AUTOSAR_ECUC V1.0.0  # Minor version number of AUTOSAR specification on which the appropriate implementation is based on.
      integer ArPatchVersion: implementation-config-class=PUBLISHED-INFORMATION, origin=AUTOSAR_ECUC V1.0.0  # Patch level version number of AUTOSAR specification on which the appropriate implementation is based on.
      integer ModuleId: implementation-config-class=PUBLISHED-INFORMATION, origin=AUTOSAR_ECUC V1.0.0  # Module ID of this module from Module List
      integer SwMajorVersion: implementation-config-class=PUBLISHED-INFORMATION, origin=AUTOSAR_ECUC V1.0.0  # Major version number of the vendor specific implementation of the module. The numbering is vendor specific.
      integer SwMinorVersion: implementation-config-class=PUBLISHED-INFORMATION, origin=AUTOSAR_ECUC V1.0.0  # Minor version number of the vendor specific implementation of the module. The numbering is vendor specific.
      integer SwPatchVersion: implementation-config-class=PUBLISHED-INFORMATION, origin=AUTOSAR_ECUC V1.0.0  # Patch level version number of the vendor specific implementation of the module. The numbering is vendor specific.
      string VendorApiInfix [0..1]: implementation-config-class=PUBLISHED-INFORMATION, origin=AUTOSAR_ECUC V1.0.0  # In driver modules which can be instantiated several times on a single ECU, BSW00347 requires that the name of APIs is extended by the VendorId and a vendor specific name. This parameter is used to specify the vendor specific name. In total, the implementation specific name is generated as follows: <ModuleName>_>VendorId>_<VendorApiInfix><Api name from SWS>. E.g. assuming that the VendorId of the implementor is 123 and the implementer chose a VendorApiInfix of "v11r456" a api name Can_Write defined in the SWS will translate to Can_123_v11r456Write. This parameter is mandatory for all modules with upper multiplicity > 1. It shall not be used for modules with upper multiplicity =1.
      integer VendorId: implementation-config-class=PUBLISHED-INFORMATION, origin=AUTOSAR_ECUC V1.0.0  # Vendor ID of the dedicated implementation of this module according to the AUTOSAR vendor list
    container RamTstCommon  # This container contains all configuration parameter for the RamTest selectable at pre-compile time.
      boolean RamTstChangeNumOfTestedCellsApi: origin=AUTOSAR_ECUC V1.0.0  # Preprocessor switch to disable / enable the function "RamTst_ChangeNumberOfTestedCells"
      boolean RamTstChangeTestAlgorithmApi: origin=AUTOSAR_ECUC V1.0.0  # Preprocessor switch to disable / enable the function "RamTst_ChangeTestAlgorithm"
      boolean RamTstContinueApi: origin=AUTOSAR_ECUC V1.0.0  # Preprocessor switch to disable / enable the function "RamTst_Continue"
      boolean RamTstDevErrorDetect: origin=AUTOSAR_ECUC V1.0.0  # Preprocessor switch to select the development error tracer (DET) ON or OFF
      boolean RamTstGetExecutionStatusApi: origin=AUTOSAR_ECUC V1.0.0  # Preprocessor switch to disable / enable the function "RamTst_GetExecutionStatus"
      boolean RamTstGetNumberOfTestedCellsApi: origin=AUTOSAR_ECUC V1.0.0  # Preprocessor switch to disable / enable the function "RamTst_GetNumberOfTestedCells"
      boolean RamTstGetTestAlgorithmApi: origin=AUTOSAR_ECUC V1.0.0  # Preprocessor switch to disable / enable the function "RamTst_GetTestAlgorithm"
      boolean RamTstGetTestResultApi: origin=AUTOSAR_ECUC V1.0.0  # Preprocessor switch to disable / enable the function "RamTst_GetTestResult"
      boolean RamTstGetTestResultPerBlockApi: origin=AUTOSAR_ECUC V1.0.0  # Preprocessor switch to disable / enable the function "RamTst_GetTestResultPerBlock"
      boolean RamTstStopApi: origin=AUTOSAR_ECUC V1.0.0  # Preprocessor switch to disable / enable the function "RamTst_Stop"
      boolean RamTstVersionInfoApi: origin=AUTOSAR_ECUC V1.0.0  # Preprocessor switch to disable / enable the function "RamTst_GetVersionInfo"
      container RamTstAlgorithms  # A subset of supported RAM Test algorithms could be chosen in this container
        boolean RamTstAbrahamTestSelected: origin=AUTOSAR_ECUC V1.0.0  # Preprocessor switch to select the abraham test ON or OFF
        boolean RamTstCheckerboardTestSelected: origin=AUTOSAR_ECUC V1.0.0  # Preprocessor switch to select the checkerboard test ON or OFF
        string RamTstDataType: origin=AUTOSAR_ECUC V1.0.0  # Data type of tested RAM cells
        boolean RamTstGalpatTestSelected: origin=AUTOSAR_ECUC V1.0.0  # Preprocessor switch to select the galpat test ON or OFF
        boolean RamTstMarchTestSelected: origin=AUTOSAR_ECUC V1.0.0  # Preprocessor switch to select the march test ON or OFF
        boolean RamTstModHammingcodeTestSelected: origin=AUTOSAR_ECUC V1.0.0  # Preprocessor switch to select the modified hamming code test ON or OFF
        boolean RamTstTranspGalpatTestSelected: origin=AUTOSAR_ECUC V1.0.0  # Preprocessor switch to select the transparent galpat test ON or OFF
        boolean RamTstWalkPathTestSelected: origin=AUTOSAR_ECUC V1.0.0  # Preprocessor switch to select the walking path test ON or OFF
      container RamTstConfigParams  # The multiplicity of the included container depends on the pre-compile configuration in the container "RamTst_Algorithms"
        enumeration RamTstDefaultTestAlgorithm: {RAMTST_ABRAHAM_TEST, RAMTST_CHECKERBOARD_TEST, RAMTST_GALPAT_TEST, RAMTST_MARCH_TEST, RAMTST_MOD_HAMMINGCODE_TEST, RAMTST_TRANSP_GALPAT_TEST, RAMTST_WALK_PATH_TEST}, origin=AUTOSAR_ECUC V1.0.0  # This is the default algorithm after the "RamTst_Init(..)" function. This is the initial value for a RAM variable which could be changed by the function "RamTst_ChangeTestAlgorithm"
        derived integer RamTstNumberOfAlgorithms: origin=AUTOSAR_ECUC V1.1.0  # Number of configured algorithms in the Container "RamTst_Algorithms"
        function name RamTstTestCompletedNotification: origin=AUTOSAR_ECUC V1.0.0  # This function will be called after finishing the ram test without an error
        function name RamTstTestErrorNotification: origin=AUTOSAR_ECUC V1.0.0  # This function will be called if an error occurs during the ram test
        container RamTstAlgParams [1..*]  # This is the parameter container for an algorithm.
          integer RamTstAlgorithmId: origin=AUTOSAR_ECUC V1.0.0  # This is the algorithm ID
          derived integer RamTstNumberOfBlocks: origin=AUTOSAR_ECUC V1.0.0  # Number of ram blocks configured in the container "RamTst_BlockParams" calculationFormula = Count of enabled RamTstBlockParams
          integer RamTstNumberOfTestedCells: origin=AUTOSAR_ECUC V1.0.0  # This is the initial value for a RAM variable which could be changed by the function "RamTst_ChangeNumberOfTestedCells"
          container RamTstBlockParams [1..*]  # This container is used in the " RamTst_AlgParams" container
            integer RamTstBlockId: origin=AUTOSAR_ECUC V1.0.0  # ID of the RAM block
            integer RamTstEndAddress: origin=AUTOSAR_ECUC V1.0.0  # End Address of the RAM block
            integer RamTstStartAddress: origin=AUTOSAR_ECUC V1.0.0  # Start Address of the RAM block
  module definition Rte [0..1]  # Configuration of the Rte (Runtime Environment) module.
    container CalprmComponentInstance [0..*]  # Specifies for each CalprmComponentType whether calibration is enabled.
      boolean CalibrationSupportEnabled: origin=AUTOSAR_ECUC V1.1.0  # Enables calibration support for the specified CalprmComponentType instance.
      instance reference CalprmComponentInstanceRef: origin=AUTOSAR_ECUC V1.1.0, destination-context=ComponentPrototype*, destination-type=ComponentPrototype  # Reference to the CalprmComponentType instance.
    container CommonPublishedInformation  # Common container, aggregated by all modules. It contains published information about vendor and versions.
      integer ArMajorVersion: implementation-config-class=PUBLISHED-INFORMATION, origin=AUTOSAR_ECUC V1.0.0  # Major version number of AUTOSAR specification on which the appropriate implementation is based on.
      integer ArMinorVersion: implementation-config-class=PUBLISHED-INFORMATION, origin=AUTOSAR_ECUC V1.0.0  # Minor version number of AUTOSAR specification on which the appropriate implementation is based on.
      integer ArPatchVersion: implementation-config-class=PUBLISHED-INFORMATION, origin=AUTOSAR_ECUC V1.0.0  # Patch level version number of AUTOSAR specification on which the appropriate implementation is based on.
      integer ModuleId: implementation-config-class=PUBLISHED-INFORMATION, origin=AUTOSAR_ECUC V1.0.0  # Module ID of this module from Module List
      integer SwMajorVersion: implementation-config-class=PUBLISHED-INFORMATION, origin=AUTOSAR_ECUC V1.0.0  # Major version number of the vendor specific implementation of the module. The numbering is vendor specific.
      integer SwMinorVersion: implementation-config-class=PUBLISHED-INFORMATION, origin=AUTOSAR_ECUC V1.0.0  # Minor version number of the vendor specific implementation of the module. The numbering is vendor specific.
      integer SwPatchVersion: implementation-config-class=PUBLISHED-INFORMATION, origin=AUTOSAR_ECUC V1.0.0  # Patch level version number of the vendor specific implementation of the module. The numbering is vendor specific.
      string VendorApiInfix [0..1]: implementation-config-class=PUBLISHED-INFORMATION, origin=AUTOSAR_ECUC V1.0.0  # In driver modules which can be instantiated several times on a single ECU, BSW00347 requires that the name of APIs is extended by the VendorId and a vendor specific name. This parameter is used to specify the vendor specific name. In total, the implementation specific name is generated as follows: <ModuleName>_>VendorId>_<VendorApiInfix><Api name from SWS>. E.g. assuming that the VendorId of the implementor is 123 and the implementer chose a VendorApiInfix of "v11r456" a api name Can_Write defined in the SWS will translate to Can_123_v11r456Write. This parameter is mandatory for all modules with upper multiplicity > 1. It shall not be used for modules with upper multiplicity =1.
      integer VendorId: implementation-config-class=PUBLISHED-INFORMATION, origin=AUTOSAR_ECUC V1.0.0  # Vendor ID of the dedicated implementation of this module according to the AUTOSAR vendor list
    container RteGeneration  # This container holds the parameters for the configuration of the RTE Generator tool itself.
      enumeration RteCalibrationSupport: {doublePointered, initializedRam, none, singlePointered}, origin=AUTOSAR_ECUC V1.1.0  # The RTE generator shall have the option to switch off support for calibration for generated RTE code. This option shall influence complete RTE code at once.
      enumeration RteGenerationMode: {CompatibilityMode, VendorMode}, origin=AUTOSAR_ECUC V1.0.0  # Switch between the two available generation modes of the RTE generator.
      boolean RteMeasurementSupport: origin=AUTOSAR_ECUC V1.1.0  # The RTE generator shall have the option to switch off support for measurement for generated RTE code. This option shall influence complete RTE code at once.
      enumeration RteOptimizationMode: {Memory, Runtime}, origin=AUTOSAR_ECUC V1.1.0  # Switch between the two available optimization modes of the RTE generator.
      integer RteVfbTrace: origin=AUTOSAR_ECUC V1.0.0  # The RTE generator shall globally enable VFB tracing when RTE_VFB_TRACE is defined in the RTE configuration header file as a non-zero integer. The RTE generator shall globally disable VFB tracing when RTE_VFB_TRACE is defined in the RTE configuration header file as 0.
      function name RteVfbTraceFunction [0..*]: origin=AUTOSAR_ECUC V1.0.0  # The RTE generator shall enable VFB tracing for a given hook function when there is a #define in the RTE configuration header file for the hook function name and tracing is globally enabled. Example: #define Rte_WriteHook_i1_p1_a_Start
    container SwComponentInstance [1..*]  # Representation of one SW-Component instance located on the to be configured ECU. All Rte configuration aspects are in relation to this SW-Component instance.
      foreign reference ImplementationRef: origin=AUTOSAR_ECUC V1.0.0, destination-type=Implementation  # The Implementation which is assiged to the ComponentPrototype.
      instance reference SoftwareComponentInstanceRef: origin=AUTOSAR_ECUC V1.1.0, destination-context=ComponentPrototype*, destination-type=ComponentPrototype  # Reference to a SW-Component ComponentPrototype. Semantic Constraint: Only ComponentPrototypes which have an AtomicSoftwareComponentType as <<isOfType>> shall be referenced here.
      container ExclusiveAreaImplementation [0..*]  # Specifies the implementation to be used for the data consistency of this ExclusiveArea.
        enumeration ExclusiveAreaImplMechanism: {CooperativeRunnablePlacement, InterruptBlocking, NonPreemptiveTasks, OsResource}, origin=AUTOSAR_ECUC V1.1.0  # To be used implementation mechanism for the specified ExclusiveArea.
        foreign reference ExclusiveAreaRef: origin=AUTOSAR_ECUC V1.1.0, destination-type=ExclusiveArea  # Reference to the ExclusiveArea.
      container NVRamAllocation [0..*]  # Specifies the relationship between the SW-Components NVRAMMapping / NVRAM needs and the NvM module configuration.
        string RamBlockLocationSymbol [0..1]: origin=AUTOSAR_ECUC V1.1.0  # This is the name of the linker object name where the NVRam Block will be mirrored by the Nvm. This symbol will be resolved into the parameter "NvmRamBlockDataAddress" from the "NvmBlockDescriptor".
        string RomBlockLocationSymbol [0..1]: origin=AUTOSAR_ECUC V1.1.0  # This is the name of the linker object name where the NVRom Block will be accessed by the Nvm. This symbol will be resolved into the parameter "NvmRomBlockDataAddress" from the "NvmBlockDescriptor".
        instance reference SwNvRamMappingReference: origin=AUTOSAR_ECUC V1.1.0, destination-context=ComponentPrototype*, destination-type=NVRAMMapping  # Reference to the NVRAMMapping instance to be configured.
        symbolic name reference NvmBlockRef: origin=AUTOSAR_ECUC V1.1.0, destination=NvmBlockDescriptor  # Reference to the used NvM block for storage of the NVRAMMapping information.
      container RunnableEntityMapping [0..*]  # Maps a RunnableEntity onto one OS Task based on the activating RTEEvent. Even if a RunnableEntity is executed in the caller's context this RunnableEntityMapping shall be specified, but no MappedToTask and PositionInTask elements given.
        float ActivationOffset [0..1]: origin=AUTOSAR_ECUC V1.1.0  # Activation offset in seconds.
        integer PositionInTask [0..1]: origin=AUTOSAR_ECUC V1.0.0  # Each RunnableEntities mapped to an OsTask has a specific position within the task execution. For periodic activation this is the order of execution. For event driver activation this is the order of evaluation which actual RunnableEntity has to be executed.
        foreign reference RTEEventRef: origin=AUTOSAR_ECUC V1.0.0, destination-type=RTEEvent  # Reference to the description of the RTEEvent which is pointing to the RunnableEntity being mapped. This allows a fine grained mapping of RunnableEntites based on the activating RTEEvent.
        reference def MappedToTaskRef: lower-multiplicity=0, upper-multiplicity=1, origin=AUTOSAR_ECUC V1.0.0, destination=OsTask  # Reference to the OsTask the RunnableEntity is mapped to. If no reference to the OsTask is specified the RunnableEntity is executed in the context of the caller.
        reference def UsedOsEventRef: lower-multiplicity=0, upper-multiplicity=1, origin=AUTOSAR_ECUC V1.0.0, destination=OsEvent  # If an OsEvent is used to activate the RunnableEntity it shall be referenced here.
  module definition SchM [0..1]  # Configuration of the SchM (BSW Scheduler) module.
    container CommonPublishedInformation  # Common container, aggregated by all modules. It contains published information about vendor and versions.
      integer ArMajorVersion: implementation-config-class=PUBLISHED-INFORMATION, origin=AUTOSAR_ECUC V1.0.0  # Major version number of AUTOSAR specification on which the appropriate implementation is based on.
      integer ArMinorVersion: implementation-config-class=PUBLISHED-INFORMATION, origin=AUTOSAR_ECUC V1.0.0  # Minor version number of AUTOSAR specification on which the appropriate implementation is based on.
      integer ArPatchVersion: implementation-config-class=PUBLISHED-INFORMATION, origin=AUTOSAR_ECUC V1.0.0  # Patch level version number of AUTOSAR specification on which the appropriate implementation is based on.
      integer ModuleId: implementation-config-class=PUBLISHED-INFORMATION, origin=AUTOSAR_ECUC V1.0.0  # Module ID of this module from Module List
      integer SwMajorVersion: implementation-config-class=PUBLISHED-INFORMATION, origin=AUTOSAR_ECUC V1.0.0  # Major version number of the vendor specific implementation of the module. The numbering is vendor specific.
      integer SwMinorVersion: implementation-config-class=PUBLISHED-INFORMATION, origin=AUTOSAR_ECUC V1.0.0  # Minor version number of the vendor specific implementation of the module. The numbering is vendor specific.
      integer SwPatchVersion: implementation-config-class=PUBLISHED-INFORMATION, origin=AUTOSAR_ECUC V1.0.0  # Patch level version number of the vendor specific implementation of the module. The numbering is vendor specific.
      string VendorApiInfix [0..1]: implementation-config-class=PUBLISHED-INFORMATION, origin=AUTOSAR_ECUC V1.0.0  # In driver modules which can be instantiated several times on a single ECU, BSW00347 requires that the name of APIs is extended by the VendorId and a vendor specific name. This parameter is used to specify the vendor specific name. In total, the implementation specific name is generated as follows: <ModuleName>_>VendorId>_<VendorApiInfix><Api name from SWS>. E.g. assuming that the VendorId of the implementor is 123 and the implementer chose a VendorApiInfix of "v11r456" a api name Can_Write defined in the SWS will translate to Can_123_v11r456Write. This parameter is mandatory for all modules with upper multiplicity > 1. It shall not be used for modules with upper multiplicity =1.
      integer VendorId: implementation-config-class=PUBLISHED-INFORMATION, origin=AUTOSAR_ECUC V1.0.0  # Vendor ID of the dedicated implementation of this module according to the AUTOSAR vendor list
    container SchMConfiguration  # Top container for the entire configuration set.
      boolean SchMDevErrorDetect: origin=AUTOSAR_ECUC V1.1.0  # Switches the Development Error Detection and Notification ON or OFF.
      boolean SchMVersionInfoApi: origin=AUTOSAR_ECUC V1.1.0  # Switches the service SchM_GetVersionInfo ON or OFF.
      container SchMMainFunctionMapping [1..*]  # Maps a MainFunction onto one OS Task.
        integer SchMPositionInTask: 0..255, origin=AUTOSAR_ECUC V1.1.0  # The parameter depicts the specific Position of the MainFunction within the OS Task. The dependencies between the main processing functions mapped to the same task have been resolved by the configuration (process) beforehand. The result of this resolution is the order of the main processing functions within this task.
        foreign reference SchMMainFunctionRef: origin=AUTOSAR_ECUC V1.1.0, destination-type=BSWMD-T  # The parameter depicts the reference to the MainFunction. TODO: destinationType should be pointing to a structure within the BSWMD. BSWMD-T not yet defined.
        reference def SchMMappedToTask: lower-multiplicity=1, upper-multiplicity=1, origin=AUTOSAR_ECUC V1.1.0, destination=OsTask  # The parameter depicts the reference to the OS Task the MainFunction is mapped to.
        reference def SchMModeRef: lower-multiplicity=1, upper-multiplicity=1, origin=AUTOSAR_ECUC V1.1.0  # This parameter is supposed to reference to a particular Mode. Since Modes are not currently introduced in AUTOSAR this reference can not be used.
        container ScheduleTableMapping [0..*]  # Assigns a MainFunction to a OS Schedule Table
          reference def SchMScheduletableRef: lower-multiplicity=1, upper-multiplicity=1, origin=AUTOSAR_ECUC V1.1.0, destination=OsScheduleTable  # The parameter depicts the reference to the OS SchedulaTable the MainFunction is mapped to.
      container SchMModuleConfiguration [0..*]  # Contains module specific configuration items.
        string SchMModuleLiteral: origin=AUTOSAR_ECUC V1.1.0  # The parameter depicts a symbolic name (a literal) for the unambigous identification of a BSW module; in fact it is the <ModulePrefix> specified for each BSW module in the Basic Software Module List.
        container InstanceConfiguration [1..*]  # Contains instance specific configuration items. One instance of this container for each instance of the module.
          integer SchMInstanceId: origin=AUTOSAR_ECUC V1.1.0  # The parameter depicts a value for the unambigous identification of a BSW module instance.
          string SchMInstanceLiteral: origin=AUTOSAR_ECUC V1.1.0  # The parameter depicts a symbolic name for the unambigous identification of a BSW module instance.
          container ActivationPointConf [0..*]  # Contains configuration items of ActivationPoints in the context of a BSW module.
            integer SchMActivationId: origin=AUTOSAR_ECUC V1.1.0  # The parameter depicts a value for the unambigous identification of an ActivationPoint.
            string SchMActivationLiteral: origin=AUTOSAR_ECUC V1.1.0  # The parameter depicts a symbolic name for the unambigous identification of an ActivationPoint.
          container CancelationPointConf [0..*]  # Contains configuration items of CancelationPoints in the context of a BSW module.
            integer SchMCancelationId: origin=AUTOSAR_ECUC V1.1.0  # The parameter depicts a value for the unambigous identification of an CancelationPoint.
            string SchMCancelationLiteral: origin=AUTOSAR_ECUC V1.1.0  # The parameter depicts a symbolic name for the unambigous identification of a CancelationPoint.
          container ExclusiveAreaConf [0..*]  # Contains configuration items of critical sections (ExclusiveArea) in the context of a BSW module.
            integer SchMExclusiveAreaId: origin=AUTOSAR_ECUC V1.1.0  # The parameter depicts a value for the unambigous identification of an ExclusiveArea.
            string SchMExclusiveAreaLiteral: origin=AUTOSAR_ECUC V1.1.0  # The parameter depicts a symbolic name for the unambigous identification of an ExclusiveArea.
          container SporadicEventConf [0..*]  # Contains configuration items of SporadicEvents.
            integer DelayTime: origin=AUTOSAR_ECUC V1.1.0  # The parameter depicts the minimum delay time until a main processing functions shall be activated. This configuration parameter is an input for integration. It represents the base for the real, implementation specific values.
            string SchMSporadicLiteral: origin=AUTOSAR_ECUC V1.1.0  # The parameter depicts a symbolic name dfor the unambiguous identification of a sporadiv event.
  module definition Spi [0..1]  # Configuration of the Spi (Serial Peripheral Interface) module.
    container CommonPublishedInformation  # Common container, aggregated by all modules. It contains published information about vendor and versions.
      integer ArMajorVersion: implementation-config-class=PUBLISHED-INFORMATION, origin=AUTOSAR_ECUC V1.0.0  # Major version number of AUTOSAR specification on which the appropriate implementation is based on.
      integer ArMinorVersion: implementation-config-class=PUBLISHED-INFORMATION, origin=AUTOSAR_ECUC V1.0.0  # Minor version number of AUTOSAR specification on which the appropriate implementation is based on.
      integer ArPatchVersion: implementation-config-class=PUBLISHED-INFORMATION, origin=AUTOSAR_ECUC V1.0.0  # Patch level version number of AUTOSAR specification on which the appropriate implementation is based on.
      integer ModuleId: implementation-config-class=PUBLISHED-INFORMATION, origin=AUTOSAR_ECUC V1.0.0  # Module ID of this module from Module List
      integer SwMajorVersion: implementation-config-class=PUBLISHED-INFORMATION, origin=AUTOSAR_ECUC V1.0.0  # Major version number of the vendor specific implementation of the module. The numbering is vendor specific.
      integer SwMinorVersion: implementation-config-class=PUBLISHED-INFORMATION, origin=AUTOSAR_ECUC V1.0.0  # Minor version number of the vendor specific implementation of the module. The numbering is vendor specific.
      integer SwPatchVersion: implementation-config-class=PUBLISHED-INFORMATION, origin=AUTOSAR_ECUC V1.0.0  # Patch level version number of the vendor specific implementation of the module. The numbering is vendor specific.
      string VendorApiInfix [0..1]: implementation-config-class=PUBLISHED-INFORMATION, origin=AUTOSAR_ECUC V1.0.0  # In driver modules which can be instantiated several times on a single ECU, BSW00347 requires that the name of APIs is extended by the VendorId and a vendor specific name. This parameter is used to specify the vendor specific name. In total, the implementation specific name is generated as follows: <ModuleName>_>VendorId>_<VendorApiInfix><Api name from SWS>. E.g. assuming that the VendorId of the implementor is 123 and the implementer chose a VendorApiInfix of "v11r456" a api name Can_Write defined in the SWS will translate to Can_123_v11r456Write. This parameter is mandatory for all modules with upper multiplicity > 1. It shall not be used for modules with upper multiplicity =1.
      integer VendorId: implementation-config-class=PUBLISHED-INFORMATION, origin=AUTOSAR_ECUC V1.0.0  # Vendor ID of the dedicated implementation of this module according to the AUTOSAR vendor list
    container SpiDriver
      container SpiChannel [1..*]  # All data needed to configure one SPI-channel
        integer SpiChannelId: origin=AUTOSAR_ECUC V1.0.0, symbolic-name-value=true
        enumeration SpiChannelType: {EB, IB}, origin=AUTOSAR_ECUC V1.0.0  # Buffer usage with EB/IB channel
        integer SpiDataWidth: 1..32, origin=AUTOSAR_ECUC V1.0.0  # This parameter is the width of a transmitted data unit.
        integer SpiDefaultData: origin=AUTOSAR_ECUC V1.0.0  # This parameter is the default value to transmit.
        integer SpiEbMaxLength: origin=AUTOSAR_ECUC V1.0.0  # This parameter contains the maximum size of data buffers in case of EB Channels and only.
        integer SpiIbNBuffers: origin=AUTOSAR_ECUC V1.0.0  # This parameter contains the maximum number of data buffers in case of IB Channels and only.
        enumeration SpiTransferStart: {LSB, MSB}, origin=AUTOSAR_ECUC V1.0.0  # This parameter defines the first starting bit for transmission.
      container SpiExternalDevice [1..*]  # The communication settings of an external device. Closely linked to SpiJob.
        float SpiBaudrate: origin=AUTOSAR_ECUC V1.0.0  # This parameter is the communication baudrate - This parameter allows using a range of values, from the point of view of configuration tools, from Hz up to MHz.
        string SpiCs: origin=AUTOSAR_ECUC V1.0.0
        enumeration SpiCsPolarity: {High, Low}, origin=AUTOSAR_ECUC V1.0.0  # This parameter defines the active polarity of Chip Select.
        enumeration SpiDataShiftEdge: {Leading, Trailing}, origin=AUTOSAR_ECUC V1.0.0  # This parameter defines the SPI data shift edge.
        boolean SpiEnableCs: origin=AUTOSAR_ECUC V1.0.0  # This parameter enables or not the Chip Select handling functions. It will be removed in next release of SWS
        enumeration SpiShiftClockIdleLevel: {High, Low}, origin=AUTOSAR_ECUC V1.0.0  # This parameter defines the SPI shift clock idle level.
        float SpiTimeClk2Cs: 0..100, origin=AUTOSAR_ECUC V1.0.0  # Timing between clock and chip select - This parameter allows to use a range of values from 0 up to 100 microSec. the real configuration-value used in software BSW-SPI is calculated out of this by the generator-tools
      container SpiJob [1..*]  # All data needed to configure one SPI-Job, amongst others the connection between the internal SPI unit and the special settings for an external device is done.
        string SpiHwUnit: origin=AUTOSAR_ECUC V1.0.0  # This parameter is the symbolic name to identify the HW SPI Hardware microcontroller peripheral allocated to this Job.
        function name SpiJobEndNotification: origin=AUTOSAR_ECUC V1.0.0  # This parameter is a reference to a notification function.
        integer SpiJobId: origin=AUTOSAR_ECUC V1.0.0, symbolic-name-value=true
        integer SpiJobPriority: 0..3, origin=AUTOSAR_ECUC V1.0.0  # Priority of the Job
        reference def ChannelAssignment: lower-multiplicity=1, upper-multiplicity=*, origin=AUTOSAR_ECUC V1.0.0, destination=SpiChannel  # A job references several channels.
        reference def DeviceAssignment: lower-multiplicity=1, upper-multiplicity=1, origin=AUTOSAR_ECUC V1.0.0, destination=SpiExternalDevice  # Reference to the external device used by this job
      container SpiSequence [1..*]  # All data needed to configure one SPI-sequence
        boolean SpiInterruptibleSequence: origin=AUTOSAR_ECUC V1.0.0  # This parameter allows or not this Sequence to be suspended by another one.
        function name SpiSeqEndNotification: origin=AUTOSAR_ECUC V1.0.0  # This parameter is a reference to a notification function.
        integer SpiSequenceId: origin=AUTOSAR_ECUC V1.0.0, symbolic-name-value=true
        reference def JobAssignment: lower-multiplicity=1, upper-multiplicity=*, origin=AUTOSAR_ECUC V1.0.0, destination=SpiJob  # A sequence references several jobs, which are executed during a communication sequence
    container SpiGeneral  # General configuration settings for SPI-Handler
      boolean SpiCancelApi: origin=AUTOSAR_ECUC V1.0.0  # Switches the Spi_Cancel function ON or OFF.
      integer SpiChannelBuffersAllowed: 0..2, origin=AUTOSAR_ECUC V1.0.0  # Selects the SPI Handler/Driver Channel Buffers usage allowed and delivered.
      boolean SpiDevErrorDetect: origin=AUTOSAR_ECUC V1.0.0  # Switches the Development Error Detection and Notification ON or OFF.
      boolean SpiHwStatusApi: origin=AUTOSAR_ECUC V1.0.0  # Switches the Spi_GetHWUnitStatus function ON or OFF.
      boolean SpiInterruptibleSeqAllowed: origin=AUTOSAR_ECUC V1.0.0  # Switches the Interruptible Sequences handling functionality ON or OFF.
      integer SpiLevelDelivered: 0..2, origin=AUTOSAR_ECUC V1.0.0  # Selects the SPI Handler/Driver level of scalable functionality that is available and delivered.
      boolean SpiVersionInfoApi: origin=AUTOSAR_ECUC V1.0.0  # Switches the Spi_GetVersionInfo function ON or OFF.
  module definition Wdg [0..*]  # Configuration of the Wdg (Watchdog driver) module. This should be the extern watchdog driver. For internal watchdogs, no port pins / DIO is used.
    container CommonPublishedInformation  # Common container, aggregated by all modules. It contains published information about vendor and versions.
      integer ArMajorVersion: implementation-config-class=PUBLISHED-INFORMATION, origin=AUTOSAR_ECUC V1.0.0  # Major version number of AUTOSAR specification on which the appropriate implementation is based on.
      integer ArMinorVersion: implementation-config-class=PUBLISHED-INFORMATION, origin=AUTOSAR_ECUC V1.0.0  # Minor version number of AUTOSAR specification on which the appropriate implementation is based on.
      integer ArPatchVersion: implementation-config-class=PUBLISHED-INFORMATION, origin=AUTOSAR_ECUC V1.0.0  # Patch level version number of AUTOSAR specification on which the appropriate implementation is based on.
      integer ModuleId: implementation-config-class=PUBLISHED-INFORMATION, origin=AUTOSAR_ECUC V1.0.0  # Module ID of this module from Module List
      integer SwMajorVersion: implementation-config-class=PUBLISHED-INFORMATION, origin=AUTOSAR_ECUC V1.0.0  # Major version number of the vendor specific implementation of the module. The numbering is vendor specific.
      integer SwMinorVersion: implementation-config-class=PUBLISHED-INFORMATION, origin=AUTOSAR_ECUC V1.0.0  # Minor version number of the vendor specific implementation of the module. The numbering is vendor specific.
      integer SwPatchVersion: implementation-config-class=PUBLISHED-INFORMATION, origin=AUTOSAR_ECUC V1.0.0  # Patch level version number of the vendor specific implementation of the module. The numbering is vendor specific.
      string VendorApiInfix [0..1]: implementation-config-class=PUBLISHED-INFORMATION, origin=AUTOSAR_ECUC V1.0.0  # In driver modules which can be instantiated several times on a single ECU, BSW00347 requires that the name of APIs is extended by the VendorId and a vendor specific name. This parameter is used to specify the vendor specific name. In total, the implementation specific name is generated as follows: <ModuleName>_>VendorId>_<VendorApiInfix><Api name from SWS>. E.g. assuming that the VendorId of the implementor is 123 and the implementer chose a VendorApiInfix of "v11r456" a api name Can_Write defined in the SWS will translate to Can_123_v11r456Write. This parameter is mandatory for all modules with upper multiplicity > 1. It shall not be used for modules with upper multiplicity =1.
      integer VendorId: implementation-config-class=PUBLISHED-INFORMATION, origin=AUTOSAR_ECUC V1.0.0  # Vendor ID of the dedicated implementation of this module according to the AUTOSAR vendor list
    container WdgGeneral  # All general parameters of the watchdog driver are collected here.
      boolean WdgDevErrorDetect: origin=AUTOSAR_ECUC V1.0.0  # Compile switch to enable / disable development error detection for this module.
      boolean WdgDisableAllowed: origin=AUTOSAR_ECUC V1.0.0  # Compile switch to allow / forbid disabling the watchdog driver during runtime.
      integer WdgIndex: origin=AUTOSAR_ECUC V1.0.0, symbolic-name-value=true  # Represents the watchdog driver's ID so that it can be referenced by the watchdog interface.
      function name WdgTriggerLocation: origin=AUTOSAR_ECUC V1.0.0  # Location (memory address) of the watchdog trigger routine.
      boolean WdgVersionInfoApi: origin=AUTOSAR_ECUC V1.0.0  # Compile switch to enable / disable the version information API
    container WdgModeConfig  # Configuration items for the different watchdog modes
      enumeration WdgDefaultMode: {FastMode, OffMode, SlowMode}, origin=AUTOSAR_ECUC V1.1.0  # Default mode for watchdog driver initialization
      container WdgSettingsFast  # Hardware dependent settings for the watchdog driver's "fast" mode.
      container WdgSettingsOff  # Hardware dependent settings for the watchdog driver's "off" mode.
      container WdgSettingsSlow  # Hardware dependent settings for the watchdog driver's "slow" mode.
    container WdgPublishedInformation  # Container holding all Wdg specific published information parameters
      float WdgMaxTimeout [0..1]: implementation-config-class=PUBLISHED-INFORMATION, origin=AUTOSAR_ECUC V1.1.0  # Maximum timeout period in [s].
      float WdgMinTimeout [0..1]: implementation-config-class=PUBLISHED-INFORMATION, origin=AUTOSAR_ECUC V1.1.0  # Minimum timeout period in [s].
      float WdgResolution [0..1]: implementation-config-class=PUBLISHED-INFORMATION, origin=AUTOSAR_ECUC V1.1.0  # Resolution of watchdog timeout period in [s].
      enumeration WdgTriggerMode: {WdgBoth, WdgToggle, WdgWindow}, implementation-config-class=PUBLISHED-INFORMATION, origin=AUTOSAR_ECUC V1.1.0  # Watchdog trigger mode (toggle/window/both)
      container WdgTimeoutList [0..1]  # List of selectable timeout periods in [s].
        float WdgTimeoutPeriod [1..*]: implementation-config-class=PUBLISHED-INFORMATION, origin=AUTOSAR_ECUC V1.1.0  # A single timeout period onto the Wdg can be configured.
  module definition WdgIf [0..1]  # Configuration of the WdgIf (Watchdog Interface) module.
    container CommonPublishedInformation  # Common container, aggregated by all modules. It contains published information about vendor and versions.
      integer ArMajorVersion: implementation-config-class=PUBLISHED-INFORMATION, origin=AUTOSAR_ECUC V1.0.0  # Major version number of AUTOSAR specification on which the appropriate implementation is based on.
      integer ArMinorVersion: implementation-config-class=PUBLISHED-INFORMATION, origin=AUTOSAR_ECUC V1.0.0  # Minor version number of AUTOSAR specification on which the appropriate implementation is based on.
      integer ArPatchVersion: implementation-config-class=PUBLISHED-INFORMATION, origin=AUTOSAR_ECUC V1.0.0  # Patch level version number of AUTOSAR specification on which the appropriate implementation is based on.
      integer ModuleId: implementation-config-class=PUBLISHED-INFORMATION, origin=AUTOSAR_ECUC V1.0.0  # Module ID of this module from Module List
      integer SwMajorVersion: implementation-config-class=PUBLISHED-INFORMATION, origin=AUTOSAR_ECUC V1.0.0  # Major version number of the vendor specific implementation of the module. The numbering is vendor specific.
      integer SwMinorVersion: implementation-config-class=PUBLISHED-INFORMATION, origin=AUTOSAR_ECUC V1.0.0  # Minor version number of the vendor specific implementation of the module. The numbering is vendor specific.
      integer SwPatchVersion: implementation-config-class=PUBLISHED-INFORMATION, origin=AUTOSAR_ECUC V1.0.0  # Patch level version number of the vendor specific implementation of the module. The numbering is vendor specific.
      string VendorApiInfix [0..1]: implementation-config-class=PUBLISHED-INFORMATION, origin=AUTOSAR_ECUC V1.0.0  # In driver modules which can be instantiated several times on a single ECU, BSW00347 requires that the name of APIs is extended by the VendorId and a vendor specific name. This parameter is used to specify the vendor specific name. In total, the implementation specific name is generated as follows: <ModuleName>_>VendorId>_<VendorApiInfix><Api name from SWS>. E.g. assuming that the VendorId of the implementor is 123 and the implementer chose a VendorApiInfix of "v11r456" a api name Can_Write defined in the SWS will translate to Can_123_v11r456Write. This parameter is mandatory for all modules with upper multiplicity > 1. It shall not be used for modules with upper multiplicity =1.
      integer VendorId: implementation-config-class=PUBLISHED-INFORMATION, origin=AUTOSAR_ECUC V1.0.0  # Vendor ID of the dedicated implementation of this module according to the AUTOSAR vendor list
    container WdgIfGeneral  # This container collects all generic watchdog interface parameters.
      boolean WdgIfDevErrorDetect: origin=AUTOSAR_ECUC V1.0.0  # Pre-processor switch for enabling the development error detection and reporting
      integer WdgIfNumberOfDevices: 1..255, origin=AUTOSAR_ECUC V1.0.0  # Constant specifying the number of controlled watchdog drivers. Can be calculated by counting the no. of references to the watchdog drivers.
      boolean WdgIfVersionInfoApi: origin=AUTOSAR_ECUC V1.0.0  # Pre-processor switch to enable / disable the service returning the version information.
      symbolic name reference WdgRef [1..*]: origin=AUTOSAR_ECUC V1.1.0, destination=WdgGeneral  # Reference to the watchdog drivers that are controlled by the watchdog interface.
  module definition WdgM [0..1]  # Configuration of the WdgM (Watchdog Manager) module.
    container CommonPublishedInformation  # Common container, aggregated by all modules. It contains published information about vendor and versions.
      integer ArMajorVersion: implementation-config-class=PUBLISHED-INFORMATION, origin=AUTOSAR_ECUC V1.0.0  # Major version number of AUTOSAR specification on which the appropriate implementation is based on.
      integer ArMinorVersion: implementation-config-class=PUBLISHED-INFORMATION, origin=AUTOSAR_ECUC V1.0.0  # Minor version number of AUTOSAR specification on which the appropriate implementation is based on.
      integer ArPatchVersion: implementation-config-class=PUBLISHED-INFORMATION, origin=AUTOSAR_ECUC V1.0.0  # Patch level version number of AUTOSAR specification on which the appropriate implementation is based on.
      integer ModuleId: implementation-config-class=PUBLISHED-INFORMATION, origin=AUTOSAR_ECUC V1.0.0  # Module ID of this module from Module List
      integer SwMajorVersion: implementation-config-class=PUBLISHED-INFORMATION, origin=AUTOSAR_ECUC V1.0.0  # Major version number of the vendor specific implementation of the module. The numbering is vendor specific.
      integer SwMinorVersion: implementation-config-class=PUBLISHED-INFORMATION, origin=AUTOSAR_ECUC V1.0.0  # Minor version number of the vendor specific implementation of the module. The numbering is vendor specific.
      integer SwPatchVersion: implementation-config-class=PUBLISHED-INFORMATION, origin=AUTOSAR_ECUC V1.0.0  # Patch level version number of the vendor specific implementation of the module. The numbering is vendor specific.
      string VendorApiInfix [0..1]: implementation-config-class=PUBLISHED-INFORMATION, origin=AUTOSAR_ECUC V1.0.0  # In driver modules which can be instantiated several times on a single ECU, BSW00347 requires that the name of APIs is extended by the VendorId and a vendor specific name. This parameter is used to specify the vendor specific name. In total, the implementation specific name is generated as follows: <ModuleName>_>VendorId>_<VendorApiInfix><Api name from SWS>. E.g. assuming that the VendorId of the implementor is 123 and the implementer chose a VendorApiInfix of "v11r456" a api name Can_Write defined in the SWS will translate to Can_123_v11r456Write. This parameter is mandatory for all modules with upper multiplicity > 1. It shall not be used for modules with upper multiplicity =1.
      integer VendorId: implementation-config-class=PUBLISHED-INFORMATION, origin=AUTOSAR_ECUC V1.0.0  # Vendor ID of the dedicated implementation of this module according to the AUTOSAR vendor list
    container WdgMConfigEntities  # Combining container that holds all configurable supervision and trigger configuration parameters.
      enumeration WdgMMode: {WDGIF_FAST_MODE, WDGIF_OFF_MODE, WDGIF_SLOW_MODE}, origin=AUTOSAR_ECUC V1.1.0  # The parameter shall contain the initial-mode of the Watchdog Manager.
      container WdgMAliveSupervision [1..*]  # Container for a management structure to configure the alive-supervision of the Watchdog Manager. Its multiplicity describes the number of alive-supervision configuration sets.
        integer WdgMAliveSupervisionConfigId: origin=AUTOSAR_ECUC V1.0.0  # This parameter shall contain the identifier of the alive-supervision configuration set
        integer WdgMExpiredSupervisionCycleTol: origin=AUTOSAR_ECUC V1.0.0  # This parameter shall be used to define a value that fixes the amount of expired supervision cycles for how long the blocking of watchdog triggering shall be postponed.
        integer WdgMNumberOfSupervisedEntities: origin=AUTOSAR_ECUC V1.1.0  # This parameter shall contain the amount of supervised entities for this alive-supervision configuration set.
        float WdgMSupervisionCycle: origin=AUTOSAR_ECUC V1.0.0  # This parameter defines the schedule period of the main function WdgM_MainFunction_AliveSupervision. Unit: [s]
        container WdgMSupervisedEntity [1..*]  # This container collects all configuration parameters to define the individual settings of a Supervised Entity.
          enumeration WdgMActivationStatus: {WDGM_SUPERVISION_DISABLED, WDGM_SUPERVISION_ENABLED}, origin=AUTOSAR_ECUC V1.0.0  # This parameter shall contain the activation status of the corresponding Supervised Entity.
          boolean WdgMDeactivationAccessEnabled: origin=AUTOSAR_ECUC V1.0.0  # This parameter shall be used to grant the access of the service WdgM_DeactivateAliveSupervision() for affecting the activation status of the corresponding Supervised Entity.
          integer WdgMExpectedAliveIndications: origin=AUTOSAR_ECUC V1.0.0  # This parameter shall contain the amount of expected alive indications within the referenced amount of defined supervision cycles according to corresponding SE.
          integer WdgMFailedSupervisionRefCycleTol: origin=AUTOSAR_ECUC V1.0.0  # This parameter shall contain the acceptable amount of failed supervision reference cycles that shall be used by checkup of alive supervision according to corresponding SE.
          integer WdgMMaxMargin: 0.., origin=AUTOSAR_ECUC V1.0.0  # This parameter shall contain the amount of alive indications that are acceptable to be additional on the expected alive indications within the corresponding supervision reference cycle.
          integer WdgMMinMargin: 0.., origin=AUTOSAR_ECUC V1.0.0  # This parameter shall contain the amount of alive indications that are acceptable to be missed from the expected alive indications within the corresponding supervision reference cycle.
          integer WdgMSupervisedEntityId: origin=AUTOSAR_ECUC V1.0.0, symbolic-name-value=true  # This parameter shall contain the identifier of he supervised entity.
          integer WdgMSupervisionReferenceCycle: origin=AUTOSAR_ECUC V1.0.0  # This parameter shall contain the amount of supervision cycles to be used as reference by the alive-supervision mechanism to perform the checkup with counted alive indications according to corresponding SE.
      container WdgMTrigger [1..*]  # Container for management structure to configure the trigger service of the Watchdog Manager. Its multiplicity describes the number of trigger configuration sets.
        integer WdgMNumberOfWatchdogInstances: origin=AUTOSAR_ECUC V1.0.0  # This parameter shall contain the amount of watchdog instances.
        float WdgMTriggerCycle: origin=AUTOSAR_ECUC V1.0.0  # This parameter defines the schedule period of the main function WdgM_MainFunction_Trigger. Unit: [s]
        container WdgMWatchdogInstance [1..*]  # This container collects all configuration parameters to define the individual settings of a watchdog instance.
          integer WdgMTriggerReferenceCycle: origin=AUTOSAR_ECUC V1.0.0  # This parameter shall contain the amount of trigger cycles to be used as reference by the trigger service of the Watchdog Manager to perform the triggering of the corresponding watchdog instance.
          integer WdgMWatchdogInstanceId: origin=AUTOSAR_ECUC V1.0.0, symbolic-name-value=true  # This parameter shall contain the identifier of the watchdog instance.
    container WdgMGeneral  # Container structures all general configuration parameters of the Watchdog Manager.
      boolean WdgMDemErrorReport: origin=AUTOSAR_ECUC V1.0.0  # Preprocessor switch to enable/disable production error reporting. Shall be used to remove unneeded code segments regarding DEM features.
      boolean WdgMDevErrorDetect: origin=AUTOSAR_ECUC V1.0.0  # Preprocessor switch for enabling development error detection and reporting
      enumeration WdgMOffModeEnabled: origin=AUTOSAR_ECUC V1.0.0  # Parameter to enable/disable he access of Off-Mode selection (Off mode of the watchdog driver).
      boolean WdgMSupervision: origin=AUTOSAR_ECUC V1.0.0  # Preprocessor switch to enable/disable the alive-supervision mechanism. Shall be used to remove unneeded code segments regarding alive-supervision. Use Case: no supervised entity assigned
      boolean WdgMVersionInfoApi: origin=AUTOSAR_ECUC V1.0.0  # Preprocessor switch to enable/disable the existence of the API WdgM_GetVersionInfo. Shall be used to remove unneeded code segments.
      reference def WdgIfRef: lower-multiplicity=1, upper-multiplicity=1, origin=AUTOSAR_ECUC V1.1.0, destination=WdgIfGeneral  # Reference to the watchdog interface that is used by the watchdog manager.
