VERSION ""

NS_ :

BS_:

BU_: DebugNode EcuTestNode

BO_ 256 Pdu_Rx: 1 DebugNode
 SG_ CounterIn : 0|8@1+ (1,0) [0|0] ""  EcuTestNode

BO_ 272 Pdu_Tx: 1 EcuTestNode
 SG_ CounterOut : 0|8@1+ (1,0) [0|255] "" Vector__XXX
