AUTOSAR XML (schema 4-0-3)
package /CanSystem
  system CanSystem: system-version=1.0.0
    system mapping SystemMapping
      data-mappings:
        data-element=TopLevelComposition.P_CounterOut.CounterValue, system-signal=CounterOut
        data-element=TopLevelComposition.R_CounterIn.CounterValue, system-signal=CounterIn
      sw-mappings:
        swc to ecu mapping EcuTestNodeMapping: ecu-instance=EcuTestNode
          component:
            TopLevelComposition.SWC_ModifyEcho
            TopLevelComposition.SWC_CyclicCounter
            TopLevelComposition.SWC_IoHwAbs
    root-software-compositions:
      root sw composition prototype TopLevelComposition: software-composition=TopLevelComposition
package /CanSystem/CLUSTERS
  can cluster CanNetwork: speed=100
    can physical channel CanChannel: comm-connectors=[Conn_DebugNode, Conn_EcuTestNode]
      frame Pdu_CounterIn: id 0x100, from DebugNode, to EcuTestNode, frame-length=1, can-addressing-mode=STANDARD
        pdu Pdu_CounterIn: length=1, transmission-mode-condition{data-filter=data-filter-type=ALWAYS, i-signal-in-i-pdu=CounterIn}, transmission-mode-true-timing=event-controlled-timing={number-of-repetitions=1, repetition-period=1.0}, unused-bit-pattern=0
          signal CounterIn: start 0, 8 bit, little-endian, data-type-policy=PORT-INTERFACE-DEFINITION, implementation-data-type=uint8, to EcuTestNode
      frame Pdu_CounterOut: id 0x110, from EcuTestNode, to DebugNode, frame-length=1, can-addressing-mode=STANDARD
        pdu Pdu_CounterOut: length=1, transmission-mode-condition{data-filter=data-filter-type=ALWAYS, i-signal-in-i-pdu=CounterOut}, transmission-mode-true-timing=event-controlled-timing={number-of-repetitions=1, repetition-period=1.0}, unused-bit-pattern=0
          signal CounterOut: start 0, 8 bit, little-endian, data-type-policy=PORT-INTERFACE-DEFINITION, implementation-data-type=uint8, to DebugNode
      frame Pdu_CounterOutPost: id 0x118, from EcuTestNode, to DebugNode, frame-length=1, can-addressing-mode=STANDARD
        pdu Pdu_CounterOutPost: length=1, transmission-mode-condition{data-filter=data-filter-type=ALWAYS, i-signal-in-i-pdu=CounterOutPost}, transmission-mode-true-timing=cyclic-timing={time-offset=0.0, time-period=2.0}, unused-bit-pattern=0
          signal CounterOutPost: start 0, 8 bit, little-endian, data-type-policy=PORT-INTERFACE-DEFINITION, implementation-data-type=uint8, to DebugNode
package /CanSystem/ECUINSTANCES
  ecu instance DebugNode: com-configuration-gw-time-base=0.005, com-configuration-rx-time-base=0.005, com-configuration-tx-time-base=0.005, com-enable-mdt-for-cyclic-transmission=false, sleep-mode-supported=false, wake-up-over-bus-supported=false
    can communication controller DebugNode
    can communication connector Conn_DebugNode: comm-controller=DebugNode
  ecu instance EcuTestNode: com-configuration-gw-time-base=0.005, com-configuration-rx-time-base=0.005, com-configuration-tx-time-base=0.005, com-enable-mdt-for-cyclic-transmission=true, sleep-mode-supported=false, wake-up-over-bus-supported=false
    can communication controller EcuTestNode
    can communication connector Conn_EcuTestNode: comm-controller=EcuTestNode
