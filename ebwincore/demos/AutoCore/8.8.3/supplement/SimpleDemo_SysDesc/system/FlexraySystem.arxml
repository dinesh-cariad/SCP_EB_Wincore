AUTOSAR XML (schema 4-0-3)
package /FlexraySystem
  system FlexraySystem: system-version=1.0.0
    system mapping SystemMapping
      data-mappings:
        data-element=TopLevelComposition.P_CounterOut.CounterValue, system-signal=CounterOut
        data-element=TopLevelComposition.R_CounterIn.CounterValue, system-signal=CounterIn
      sw-mappings:
        swc to ecu mapping EcuTestNodeMapping: ecu-instance=EcuTestNode
          component:
            TopLevelComposition.SWC_ModifyEcho
            TopLevelComposition.SWC_CyclicCounter
            TopLevelComposition.SWC_IoHwAbs
    root-software-compositions:
      root sw composition prototype TopLevelComposition: software-composition=TopLevelComposition
package /FlexraySystem/CLUSTERS
  flexray cluster simple_demo_flexray:
    protocol-name=FlexRay
    protocol-version=2.1
    speed=10000
    action-point-offset=6
    bit=0.000000001
    cas-rx-low-max=81
    cold-start-attempts=10
    cycle=0.01
    cycle-count-max=63
    detect-nit-error=false
    dynamic-slot-idle-phase=1
    ignore-after-tx=0
    listen-noise=2
    macro-per-cycle=10000
    macrotick-duration=1.0E-6
    max-without-clock-correction-fatal=2
    max-without-clock-correction-passive=2
    minislot-action-point-offset=3
    minislot-duration=6
    network-idle-time=250
    network-management-vector-length=2
    number-of-minislots=0
    number-of-static-slots=195
    offset-correction-start=9987
    payload-length-static=10
    safety-margin=0
    sample-clock-period=0.0000000125
    static-slot-duration=50
    symbol-window=0
    symbol-window-action-point-offset=6
    sync-frame-id-count-max=15
    transmission-start-sequence-duration=6
    wakeup-rx-idle=59
    wakeup-rx-low=55
    wakeup-rx-window=301
    wakeup-tx-active=60
    wakeup-tx-idle=180
    flexray physical channel Channel_A_FlexRayNetwork_1: channel-name=CHANNEL-A
      comm-connectors:
        ECU_DebugNode_CC_FlexRay_Controller_2_Ch_Channel_A_FlexRayNetwork_1
        ECU_EcuTestNode_CC_FlexRay_Controller_1_Ch_Channel_A_FlexRayNetwork_1
      frame CounterInFrame_001: from DebugNode, to EcuTestNode, frame-length=8, flexray-absolutely-scheduled-timing{communication-cycle=cycle-repetition={base-cycle=0, cycle-repetition=CYCLE-REPETITION-1}, slot-id=1}, allow-dynamic-l-sdu-length=false, payload-preamble-indicator=false
        pdu Pdu_CounterIn: length=1, transmission-mode-condition{data-filter=data-filter-type=ALWAYS, i-signal-in-i-pdu=CounterIn_Pdu_CounterIn_0}, transmission-mode-true-timing=event-controlled-timing={number-of-repetitions=1, repetition-period=1.0}, unused-bit-pattern=0
          signal CounterIn: start 7, 8 bit, big-endian, data-type-policy=PORT-INTERFACE-DEFINITION, implementation-data-type=uint8, to EcuTestNode
      frame CounterOutFrame_001: from EcuTestNode, to DebugNode, frame-length=8, flexray-absolutely-scheduled-timing{communication-cycle=cycle-repetition={base-cycle=0, cycle-repetition=CYCLE-REPETITION-1}, slot-id=10}, allow-dynamic-l-sdu-length=false, payload-preamble-indicator=false
        pdu Pdu_CounterOut: length=1, transmission-mode-condition{data-filter=data-filter-type=ALWAYS, i-signal-in-i-pdu=CounterOut_Pdu_CounterOut_0}, transmission-mode-true-timing=event-controlled-timing={number-of-repetitions=1, repetition-period=1.0}, unused-bit-pattern=0
          signal CounterOut: start 7, 8 bit, big-endian, data-type-policy=PORT-INTERFACE-DEFINITION, implementation-data-type=uint8, to DebugNode
package /FlexraySystem/ECUINSTANCES
  ecu instance DebugNode: com-configuration-gw-time-base=0.005, com-configuration-rx-time-base=0.005, com-configuration-tx-time-base=0.005, com-enable-mdt-for-cyclic-transmission=false, sleep-mode-supported=false, wake-up-over-bus-supported=false
    flexray communication controller FlexRay_Controller_2:
      accepted-startup-range=109
      allow-halt-due-to-clock=true
      allow-passive-to-active=0
      cluster-drift-damping=1
      decoding-correction=36
      delay-compensation-a=10
      delay-compensation-b=10
      extern-offset-correction=0
      extern-rate-correction=0
      external-sync=false
      fall-back-internal=false
      key-slot-id=6
      key-slot-only-enabled=false
      key-slot-used-for-start-up=true
      key-slot-used-for-sync=true
      latest-tx=0
      listen-timeout=802404
      macro-initial-offset-a=8
      macro-initial-offset-b=8
      maximum-dynamic-payload-length=16
      micro-initial-offset-a=34
      micro-initial-offset-b=34
      micro-per-cycle=400000
      microtick-duration=2.5000000000000002E-8
      nm-vector-early-update=false
      offset-correction-out=259
      rate-correction-out=1202
      samples-per-microtick=2
      two-key-slot-mode=false
      wake-up-pattern=63
    flexray communication connector ECU_DebugNode_CC_FlexRay_Controller_2_Ch_Channel_A_FlexRayNetwork_1: comm-controller=FlexRay_Controller_2, wake-up-channel=true
  ecu instance EcuTestNode: com-configuration-gw-time-base=0.005, com-configuration-rx-time-base=0.005, com-configuration-tx-time-base=0.005, com-enable-mdt-for-cyclic-transmission=false, sleep-mode-supported=false, wake-up-over-bus-supported=false
    flexray communication controller FlexRay_Controller_1:
      accepted-startup-range=109
      allow-halt-due-to-clock=true
      allow-passive-to-active=0
      cluster-drift-damping=1
      decoding-correction=36
      delay-compensation-a=10
      delay-compensation-b=10
      extern-offset-correction=0
      extern-rate-correction=0
      external-sync=false
      fall-back-internal=false
      key-slot-id=10
      key-slot-only-enabled=false
      key-slot-used-for-start-up=true
      key-slot-used-for-sync=true
      latest-tx=0
      listen-timeout=802404
      macro-initial-offset-a=8
      macro-initial-offset-b=8
      maximum-dynamic-payload-length=16
      micro-initial-offset-a=34
      micro-initial-offset-b=34
      micro-per-cycle=400000
      microtick-duration=2.5000000000000002E-8
      nm-vector-early-update=false
      offset-correction-out=259
      rate-correction-out=1202
      samples-per-microtick=2
      two-key-slot-mode=false
      wake-up-pattern=63
    flexray communication connector ECU_EcuTestNode_CC_FlexRay_Controller_1_Ch_Channel_A_FlexRayNetwork_1: comm-controller=FlexRay_Controller_1, wake-up-channel=true
