AUTOSAR XML (schema 4-0-3)
package /LinSystem
  system LinSystem: system-version=1.0.0
    system mapping SystemMapping
      data-mappings:
        data-element=TopLevelComposition.P_CounterOut.CounterValue, system-signal=CounterOut
        data-element=TopLevelComposition.R_CounterIn.CounterValue, system-signal=CounterIn
      sw-mappings:
        swc to ecu mapping EcuTestNodeMapping: ecu-instance=EcuTestNode
          component:
            TopLevelComposition.SWC_ModifyEcho
            TopLevelComposition.SWC_CyclicCounter
            TopLevelComposition.SWC_IoHwAbs
    root-software-compositions:
      root sw composition prototype TopLevelComposition: software-composition=TopLevelComposition
package /LinSystem/CLUSTERS
  lin cluster LinNetwork: speed=10
    lin physical channel LinChannel: comm-connectors=[Conn_DebugNode, Conn_EcuTestNode]
      frame Pdu_CounterIn: id 0x0, from DebugNode, to EcuTestNode, frame-length=2, lin-checksum=CLASSIC
        pdu Pdu_CounterIn: length=1, transmission-mode-condition{data-filter=data-filter-type=ALWAYS, i-signal-in-i-pdu=CounterIn}, transmission-mode-true-timing=event-controlled-timing={number-of-repetitions=1, repetition-period=1.0}, unused-bit-pattern=0
          signal CounterIn: start 0, 8 bit, little-endian, data-type-policy=PORT-INTERFACE-DEFINITION, implementation-data-type=uint8, to EcuTestNode
      frame Pdu_CounterOut: id 0x1, from EcuTestNode, to DebugNode, frame-length=2, lin-checksum=CLASSIC
        pdu Pdu_CounterOut: length=1, transmission-mode-condition{data-filter=data-filter-type=ALWAYS, i-signal-in-i-pdu=CounterOut}, transmission-mode-true-timing=event-controlled-timing={number-of-repetitions=1, repetition-period=1.0}, unused-bit-pattern=0
          signal CounterOut: start 0, 8 bit, little-endian, data-type-policy=PORT-INTERFACE-DEFINITION, implementation-data-type=uint8, to DebugNode
      lin schedule table schTabConfig: resume-position=CONTINUE-AT-IT-POSITION, run-mode=RUN-ONCE
        table-entrys:
          assign-frame-id={delay=0.02, position-in-table=0, assigned-controller=DebugNode, assigned-frame-triggering=FT_Pdu_CounterIn}
          assign-nad={delay=0.02, position-in-table=1, assigned-controller=DebugNode, new-nad=3}
      lin schedule table schTab1: resume-position=START-FROM-BEGINNING, run-mode=RUN-CONTINUOUS
        table-entrys:
          delay=0.02, position-in-table=0, frame-triggering=FT_Pdu_CounterIn
          delay=0.02, position-in-table=1, frame-triggering=FT_Pdu_CounterOut
package /LinSystem/ECUINSTANCES
  ecu instance DebugNode: com-configuration-gw-time-base=0.005, com-configuration-rx-time-base=0.005, com-configuration-tx-time-base=0.005, com-enable-mdt-for-cyclic-transmission=false, sleep-mode-supported=false, wake-up-over-bus-supported=false
    lin slave DebugNode: protocol-version=2.0, configured-nad=2, function-id=1, lin-error-response={frame-triggering=FT_Pdu_CounterIn, response-error-position=1}, supplier-id=4660, variant-id=3
    lin communication connector Conn_DebugNode: comm-controller=DebugNode, initial-nad=2, lin-configurable-frame{frame=Pdu_CounterIn, message-id=1}
  ecu instance EcuTestNode: com-configuration-gw-time-base=0.005, com-configuration-rx-time-base=0.005, com-configuration-tx-time-base=0.005, com-enable-mdt-for-cyclic-transmission=false, sleep-mode-supported=false, wake-up-over-bus-supported=false
    lin master EcuTestNode: protocol-version=1.2, time-base=0.01, time-base-jitter=0.0
    lin communication connector Conn_EcuTestNode: comm-controller=EcuTestNode, initial-nad=1
