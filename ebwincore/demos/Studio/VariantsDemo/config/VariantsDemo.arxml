AUTOSAR XML (schema 4-2-2)
package /EB
  module definition VariantsDemo: variants pre-compile/post-build
    container SelectableContainer [0..*]: post-build-variant-multiplicity=true
      integer Variable
    container Container
      boolean SelectableBoolean [0..1]: post-build-variant-value=true, default-value=false
    container LoadableContainer [0..*]: multiplicity set at pre-compile in variant pre-compile / post-build in variant post-build
      integer Integer: default-value=3
    container Container2
      string LoadableString: set at pre-compile in variant pre-compile / post-build in variant post-build
