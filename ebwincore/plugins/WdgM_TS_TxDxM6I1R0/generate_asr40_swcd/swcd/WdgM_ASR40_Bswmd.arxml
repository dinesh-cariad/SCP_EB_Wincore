<?xml version="1.0" encoding="ISO-8859-1"?>
[!AUTOSPACING!][!//
<AUTOSAR
  xmlns="http://autosar.org/schema/r4.0"
  xmlns:xsi="http://www.w3.org/2001/XMLSchema-instance"
  xsi:schemaLocation="http://autosar.org/schema/r4.0 AUTOSAR_4-0-3_STRICT_COMPACT.xsd">
[!IF "WdgMGeneral/WdgMServiceAPI/WdgMDefaultASRServiceAPI = 'AUTOSAR_32'"!][!//
[!VAR "bswModuleEntryPackageName" = "'SwServices'"!][!//
[!VAR "swComponentTypePackageName" = "'ComponentTypes'"!][!//
[!ELSE!][!//
[!VAR "bswModuleEntryPackageName" = "'BswModuleEntrys'"!][!//
[!VAR "swComponentTypePackageName" = "'SwComponentTypes'"!][!//
[!ENDIF!][!//
  <AR-PACKAGES>
    <AR-PACKAGE>
      <SHORT-NAME>AUTOSAR_WdgM</SHORT-NAME>
      <AR-PACKAGES>
        <AR-PACKAGE>
          <SHORT-NAME>BswModuleDescriptions</SHORT-NAME>
          <ELEMENTS>
            <BSW-MODULE-DESCRIPTION>
              <SHORT-NAME>WdgM</SHORT-NAME>
              <MODULE-ID>13</MODULE-ID>
              <PROVIDED-ENTRYS>
                <BSW-MODULE-ENTRY-REF-CONDITIONAL>
                  <BSW-MODULE-ENTRY-REF DEST="BSW-MODULE-ENTRY">/AUTOSAR_WdgM/[!"$bswModuleEntryPackageName"!]/WdgM_MainFunction</BSW-MODULE-ENTRY-REF>
                </BSW-MODULE-ENTRY-REF-CONDITIONAL>
              </PROVIDED-ENTRYS>
              <INTERNAL-BEHAVIORS>
                <BSW-INTERNAL-BEHAVIOR>
                  <SHORT-NAME>InternalBehavior_0</SHORT-NAME>
                  <ENTITYS>
[!// <!-- !LINKSTO WDGM.EB.BSWMDGeneration_2,1 -->
                    <BSW-SCHEDULABLE-ENTITY>
                      <SHORT-NAME>WdgM_MainFunction</SHORT-NAME>
                      <MINIMUM-START-INTERVAL>0.0</MINIMUM-START-INTERVAL>
                      <IMPLEMENTED-ENTRY-REF DEST="BSW-MODULE-ENTRY">/AUTOSAR_WdgM/[!"$bswModuleEntryPackageName"!]/WdgM_MainFunction</IMPLEMENTED-ENTRY-REF>
                    </BSW-SCHEDULABLE-ENTITY>
                  </ENTITYS>
                  <EVENTS>
                    <BSW-TIMING-EVENT>
                      <SHORT-NAME>TimingEvent_MainFunction</SHORT-NAME>
                      <STARTS-ON-EVENT-REF DEST="BSW-SCHEDULABLE-ENTITY">/AUTOSAR_WdgM/BswModuleDescriptions/WdgM/InternalBehavior_0/WdgM_MainFunction</STARTS-ON-EVENT-REF>
                      <PERIOD>[!"num:f(WdgMConfigSet/*[1]/WdgMMode/*[1]/WdgMSupervisionCycle)"!]</PERIOD>
                    </BSW-TIMING-EVENT>
                  </EVENTS>
                </BSW-INTERNAL-BEHAVIOR>
              </INTERNAL-BEHAVIORS>
            </BSW-MODULE-DESCRIPTION>
          </ELEMENTS>
        </AR-PACKAGE>
        <AR-PACKAGE>
          <SHORT-NAME>[!"$bswModuleEntryPackageName"!]</SHORT-NAME>
          <ELEMENTS>
            <BSW-MODULE-ENTRY>
              <SHORT-NAME>WdgM_MainFunction</SHORT-NAME>
              <SERVICE-ID>8</SERVICE-ID>
              <IS-REENTRANT>false</IS-REENTRANT>
              <IS-SYNCHRONOUS>true</IS-SYNCHRONOUS>
              <CALL-TYPE>SCHEDULED</CALL-TYPE>
              <EXECUTION-CONTEXT>TASK</EXECUTION-CONTEXT>
              <SW-SERVICE-IMPL-POLICY>STANDARD</SW-SERVICE-IMPL-POLICY>
            </BSW-MODULE-ENTRY>
          </ELEMENTS>
        </AR-PACKAGE>
[!IF "WdgMGeneral/WdgMRteUsage = 'true'"!]
        <AR-PACKAGE>
          <SHORT-NAME>SwcBswMappings</SHORT-NAME>
          <ELEMENTS>
            <SWC-BSW-MAPPING>
              <SHORT-NAME>SwcBswMapping_0</SHORT-NAME>
              <BSW-BEHAVIOR-REF DEST="BSW-INTERNAL-BEHAVIOR">/AUTOSAR_WdgM/BswModuleDescriptions/WdgM/InternalBehavior_0</BSW-BEHAVIOR-REF>
              <RUNNABLE-MAPPINGS>
                <SWC-BSW-RUNNABLE-MAPPING>
                  <BSW-ENTITY-REF DEST="BSW-SCHEDULABLE-ENTITY">/AUTOSAR_WdgM/BswModuleDescriptions/WdgM/InternalBehavior_0/WdgM_MainFunction</BSW-ENTITY-REF>
                  <SWC-RUNNABLE-REF DEST="RUNNABLE-ENTITY">/AUTOSAR_WdgM/[!"$swComponentTypePackageName"!]/WdgM/SwcInternalBehavior_0/RE_Main</SWC-RUNNABLE-REF>
                </SWC-BSW-RUNNABLE-MAPPING>
              </RUNNABLE-MAPPINGS>
              <SWC-BEHAVIOR-REF DEST="SWC-INTERNAL-BEHAVIOR">/AUTOSAR_WdgM/[!"$swComponentTypePackageName"!]/WdgM/SwcInternalBehavior_0</SWC-BEHAVIOR-REF>
            </SWC-BSW-MAPPING>
          </ELEMENTS>
        </AR-PACKAGE>
[!ENDIF!]
      </AR-PACKAGES>
    </AR-PACKAGE>
    <AR-PACKAGE>
      <SHORT-NAME>EB_WdgM</SHORT-NAME>
      <AR-PACKAGES>
        <AR-PACKAGE>
          <SHORT-NAME>Implementations</SHORT-NAME>
          <ELEMENTS>
            <BSW-IMPLEMENTATION>
              <SHORT-NAME>BswImplementation_0</SHORT-NAME>
              <CODE-DESCRIPTORS>
                <CODE>
                  <SHORT-NAME>Files</SHORT-NAME>
                  <ARTIFACT-DESCRIPTORS>
                    <AUTOSAR-ENGINEERING-OBJECT>
                      <SHORT-LABEL>Autosar::include::WdgM.h</SHORT-LABEL>
                      <CATEGORY>SWHDR</CATEGORY>
                    </AUTOSAR-ENGINEERING-OBJECT>
                    <AUTOSAR-ENGINEERING-OBJECT>
                      <SHORT-LABEL>Autosar::include::WdgM_BSW_Lcfg.h</SHORT-LABEL>
                      <CATEGORY>SWHDR</CATEGORY>
                    </AUTOSAR-ENGINEERING-OBJECT>
                    <AUTOSAR-ENGINEERING-OBJECT>
                      <SHORT-LABEL>Autosar::include::WdgM_Int.h</SHORT-LABEL>
                      <CATEGORY>SWHDR</CATEGORY>
                    </AUTOSAR-ENGINEERING-OBJECT>
                    <AUTOSAR-ENGINEERING-OBJECT>
                      <SHORT-LABEL>Autosar::include::WdgM_Trace_Stc.h</SHORT-LABEL>
                      <CATEGORY>SWHDR</CATEGORY>
                    </AUTOSAR-ENGINEERING-OBJECT>
                    <AUTOSAR-ENGINEERING-OBJECT>
                      <SHORT-LABEL>Autosar::include::WdgM_Version.h</SHORT-LABEL>
                      <CATEGORY>SWHDR</CATEGORY>
                    </AUTOSAR-ENGINEERING-OBJECT>
                    <AUTOSAR-ENGINEERING-OBJECT>
                      <SHORT-LABEL>Autosar::src::WdgM.c</SHORT-LABEL>
                      <CATEGORY>SWSRC</CATEGORY>
                    </AUTOSAR-ENGINEERING-OBJECT>
                    <AUTOSAR-ENGINEERING-OBJECT>
                      <SHORT-LABEL>make::WdgM_defs.mak</SHORT-LABEL>
                      <CATEGORY>SWMAKE</CATEGORY>
                    </AUTOSAR-ENGINEERING-OBJECT>
                    <AUTOSAR-ENGINEERING-OBJECT>
                      <SHORT-LABEL>make::WdgM_rules.mak</SHORT-LABEL>
                      <CATEGORY>SWMAKE</CATEGORY>
                    </AUTOSAR-ENGINEERING-OBJECT>
                  </ARTIFACT-DESCRIPTORS>
                </CODE>
              </CODE-DESCRIPTORS>
              <PROGRAMMING-LANGUAGE>C</PROGRAMMING-LANGUAGE>
              <RESOURCE-CONSUMPTION>
                <SHORT-NAME>ResourceConsumption</SHORT-NAME>
[!// <!-- !LINKSTO WDGM.EB.BSWMDGeneration_4,1 -->
                <MEMORY-SECTIONS>
[!IF "WdgMGeneral/WdgMServiceAPI/WdgMEnableASR32ServiceAPI = 'true'"!]
                  <MEMORY-SECTION>
                    <SHORT-NAME>VAR_INIT_8BIT</SHORT-NAME>
                    <ALIGNMENT>8</ALIGNMENT>
                    <SW-ADDRMETHOD-REF DEST="SW-ADDR-METHOD">/AUTOSAR_MemMap/SwAddrMethods/VAR_INIT</SW-ADDRMETHOD-REF>
                  </MEMORY-SECTION>
                  <MEMORY-SECTION>
                    <SHORT-NAME>CONST_8BIT</SHORT-NAME>
                    <ALIGNMENT>8</ALIGNMENT>
                    <SW-ADDRMETHOD-REF DEST="SW-ADDR-METHOD">/AUTOSAR_MemMap/SwAddrMethods/CONST</SW-ADDRMETHOD-REF>
                  </MEMORY-SECTION>
                  <MEMORY-SECTION>
                    <SHORT-NAME>VAR_8BIT</SHORT-NAME>
                    <ALIGNMENT>8</ALIGNMENT>
                    <SW-ADDRMETHOD-REF DEST="SW-ADDR-METHOD">/AUTOSAR_MemMap/SwAddrMethods/VAR</SW-ADDRMETHOD-REF>
                  </MEMORY-SECTION>
                  <MEMORY-SECTION>
                    <SHORT-NAME>VAR_CLEARED_8BIT</SHORT-NAME>
                    <ALIGNMENT>8</ALIGNMENT>
                    <SW-ADDRMETHOD-REF DEST="SW-ADDR-METHOD">/AUTOSAR_MemMap/SwAddrMethods/VAR_CLEARED</SW-ADDRMETHOD-REF>
                  </MEMORY-SECTION>
                  <MEMORY-SECTION>
                    <SHORT-NAME>CONST_UNSPECIFIED</SHORT-NAME>
                    <ALIGNMENT>UNSPECIFIED</ALIGNMENT>
                    <SW-ADDRMETHOD-REF DEST="SW-ADDR-METHOD">/AUTOSAR_MemMap/SwAddrMethods/CONST</SW-ADDRMETHOD-REF>
                  </MEMORY-SECTION>
                  <MEMORY-SECTION>
                    <SHORT-NAME>VAR_32BIT</SHORT-NAME>
                    <ALIGNMENT>32</ALIGNMENT>
                    <SW-ADDRMETHOD-REF DEST="SW-ADDR-METHOD">/AUTOSAR_MemMap/SwAddrMethods/VAR</SW-ADDRMETHOD-REF>
                  </MEMORY-SECTION>
                  <MEMORY-SECTION>
                    <SHORT-NAME>VAR_CLEARED_32BIT</SHORT-NAME>
                    <ALIGNMENT>32</ALIGNMENT>
                    <SW-ADDRMETHOD-REF DEST="SW-ADDR-METHOD">/AUTOSAR_MemMap/SwAddrMethods/VAR_CLEARED</SW-ADDRMETHOD-REF>
                  </MEMORY-SECTION>
                  <MEMORY-SECTION>
                    <SHORT-NAME>CONST_16BIT</SHORT-NAME>
                    <ALIGNMENT>16</ALIGNMENT>
                    <SW-ADDRMETHOD-REF DEST="SW-ADDR-METHOD">/AUTOSAR_MemMap/SwAddrMethods/CONST</SW-ADDRMETHOD-REF>
                  </MEMORY-SECTION>
                  <MEMORY-SECTION>
                    <SHORT-NAME>VAR_CLEARED_16BIT</SHORT-NAME>
                    <ALIGNMENT>16</ALIGNMENT>
                    <SW-ADDRMETHOD-REF DEST="SW-ADDR-METHOD">/AUTOSAR_MemMap/SwAddrMethods/VAR_CLEARED</SW-ADDRMETHOD-REF>
                  </MEMORY-SECTION>
                  <MEMORY-SECTION>
                    <SHORT-NAME>VAR_INIT_16BIT</SHORT-NAME>
                    <ALIGNMENT>16</ALIGNMENT>
                    <SW-ADDRMETHOD-REF DEST="SW-ADDR-METHOD">/AUTOSAR_MemMap/SwAddrMethods/VAR_INIT</SW-ADDRMETHOD-REF>
                  </MEMORY-SECTION>
[!ENDIF!]
                  <MEMORY-SECTION>
                    <SHORT-NAME>CODE</SHORT-NAME>
                    <SW-ADDRMETHOD-REF DEST="SW-ADDR-METHOD">/AUTOSAR_MemMap/SwAddrMethods/CODE</SW-ADDRMETHOD-REF>
                  </MEMORY-SECTION>
                  <MEMORY-SECTION>
                    <SHORT-NAME>CODE_ASIL_D</SHORT-NAME>
                    <OPTIONS>
                      <OPTION>safetyAsilD</OPTION>
                    </OPTIONS>
                    <SW-ADDRMETHOD-REF DEST="SW-ADDR-METHOD">/AUTOSAR_MemMap/SwAddrMethods/CODE_ASIL_D</SW-ADDRMETHOD-REF>
                  </MEMORY-SECTION>
                  <MEMORY-SECTION>
                    <SHORT-NAME>CONST_8</SHORT-NAME>
                    <ALIGNMENT>8</ALIGNMENT>
                    <SW-ADDRMETHOD-REF DEST="SW-ADDR-METHOD">/AUTOSAR_MemMap/SwAddrMethods/CONST</SW-ADDRMETHOD-REF>
                  </MEMORY-SECTION>
                  <MEMORY-SECTION>
                    <SHORT-NAME>CONST_ASIL_D_8</SHORT-NAME>
                    <ALIGNMENT>8</ALIGNMENT>
                    <OPTIONS>
                      <OPTION>safetyAsilD</OPTION>
                    </OPTIONS>
                    <SW-ADDRMETHOD-REF DEST="SW-ADDR-METHOD">/AUTOSAR_MemMap/SwAddrMethods/CONST_ASIL_D</SW-ADDRMETHOD-REF>
                  </MEMORY-SECTION>
                  <MEMORY-SECTION>
                    <SHORT-NAME>CONST_16</SHORT-NAME>
                    <ALIGNMENT>16</ALIGNMENT>
                    <SW-ADDRMETHOD-REF DEST="SW-ADDR-METHOD">/AUTOSAR_MemMap/SwAddrMethods/CONST</SW-ADDRMETHOD-REF>
                  </MEMORY-SECTION>
                  <MEMORY-SECTION>
                    <SHORT-NAME>CONST_ASIL_D_16</SHORT-NAME>
                    <ALIGNMENT>16</ALIGNMENT>
                    <OPTIONS>
                      <OPTION>safetyAsilD</OPTION>
                    </OPTIONS>
                    <SW-ADDRMETHOD-REF DEST="SW-ADDR-METHOD">/AUTOSAR_MemMap/SwAddrMethods/CONST_ASIL_D</SW-ADDRMETHOD-REF>
                  </MEMORY-SECTION>
                  <MEMORY-SECTION>
                    <SHORT-NAME>CONST_ASIL_D_UNSPECIFIED</SHORT-NAME>
                    <ALIGNMENT>UNSPECIFIED</ALIGNMENT>
                    <OPTIONS>
                      <OPTION>safetyAsilD</OPTION>
                    </OPTIONS>
                    <SW-ADDRMETHOD-REF DEST="SW-ADDR-METHOD">/AUTOSAR_MemMap/SwAddrMethods/CONST_ASIL_D</SW-ADDRMETHOD-REF>
                  </MEMORY-SECTION>
                  <MEMORY-SECTION>
                    <SHORT-NAME>VAR_INIT_UNSPECIFIED</SHORT-NAME>
                    <ALIGNMENT>UNSPECIFIED</ALIGNMENT>
                    <SW-ADDRMETHOD-REF DEST="SW-ADDR-METHOD">/AUTOSAR_MemMap/SwAddrMethods/VAR</SW-ADDRMETHOD-REF>
                    <SYMBOL>VAR_INIT_UNSPECIFIED</SYMBOL>
                  </MEMORY-SECTION>
                  <MEMORY-SECTION>
                    <SHORT-NAME>VAR_INIT_ASIL_D_UNSPECIFIED</SHORT-NAME>
                    <ALIGNMENT>UNSPECIFIED</ALIGNMENT>
                    <OPTIONS>
                      <OPTION>safetyAsilD</OPTION>
                    </OPTIONS>
                    <SW-ADDRMETHOD-REF DEST="SW-ADDR-METHOD">/AUTOSAR_MemMap/SwAddrMethods/VAR_INIT_ASIL_D</SW-ADDRMETHOD-REF>
                  </MEMORY-SECTION>
                  <MEMORY-SECTION>
                    <SHORT-NAME>VAR_CLEARED_16</SHORT-NAME>
                    <ALIGNMENT>16</ALIGNMENT>
                    <SW-ADDRMETHOD-REF DEST="SW-ADDR-METHOD">/AUTOSAR_MemMap/SwAddrMethods/VAR_CLEARED</SW-ADDRMETHOD-REF>
                    <SYMBOL>VAR_CLEARED_16</SYMBOL>
                  </MEMORY-SECTION>
                  <MEMORY-SECTION>
                    <SHORT-NAME>VAR_CLEARED_ASIL_D_16</SHORT-NAME>
                    <ALIGNMENT>16</ALIGNMENT>
                    <OPTIONS>
                      <OPTION>safetyAsilD</OPTION>
                    </OPTIONS>
                    <SW-ADDRMETHOD-REF DEST="SW-ADDR-METHOD">/AUTOSAR_MemMap/SwAddrMethods/VAR_CLEARED_ASIL_D</SW-ADDRMETHOD-REF>
                  </MEMORY-SECTION>
                  <MEMORY-SECTION>
                    <SHORT-NAME>VAR_CLEARED_ASIL_D_32</SHORT-NAME>
                    <ALIGNMENT>32</ALIGNMENT>
                    <OPTIONS>
                      <OPTION>safetyAsilD</OPTION>
                    </OPTIONS>
                    <SW-ADDRMETHOD-REF DEST="SW-ADDR-METHOD">/AUTOSAR_MemMap/SwAddrMethods/VAR_CLEARED_ASIL_D</SW-ADDRMETHOD-REF>
                  </MEMORY-SECTION>
                  <MEMORY-SECTION>
                    <SHORT-NAME>VAR_INIT_ASIL_D_8</SHORT-NAME>
                    <ALIGNMENT>8</ALIGNMENT>
                    <OPTIONS>
                      <OPTION>safetyAsilD</OPTION>
                    </OPTIONS>
                    <SW-ADDRMETHOD-REF DEST="SW-ADDR-METHOD">/AUTOSAR_MemMap/SwAddrMethods/VAR_INIT_ASIL_D</SW-ADDRMETHOD-REF>
                  </MEMORY-SECTION>
                  <MEMORY-SECTION>
                    <SHORT-NAME>VAR_INIT_8</SHORT-NAME>
                    <ALIGNMENT>8</ALIGNMENT>
                    <SW-ADDRMETHOD-REF DEST="SW-ADDR-METHOD">/AUTOSAR_MemMap/SwAddrMethods/VAR_INIT</SW-ADDRMETHOD-REF>
                  </MEMORY-SECTION>
                  <MEMORY-SECTION>
                    <SHORT-NAME>VAR_INIT_16</SHORT-NAME>
                    <ALIGNMENT>16</ALIGNMENT>
                    <SW-ADDRMETHOD-REF DEST="SW-ADDR-METHOD">/AUTOSAR_MemMap/SwAddrMethods/VAR_INIT</SW-ADDRMETHOD-REF>
                  </MEMORY-SECTION>
                  <MEMORY-SECTION>
                    <SHORT-NAME>VAR_CLEARED_UNSPECIFIED</SHORT-NAME>
                    <ALIGNMENT>UNSPECIFIED</ALIGNMENT>
                    <SW-ADDRMETHOD-REF DEST="SW-ADDR-METHOD">/AUTOSAR_MemMap/SwAddrMethods/VAR_CLEARED</SW-ADDRMETHOD-REF>
                  </MEMORY-SECTION>
                  <MEMORY-SECTION>
                    <SHORT-NAME>VAR_CLEARED_ASIL_D_8</SHORT-NAME>
                    <ALIGNMENT>8</ALIGNMENT>
                    <OPTIONS>
                      <OPTION>safetyAsilD</OPTION>
                    </OPTIONS>
                    <SW-ADDRMETHOD-REF DEST="SW-ADDR-METHOD">/AUTOSAR_MemMap/SwAddrMethods/VAR_CLEARED_ASIL_D</SW-ADDRMETHOD-REF>
                  </MEMORY-SECTION>
[!IF "not(node:exists(as:modconf('WdgM')[1]/WdgMGeneral/WdgMGeneralMulticore/WdgMNumberOfCores) and as:modconf('WdgM')[1]/WdgMGeneral/WdgMGeneralMulticore/WdgMNumberOfCores > 1) or (as:modconf('WdgM')[1]/WdgMGeneral/WdgMSetModeSynchron)"!]
                  <MEMORY-SECTION>
                    <SHORT-NAME>VAR_INIT_ASIL_D_LOCAL_8</SHORT-NAME>
                    <ALIGNMENT>8</ALIGNMENT>
                    <OPTIONS>
                       <OPTION>safetyAsilD</OPTION>
                       <OPTION>coreLocal</OPTION>
                    </OPTIONS>
                    <SW-ADDRMETHOD-REF DEST="SW-ADDR-METHOD">/AUTOSAR_MemMap/SwAddrMethods/VAR_FAST_ASIL_D_LOCAL</SW-ADDRMETHOD-REF>
                  </MEMORY-SECTION>
[!ENDIF!]
[!IF "node:exists(as:modconf('WdgM')[1]/WdgMGeneral/WdgMGeneralMulticore/WdgMNumberOfCores) and as:modconf('WdgM')[1]/WdgMGeneral/WdgMGeneralMulticore/WdgMNumberOfCores > 1"!]
                  <MEMORY-SECTION>
                    <SHORT-NAME>VAR_INIT_UNSPECIFIED</SHORT-NAME>
                    <ALIGNMENT>UNSPECIFIED</ALIGNMENT>
                    <SW-ADDRMETHOD-REF DEST="SW-ADDR-METHOD">/AUTOSAR_MemMap/SwAddrMethods/VAR</SW-ADDRMETHOD-REF>
                  </MEMORY-SECTION>
                  <MEMORY-SECTION>
                    <SHORT-NAME>VAR_INIT_ASIL_D_LOCAL_8</SHORT-NAME>
                    <ALIGNMENT>8</ALIGNMENT>
                    <OPTIONS>
                       <OPTION>safetyAsilD</OPTION>
                       <OPTION>coreLocal</OPTION>
                    </OPTIONS>
                    <SW-ADDRMETHOD-REF DEST="SW-ADDR-METHOD">/AUTOSAR_MemMap/SwAddrMethods/VAR_FAST_ASIL_D_LOCAL</SW-ADDRMETHOD-REF>
                  </MEMORY-SECTION>
                  <MEMORY-SECTION>
                    <SHORT-NAME>VAR_INIT_GLOBAL_32</SHORT-NAME>
                    <ALIGNMENT>32</ALIGNMENT>
                    <SW-ADDRMETHOD-REF DEST="SW-ADDR-METHOD">/AUTOSAR_MemMap/SwAddrMethods/VAR_INIT</SW-ADDRMETHOD-REF>
                  </MEMORY-SECTION>
                  <MEMORY-SECTION>
                   <SHORT-NAME>VAR_POWER_ON_INIT_ASIL_D_GLOBAL_32</SHORT-NAME>
                   <ALIGNMENT>32</ALIGNMENT>
                   <OPTIONS>
                      <OPTION>safetyAsilD</OPTION>
                    </OPTIONS>
                   <SW-ADDRMETHOD-REF DEST="SW-ADDR-METHOD">/AUTOSAR_MemMap/SwAddrMethods/VAR_POWER_ON_INIT_ASIL_D</SW-ADDRMETHOD-REF>
                  </MEMORY-SECTION>
                  <MEMORY-SECTION>
                    <SHORT-NAME>VAR_GLOBAL_32</SHORT-NAME>
                    <ALIGNMENT>32</ALIGNMENT>
                    <SW-ADDRMETHOD-REF DEST="SW-ADDR-METHOD">/AUTOSAR_MemMap/SwAddrMethods/VAR</SW-ADDRMETHOD-REF>
                  </MEMORY-SECTION>
                  <MEMORY-SECTION>
                    <SHORT-NAME>VAR_CLEARED_GLOBAL_UNSPECIFIED</SHORT-NAME>
                    <ALIGNMENT>UNSPECIFIED</ALIGNMENT>
                    <SW-ADDRMETHOD-REF DEST="SW-ADDR-METHOD">/AUTOSAR_MemMap/SwAddrMethods/VAR_CLEARED</SW-ADDRMETHOD-REF>
                  </MEMORY-SECTION>
[!IF "WdgMGeneral/WdgMPartitioningEnabled = 'true'"!]
                  <MEMORY-SECTION>
                    <SHORT-NAME>SHARED_VAR_CLEARED_GLOBAL_UNSPECIFIED</SHORT-NAME>
                    <ALIGNMENT>UNSPECIFIED</ALIGNMENT>
                    <SW-ADDRMETHOD-REF DEST="SW-ADDR-METHOD">/AUTOSAR_MemMap/SwAddrMethods/VAR_CLEARED</SW-ADDRMETHOD-REF>
                  </MEMORY-SECTION>
[!ENDIF!]
[!FOR "index_i" = "0" TO "num:i(as:modconf('WdgM')[1]/WdgMGeneral/WdgMGeneralMulticore/WdgMNumberOfCores) -1"!]
                  <MEMORY-SECTION>
                    <SHORT-NAME>CORE_[!"num:i($index_i)"!]_VAR_CLEARED_16BIT</SHORT-NAME>
                    <ALIGNMENT>16</ALIGNMENT>
                    <PREFIX-REF
                      DEST="SECTION-NAME-PREFIX">/EB_WdgM/Implementations/BswImplementation_0/ResourceConsumption/CORE[!"num:i($index_i)"!]</PREFIX-REF>
                    <SW-ADDRMETHOD-REF DEST="SW-ADDR-METHOD">/AUTOSAR_MemMap/SwAddrMethods/VAR_CLEARED</SW-ADDRMETHOD-REF>
                    <SYMBOL>VAR_CLEARED_16BIT</SYMBOL>
                  </MEMORY-SECTION>
                  <MEMORY-SECTION>
                    <SHORT-NAME>CORE_[!"num:i($index_i)"!]_VAR_CLEARED_16</SHORT-NAME>
                    <ALIGNMENT>16</ALIGNMENT>
                    <PREFIX-REF
                      DEST="SECTION-NAME-PREFIX">/EB_WdgM/Implementations/BswImplementation_0/ResourceConsumption/CORE[!"num:i($index_i)"!]</PREFIX-REF>
                    <SW-ADDRMETHOD-REF DEST="SW-ADDR-METHOD">/AUTOSAR_MemMap/SwAddrMethods/VAR_CLEARED</SW-ADDRMETHOD-REF>
                    <SYMBOL>VAR_CLEARED_16</SYMBOL>
                  </MEMORY-SECTION>
                  <MEMORY-SECTION>
                    <SHORT-NAME>CORE_[!"num:i($index_i)"!]_VAR_INIT_UNSPECIFIED</SHORT-NAME>
                    <ALIGNMENT>UNSPECIFIED</ALIGNMENT>
                    <OPTIONS>
                       <OPTION>safetyAsilD</OPTION>
                       <OPTION>coreLocal</OPTION>
                    </OPTIONS>
                    <PREFIX-REF
                      DEST="SECTION-NAME-PREFIX">/EB_WdgM/Implementations/BswImplementation_0/ResourceConsumption/CORE[!"num:i($index_i)"!]</PREFIX-REF>
                    <SW-ADDRMETHOD-REF DEST="SW-ADDR-METHOD">/AUTOSAR_MemMap/SwAddrMethods/VAR_FAST_ASIL_D_LOCAL</SW-ADDRMETHOD-REF>
                    <SYMBOL>VAR_INIT_ASIL_D_LOCAL_UNSPECIFIED</SYMBOL>
                  </MEMORY-SECTION>
[!ENDFOR!]
[!ENDIF!]
                  <MEMORY-SECTION>
                    <SHORT-NAME>VAR_CLEARED_32</SHORT-NAME>
                    <ALIGNMENT>32</ALIGNMENT>
                    <SW-ADDRMETHOD-REF DEST="SW-ADDR-METHOD">/AUTOSAR_MemMap/SwAddrMethods/VAR_CLEARED</SW-ADDRMETHOD-REF>
                  </MEMORY-SECTION>
                  <MEMORY-SECTION>
                    <SHORT-NAME>VAR_POWER_ON_INIT_ASIL_D_16</SHORT-NAME>
                    <ALIGNMENT>16</ALIGNMENT>
                    <OPTIONS>
                       <OPTION>safetyAsilD</OPTION>
                    </OPTIONS>
                    <SW-ADDRMETHOD-REF DEST="SW-ADDR-METHOD">/AUTOSAR_MemMap/SwAddrMethods/VAR_POWER_ON_INIT_ASIL_D</SW-ADDRMETHOD-REF>
                  </MEMORY-SECTION>
                  <MEMORY-SECTION>
                    <SHORT-NAME>VAR_INIT_ASIL_D_32</SHORT-NAME>
                    <ALIGNMENT>32</ALIGNMENT>
                    <OPTIONS>
                       <OPTION>safetyAsilD</OPTION>
                    </OPTIONS>
                    <SW-ADDRMETHOD-REF DEST="SW-ADDR-METHOD">/AUTOSAR_MemMap/SwAddrMethods/VAR_INIT_ASIL_D</SW-ADDRMETHOD-REF>
                  </MEMORY-SECTION>
                  <MEMORY-SECTION>
                    <SHORT-NAME>VAR_POWER_ON_INIT_ASIL_D_UNSPECIFIED</SHORT-NAME>
                    <ALIGNMENT>UNSPECIFIED</ALIGNMENT>
                    <OPTIONS>
                      <OPTION>safetyAsilD</OPTION>
                    </OPTIONS>
                    <SW-ADDRMETHOD-REF DEST="SW-ADDR-METHOD">/AUTOSAR_MemMap/SwAddrMethods/VAR_POWER_ON_INIT_ASIL_D</SW-ADDRMETHOD-REF>
                  </MEMORY-SECTION>
[!// <!-- !LINKSTO WDGM.EB.TIMEPM.WDGM020305,1 -->
[!IF "WdgMGeneral/WdgMPartitioningEnabled = 'true'"!]
                  <MEMORY-SECTION>
                    <SHORT-NAME>SHARED_VAR_CLEARED_UNSPECIFIED</SHORT-NAME>
                    <ALIGNMENT>UNSPECIFIED</ALIGNMENT>
                    <SW-ADDRMETHOD-REF DEST="SW-ADDR-METHOD">/AUTOSAR_MemMap/SwAddrMethods/VAR_CLEARED</SW-ADDRMETHOD-REF>
                  </MEMORY-SECTION>
                  <MEMORY-SECTION>
                    <SHORT-NAME>SHARED_VAR_INIT_16</SHORT-NAME>
                    <ALIGNMENT>16</ALIGNMENT>
                    <SW-ADDRMETHOD-REF DEST="SW-ADDR-METHOD">/AUTOSAR_MemMap/SwAddrMethods/VAR_INIT</SW-ADDRMETHOD-REF>
                  </MEMORY-SECTION>
                  <MEMORY-SECTION>
                    <SHORT-NAME>SHARED_VAR_INIT_UNSPECIFIED</SHORT-NAME>
                    <ALIGNMENT>UNSPECIFIED</ALIGNMENT>
                    <SW-ADDRMETHOD-REF DEST="SW-ADDR-METHOD">/AUTOSAR_MemMap/SwAddrMethods/VAR_INIT</SW-ADDRMETHOD-REF>
                  </MEMORY-SECTION>
[!ENDIF!]
                </MEMORY-SECTIONS>
[!IF "node:exists(as:modconf('WdgM')[1]/WdgMGeneral/WdgMGeneralMulticore/WdgMNumberOfCores) and as:modconf('WdgM')[1]/WdgMGeneral/WdgMGeneralMulticore/WdgMNumberOfCores > 1"!]
                <SECTION-NAME-PREFIXS>
[!FOR "index_i" = "0" TO "num:i(as:modconf('WdgM')[1]/WdgMGeneral/WdgMGeneralMulticore/WdgMNumberOfCores)-1"!]
                  <SECTION-NAME-PREFIX>
                    <SHORT-NAME>CORE[!"num:i($index_i)"!]</SHORT-NAME>
                    <SYMBOL>WDGM_CORE[!"num:i($index_i)"!]</SYMBOL>
                  </SECTION-NAME-PREFIX>
[!ENDFOR!]
                </SECTION-NAME-PREFIXS>
[!ENDIF!]
              </RESOURCE-CONSUMPTION>
              <SW-VERSION>6.1.39</SW-VERSION>
[!IF "WdgMGeneral/WdgMRteUsage = 'true'"!]
              <SWC-BSW-MAPPING-REF DEST="SWC-BSW-MAPPING">/AUTOSAR_WdgM/SwcBswMappings/SwcBswMapping_0</SWC-BSW-MAPPING-REF>
[!ENDIF!]
              <VENDOR-ID>1</VENDOR-ID>
              <AR-RELEASE-VERSION>4.0.3</AR-RELEASE-VERSION>
              <BEHAVIOR-REF DEST="BSW-INTERNAL-BEHAVIOR">/AUTOSAR_WdgM/BswModuleDescriptions/WdgM/InternalBehavior_0</BEHAVIOR-REF>
              <VENDOR-SPECIFIC-MODULE-DEF-REFS>
                <VENDOR-SPECIFIC-MODULE-DEF-REF DEST="ECUC-MODULE-DEF">/TS_TxDxM6I1R0/WdgM</VENDOR-SPECIFIC-MODULE-DEF-REF>
              </VENDOR-SPECIFIC-MODULE-DEF-REFS>
            </BSW-IMPLEMENTATION>
          </ELEMENTS>
        </AR-PACKAGE>
      </AR-PACKAGES>
    </AR-PACKAGE>
  </AR-PACKAGES>
</AUTOSAR>
