<?xml version="1.0" encoding="UTF-8"?>
[!AUTOSPACING!]
<AUTOSAR xmlns="http://autosar.org/schema/r4.0"
  xmlns:xsi="http://www.w3.org/2001/XMLSchema-instance"
  xsi:schemaLocation="http://autosar.org/schema/r4.0 AUTOSAR_4-0-3_STRICT_COMPACT.xsd">
  [!/* do not generate this file if RTE is not used */!]
  [!SKIPFILE "(WdgMGeneral/WdgMRteUsage = 'false') or not(node:exists(WdgMGeneral/WdgMServiceAPI))"!][!//
  [!IF "node:exists(WdgMGeneral/WdgMServiceAPI) and  WdgMGeneral/WdgMServiceAPI/WdgMDefaultASRServiceAPI = 'AUTOSAR_32'"!][!//
  [!VAR "swComponentTypePackageName" = "'ComponentTypes'"!][!//
  [!VAR "swcImplementationPackageName" = "'Implementations'"!][!//
  [!VAR "swcImplementationDataTypesPackageName" = "'Datatypes'"!][!//
  [!ELSE!][!//
  [!VAR "swComponentTypePackageName" = "'SwComponentTypes'"!][!//
  [!VAR "swcImplementationPackageName" = "'SwcImplementations'"!][!//
  [!VAR "swcImplementationDataTypesPackageName" = "'ImplementationDataTypes'"!][!//
  [!ENDIF!][!//
  <AR-PACKAGES>
    <AR-PACKAGE> <!-- AUTOSAR_WdgM -->
      <SHORT-NAME>AUTOSAR_WdgM</SHORT-NAME>
      <AR-PACKAGES>
        <AR-PACKAGE> <!-- SwComponentTypes/ComponentTypes -->
          <SHORT-NAME>[!"$swComponentTypePackageName"!]</SHORT-NAME>
          <ELEMENTS>
            <SERVICE-SW-COMPONENT-TYPE>
              <SHORT-NAME>WdgM</SHORT-NAME>
              <PORTS>
[!IF "node:exists(WdgMGeneral/WdgMServiceAPI) and (WdgMGeneral/WdgMServiceAPI/WdgMEnableASR32ServiceAPI = 'true')"!]
<!-- Provide AUTOSAR 3.2 service -->
  [!/* global mode port */!]
                <P-PORT-PROTOTYPE>
                  <SHORT-NAME>WdgM_ASR32_globalMode</SHORT-NAME>
                  <PROVIDED-INTERFACE-TREF DEST="MODE-SWITCH-INTERFACE">/AUTOSAR_WdgM/ASR32/PortInterfaces/WdgM_ASR32_GlobalMode</PROVIDED-INTERFACE-TREF>
                </P-PORT-PROTOTYPE>
  [!LOOP "WdgMGeneral/WdgMSupervisedEntity/*"!]
  [!/* ports for alive supervision per SE */!]
                <P-PORT-PROTOTYPE>
                  <SHORT-NAME>alive_ASR32_[!"name(.)"!]</SHORT-NAME>
                  <PROVIDED-COM-SPECS>
                    <SERVER-COM-SPEC>
                      <OPERATION-REF DEST="CLIENT-SERVER-OPERATION">/AUTOSAR_WdgM/ASR32/PortInterfaces/WdgM_ASR32_AliveSupervision/UpdateAliveCounter</OPERATION-REF>
                      <QUEUE-LENGTH>1</QUEUE-LENGTH>
                    </SERVER-COM-SPEC>
    [!IF "node:exists(../../WdgMServiceAPI/WdgMEnableASR32ActivateAliveSupervisionAPI)"!]
                    <SERVER-COM-SPEC>
                      <OPERATION-REF DEST="CLIENT-SERVER-OPERATION">/AUTOSAR_WdgM/ASR32/PortInterfaces/WdgM_ASR32_AliveSupervision/ActivateAliveSupervision</OPERATION-REF>
                      <QUEUE-LENGTH>1</QUEUE-LENGTH>
                    </SERVER-COM-SPEC>
    [!ENDIF!]
    [!IF "node:exists(../../WdgMServiceAPI/WdgMEnableASR32DeactivateAliveSupervisionAPI)"!]
                    <SERVER-COM-SPEC>
                      <OPERATION-REF DEST="CLIENT-SERVER-OPERATION">/AUTOSAR_WdgM/ASR32/PortInterfaces/WdgM_ASR32_AliveSupervision/DeactivateAliveSupervision</OPERATION-REF>
                      <QUEUE-LENGTH>1</QUEUE-LENGTH>
                    </SERVER-COM-SPEC>
    [!ENDIF!]
                  </PROVIDED-COM-SPECS>
                  <PROVIDED-INTERFACE-TREF DEST="CLIENT-SERVER-INTERFACE">/AUTOSAR_WdgM/ASR32/PortInterfaces/WdgM_ASR32_AliveSupervision</PROVIDED-INTERFACE-TREF>
                </P-PORT-PROTOTYPE>
  [!/* individual mode port per SE */!]
                <P-PORT-PROTOTYPE>
                  <SHORT-NAME>mode_ASR32_[!"name(.)"!]</SHORT-NAME>
                  <PROVIDED-INTERFACE-TREF DEST="MODE-SWITCH-INTERFACE">/AUTOSAR_WdgM/ASR32/PortInterfaces/WdgM_ASR32_IndividualMode</PROVIDED-INTERFACE-TREF>
                </P-PORT-PROTOTYPE>
  [!ENDLOOP!]
[!ENDIF!]
[!IF "node:exists(WdgMGeneral/WdgMServiceAPI) and (WdgMGeneral/WdgMServiceAPI/WdgMEnableASR40ServiceAPI = 'true')"!]
<!-- Provide AUTOSAR 4.0 service -->
  [!/* global mode port */!]
                <P-PORT-PROTOTYPE>
                  <SHORT-NAME>WdgM_ASR40_globalMode</SHORT-NAME>
                  <PROVIDED-INTERFACE-TREF DEST="MODE-SWITCH-INTERFACE">/AUTOSAR_WdgM/ASR40/PortInterfaces/WdgM_ASR40_GlobalMode</PROVIDED-INTERFACE-TREF>
                </P-PORT-PROTOTYPE>
  [!LOOP "WdgMGeneral/WdgMSupervisedEntity/*"!]
  [!/* ports for alive supervision per SE */!]
                <P-PORT-PROTOTYPE>
                  <SHORT-NAME>alive_ASR40_[!"name(.)"!]</SHORT-NAME>
                  <PROVIDED-COM-SPECS>
                    <SERVER-COM-SPEC>
                      <OPERATION-REF DEST="CLIENT-SERVER-OPERATION">/AUTOSAR_WdgM/ASR40/PortInterfaces/WdgM_ASR40_AliveSupervision/UpdateAliveCounter</OPERATION-REF>
                      <QUEUE-LENGTH>1</QUEUE-LENGTH>
                    </SERVER-COM-SPEC>
                    <SERVER-COM-SPEC>
                      <OPERATION-REF DEST="CLIENT-SERVER-OPERATION">/AUTOSAR_WdgM/ASR40/PortInterfaces/WdgM_ASR40_AliveSupervision/CheckpointReached</OPERATION-REF>
                      <QUEUE-LENGTH>1</QUEUE-LENGTH>
                    </SERVER-COM-SPEC>
                  </PROVIDED-COM-SPECS>
                  <PROVIDED-INTERFACE-TREF DEST="CLIENT-SERVER-INTERFACE">/AUTOSAR_WdgM/ASR40/PortInterfaces/WdgM_ASR40_AliveSupervision</PROVIDED-INTERFACE-TREF>
                </P-PORT-PROTOTYPE>
  [!/* individual mode port per SE */!]
                <P-PORT-PROTOTYPE>
                  <SHORT-NAME>mode_ASR40_[!"name(.)"!]</SHORT-NAME>
                  <PROVIDED-INTERFACE-TREF DEST="MODE-SWITCH-INTERFACE">/AUTOSAR_WdgM/ASR40/PortInterfaces/WdgM_ASR40_IndividualMode</PROVIDED-INTERFACE-TREF>
                </P-PORT-PROTOTYPE>
  [!ENDLOOP!]
[!ENDIF!]
[!IF "node:exists(WdgMGeneral/WdgMServiceAPI) and WdgMGeneral/WdgMServiceAPI/WdgMDefaultASRServiceAPI = 'AUTOSAR_32'"!]
<!-- Provide AUTOSAR 3.2 as default service -->
[!/* global mode port */!]
                <P-PORT-PROTOTYPE>
                  <SHORT-NAME>globalMode</SHORT-NAME>
                  <PROVIDED-INTERFACE-TREF DEST="MODE-SWITCH-INTERFACE">/AUTOSAR_WdgM/PortInterfaces/WdgM_GlobalMode</PROVIDED-INTERFACE-TREF>
                </P-PORT-PROTOTYPE>
  [!LOOP "WdgMGeneral/WdgMSupervisedEntity/*"!]
  [!/* ports for alive supervision per SE */!]
                <P-PORT-PROTOTYPE>
                  <SHORT-NAME>alive_[!"name(.)"!]</SHORT-NAME>
                  <PROVIDED-COM-SPECS>
                    <SERVER-COM-SPEC>
                      <OPERATION-REF DEST="CLIENT-SERVER-OPERATION">/AUTOSAR_WdgM/PortInterfaces/WdgM_AliveSupervision/UpdateAliveCounter</OPERATION-REF>
                      <QUEUE-LENGTH>1</QUEUE-LENGTH>
                    </SERVER-COM-SPEC>
    [!IF "node:exists(../../WdgMServiceAPI/WdgMEnableASR32ActivateAliveSupervisionAPI)"!]
                    <SERVER-COM-SPEC>
                      <OPERATION-REF DEST="CLIENT-SERVER-OPERATION">/AUTOSAR_WdgM/PortInterfaces/WdgM_AliveSupervision/ActivateAliveSupervision</OPERATION-REF>
                      <QUEUE-LENGTH>1</QUEUE-LENGTH>
                    </SERVER-COM-SPEC>
    [!ENDIF!]
    [!IF "node:exists(../../WdgMServiceAPI/WdgMEnableASR32DeactivateAliveSupervisionAPI)"!]
                    <SERVER-COM-SPEC>
                      <OPERATION-REF DEST="CLIENT-SERVER-OPERATION">/AUTOSAR_WdgM/PortInterfaces/WdgM_AliveSupervision/DeactivateAliveSupervision</OPERATION-REF>
                      <QUEUE-LENGTH>1</QUEUE-LENGTH>
                    </SERVER-COM-SPEC>
    [!ENDIF!]
                  </PROVIDED-COM-SPECS>
                  <PROVIDED-INTERFACE-TREF DEST="CLIENT-SERVER-INTERFACE">/AUTOSAR_WdgM/PortInterfaces/WdgM_AliveSupervision</PROVIDED-INTERFACE-TREF>
                </P-PORT-PROTOTYPE>
  [!/* individual mode port per SE */!]
                <P-PORT-PROTOTYPE>
                  <SHORT-NAME>mode_[!"name(.)"!]</SHORT-NAME>
                  <PROVIDED-INTERFACE-TREF DEST="MODE-SWITCH-INTERFACE">/AUTOSAR_WdgM/PortInterfaces/WdgM_IndividualMode</PROVIDED-INTERFACE-TREF>
                </P-PORT-PROTOTYPE>
  [!ENDLOOP!]
[!ENDIF!]
[!IF "node:exists(WdgMGeneral/WdgMServiceAPI) and WdgMGeneral/WdgMServiceAPI/WdgMDefaultASRServiceAPI = 'AUTOSAR_40'"!]
  <!-- Provide AUTOSAR 4.0 as default service -->
  [!/* global mode port */!]
                <P-PORT-PROTOTYPE>
                  <SHORT-NAME>globalMode</SHORT-NAME>
                  <PROVIDED-INTERFACE-TREF DEST="MODE-SWITCH-INTERFACE">/AUTOSAR_WdgM/PortInterfaces/WdgM_GlobalMode</PROVIDED-INTERFACE-TREF>
                </P-PORT-PROTOTYPE>
  [!LOOP "WdgMGeneral/WdgMSupervisedEntity/*"!]
  [!/* ports for alive supervision per SE */!]
                <P-PORT-PROTOTYPE>
                  <SHORT-NAME>alive_[!"name(.)"!]</SHORT-NAME>
                  <PROVIDED-COM-SPECS>
                    <SERVER-COM-SPEC>
                      <OPERATION-REF DEST="CLIENT-SERVER-OPERATION">/AUTOSAR_WdgM/PortInterfaces/WdgM_AliveSupervision/UpdateAliveCounter</OPERATION-REF>
                      <QUEUE-LENGTH>1</QUEUE-LENGTH>
                    </SERVER-COM-SPEC>
                    <SERVER-COM-SPEC>
                      <OPERATION-REF DEST="CLIENT-SERVER-OPERATION">/AUTOSAR_WdgM/PortInterfaces/WdgM_AliveSupervision/CheckpointReached</OPERATION-REF>
                      <QUEUE-LENGTH>1</QUEUE-LENGTH>
                    </SERVER-COM-SPEC>
                  </PROVIDED-COM-SPECS>
                  <PROVIDED-INTERFACE-TREF DEST="CLIENT-SERVER-INTERFACE">/AUTOSAR_WdgM/PortInterfaces/WdgM_AliveSupervision</PROVIDED-INTERFACE-TREF>
                </P-PORT-PROTOTYPE>
  [!/* individual mode port per SE */!]
                <P-PORT-PROTOTYPE>
                  <SHORT-NAME>mode_[!"name(.)"!]</SHORT-NAME>
                  <PROVIDED-INTERFACE-TREF DEST="MODE-SWITCH-INTERFACE">/AUTOSAR_WdgM/PortInterfaces/WdgM_IndividualMode</PROVIDED-INTERFACE-TREF>
                </P-PORT-PROTOTYPE>
  [!ENDLOOP!]
[!ENDIF!]
              </PORTS>
              <INTERNAL-BEHAVIORS>
                <SWC-INTERNAL-BEHAVIOR>
                  <SHORT-NAME>SwcInternalBehavior_0</SHORT-NAME>
                  <DATA-TYPE-MAPPING-REFS>
[!IF "node:exists(WdgMGeneral/WdgMServiceAPI) and (WdgMGeneral/WdgMServiceAPI/WdgMEnableASR32ServiceAPI = 'true')"!]
<!-- Provide AUTOSAR 3.2 DataTypeMappings -->
                    <DATA-TYPE-MAPPING-REF DEST="DATA-TYPE-MAPPING-SET">/AUTOSAR_WdgM/ASR32/ImplementationDataTypes/WdgM_ASR32_DataTypeMappingSet</DATA-TYPE-MAPPING-REF>
[!ENDIF!]
[!IF "node:exists(WdgMGeneral/WdgMServiceAPI) and (WdgMGeneral/WdgMServiceAPI/WdgMEnableASR40ServiceAPI = 'true')"!]
<!-- Provide AUTOSAR 4.0 DataTypeMappings -->
                    <DATA-TYPE-MAPPING-REF DEST="DATA-TYPE-MAPPING-SET">/AUTOSAR_WdgM/ASR40/ImplementationDataTypes/WdgM_ASR40_DataTypeMappingSet</DATA-TYPE-MAPPING-REF>

[!ENDIF!]
[!IF "node:exists(WdgMGeneral/WdgMServiceAPI) and WdgMGeneral/WdgMServiceAPI/WdgMDefaultASRServiceAPI != 'NONE'"!]
<!-- Provide default DataTypeMappings -->
                    <DATA-TYPE-MAPPING-REF DEST="DATA-TYPE-MAPPING-SET">/AUTOSAR_WdgM/[!"$swcImplementationDataTypesPackageName"!]/WdgMDataTypeMappingSet</DATA-TYPE-MAPPING-REF>
[!ENDIF!]
                  </DATA-TYPE-MAPPING-REFS>
                  <EVENTS>
[!IF "node:exists(WdgMGeneral/WdgMServiceAPI) and (WdgMGeneral/WdgMServiceAPI/WdgMEnableASR32ServiceAPI = 'true')"!]
<!-- Provide AUTOSAR 3.2 service -->
  [!LOOP "WdgMGeneral/WdgMSupervisedEntity/*"!]
                    <OPERATION-INVOKED-EVENT>
                      <SHORT-NAME>EV_ASR32_UpdateAliveCounter_SE_[!"name(.)"!]</SHORT-NAME>
                      <START-ON-EVENT-REF DEST="RUNNABLE-ENTITY">/AUTOSAR_WdgM/[!"$swComponentTypePackageName"!]/WdgM/SwcInternalBehavior_0/RE_ASR32_UpdateAliveCounter</START-ON-EVENT-REF>
                      <OPERATION-IREF>
                        <CONTEXT-P-PORT-REF DEST="P-PORT-PROTOTYPE">/AUTOSAR_WdgM/[!"$swComponentTypePackageName"!]/WdgM/alive_ASR32_[!"name(.)"!]</CONTEXT-P-PORT-REF>
                        <TARGET-PROVIDED-OPERATION-REF DEST="CLIENT-SERVER-OPERATION">/AUTOSAR_WdgM/ASR32/PortInterfaces/WdgM_ASR32_AliveSupervision/UpdateAliveCounter</TARGET-PROVIDED-OPERATION-REF>
                      </OPERATION-IREF>
                    </OPERATION-INVOKED-EVENT>
    [!IF "node:exists(../../WdgMServiceAPI/WdgMEnableASR32ActivateAliveSupervisionAPI)"!]
                    <OPERATION-INVOKED-EVENT>
                      <SHORT-NAME>EV_ASR32_ActAliveSuperv_SE_[!"name(.)"!]</SHORT-NAME>
                      <START-ON-EVENT-REF DEST="RUNNABLE-ENTITY">/AUTOSAR_WdgM/[!"$swComponentTypePackageName"!]/WdgM/SwcInternalBehavior_0/RE_ASR32_ActivateAliveSupervision</START-ON-EVENT-REF>
                      <OPERATION-IREF>
                        <CONTEXT-P-PORT-REF DEST="P-PORT-PROTOTYPE">/AUTOSAR_WdgM/[!"$swComponentTypePackageName"!]/WdgM/alive_ASR32_[!"name(.)"!]</CONTEXT-P-PORT-REF>
                        <TARGET-PROVIDED-OPERATION-REF DEST="CLIENT-SERVER-OPERATION">/AUTOSAR_WdgM/ASR32/PortInterfaces/WdgM_ASR32_AliveSupervision/ActivateAliveSupervision</TARGET-PROVIDED-OPERATION-REF>
                      </OPERATION-IREF>
                    </OPERATION-INVOKED-EVENT>
    [!ENDIF!]
    [!IF "node:exists(../../WdgMServiceAPI/WdgMEnableASR32DeactivateAliveSupervisionAPI)"!]
                    <OPERATION-INVOKED-EVENT>
                      <SHORT-NAME>EV_ASR32_DeactAliveSuperv_SE_[!"name(.)"!]</SHORT-NAME>
                      <START-ON-EVENT-REF DEST="RUNNABLE-ENTITY">/AUTOSAR_WdgM/[!"$swComponentTypePackageName"!]/WdgM/SwcInternalBehavior_0/RE_ASR32_DeactivateAliveSupervision</START-ON-EVENT-REF>
                      <OPERATION-IREF>
                        <CONTEXT-P-PORT-REF DEST="P-PORT-PROTOTYPE">/AUTOSAR_WdgM/[!"$swComponentTypePackageName"!]/WdgM/alive_ASR32_[!"name(.)"!]</CONTEXT-P-PORT-REF>
                        <TARGET-PROVIDED-OPERATION-REF DEST="CLIENT-SERVER-OPERATION">/AUTOSAR_WdgM/ASR32/PortInterfaces/WdgM_ASR32_AliveSupervision/DeactivateAliveSupervision</TARGET-PROVIDED-OPERATION-REF>
                      </OPERATION-IREF>
                    </OPERATION-INVOKED-EVENT>
    [!ENDIF!]
  [!ENDLOOP!]
[!ENDIF!]
[!IF "node:exists(WdgMGeneral/WdgMServiceAPI) and (WdgMGeneral/WdgMServiceAPI/WdgMEnableASR40ServiceAPI = 'true')"!]
<!-- Provide AUTOSAR 4.0 service -->
  [!LOOP "WdgMGeneral/WdgMSupervisedEntity/*"!]
                    <OPERATION-INVOKED-EVENT>
                      <SHORT-NAME>EV_ASR40_UpdateAliveCounter_SE_[!"name(.)"!]</SHORT-NAME>
                      <START-ON-EVENT-REF DEST="RUNNABLE-ENTITY">/AUTOSAR_WdgM/[!"$swComponentTypePackageName"!]/WdgM/SwcInternalBehavior_0/RE_ASR40_UpdateAliveCounter</START-ON-EVENT-REF>
                      <OPERATION-IREF>
                        <CONTEXT-P-PORT-REF DEST="P-PORT-PROTOTYPE">/AUTOSAR_WdgM/[!"$swComponentTypePackageName"!]/WdgM/alive_ASR40_[!"name(.)"!]</CONTEXT-P-PORT-REF>
                        <TARGET-PROVIDED-OPERATION-REF DEST="CLIENT-SERVER-OPERATION">/AUTOSAR_WdgM/ASR40/PortInterfaces/WdgM_ASR40_AliveSupervision/UpdateAliveCounter</TARGET-PROVIDED-OPERATION-REF>
                      </OPERATION-IREF>
                    </OPERATION-INVOKED-EVENT>
                    <OPERATION-INVOKED-EVENT>
                      <SHORT-NAME>EV_ASR40_CheckpointReached_SE_[!"name(.)"!]</SHORT-NAME>
                      <START-ON-EVENT-REF DEST="RUNNABLE-ENTITY">/AUTOSAR_WdgM/[!"$swComponentTypePackageName"!]/WdgM/SwcInternalBehavior_0/RE_ASR40_CheckpointReached</START-ON-EVENT-REF>
                      <OPERATION-IREF>
                        <CONTEXT-P-PORT-REF DEST="P-PORT-PROTOTYPE">/AUTOSAR_WdgM/[!"$swComponentTypePackageName"!]/WdgM/alive_ASR40_[!"name(.)"!]</CONTEXT-P-PORT-REF>
                        <TARGET-PROVIDED-OPERATION-REF DEST="CLIENT-SERVER-OPERATION">/AUTOSAR_WdgM/ASR40/PortInterfaces/WdgM_ASR40_AliveSupervision/CheckpointReached</TARGET-PROVIDED-OPERATION-REF>
                      </OPERATION-IREF>
                    </OPERATION-INVOKED-EVENT>
  [!ENDLOOP!]
[!ENDIF!]
[!IF "node:exists(WdgMGeneral/WdgMServiceAPI) and WdgMGeneral/WdgMServiceAPI/WdgMDefaultASRServiceAPI != 'NONE'"!]
<!-- Provide default service -->
  [!LOOP "WdgMGeneral/WdgMSupervisedEntity/*"!]
                    <OPERATION-INVOKED-EVENT>
                      <SHORT-NAME>EV_UpdateAliveCounter_SE_[!"name(.)"!]</SHORT-NAME>
                      <START-ON-EVENT-REF DEST="RUNNABLE-ENTITY">/AUTOSAR_WdgM/[!"$swComponentTypePackageName"!]/WdgM/SwcInternalBehavior_0/RE_UpdateAliveCounter</START-ON-EVENT-REF>
                      <OPERATION-IREF>
                        <CONTEXT-P-PORT-REF DEST="P-PORT-PROTOTYPE">/AUTOSAR_WdgM/[!"$swComponentTypePackageName"!]/WdgM/alive_[!"name(.)"!]</CONTEXT-P-PORT-REF>
                        <TARGET-PROVIDED-OPERATION-REF DEST="CLIENT-SERVER-OPERATION">/AUTOSAR_WdgM/PortInterfaces/WdgM_AliveSupervision/UpdateAliveCounter</TARGET-PROVIDED-OPERATION-REF>
                      </OPERATION-IREF>
                    </OPERATION-INVOKED-EVENT>
    [!IF "../../WdgMServiceAPI/WdgMDefaultASRServiceAPI = 'AUTOSAR_40'"!]
                    <OPERATION-INVOKED-EVENT>
                      <SHORT-NAME>EV_CheckpointReached_SE_[!"name(.)"!]</SHORT-NAME>
                      <START-ON-EVENT-REF DEST="RUNNABLE-ENTITY">/AUTOSAR_WdgM/[!"$swComponentTypePackageName"!]/WdgM/SwcInternalBehavior_0/RE_CheckpointReached</START-ON-EVENT-REF>
                      <OPERATION-IREF>
                        <CONTEXT-P-PORT-REF DEST="P-PORT-PROTOTYPE">/AUTOSAR_WdgM/[!"$swComponentTypePackageName"!]/WdgM/alive_[!"name(.)"!]</CONTEXT-P-PORT-REF>
                        <TARGET-PROVIDED-OPERATION-REF DEST="CLIENT-SERVER-OPERATION">/AUTOSAR_WdgM/PortInterfaces/WdgM_AliveSupervision/CheckpointReached</TARGET-PROVIDED-OPERATION-REF>
                      </OPERATION-IREF>
                    </OPERATION-INVOKED-EVENT>
    [!ENDIF!]
    [!IF "../../WdgMServiceAPI/WdgMDefaultASRServiceAPI = 'AUTOSAR_32'"!]
      [!IF "node:exists(../../WdgMServiceAPI/WdgMEnableASR32ActivateAliveSupervisionAPI)"!]
                    <OPERATION-INVOKED-EVENT>
                      <SHORT-NAME>EV_ActAliveSuperv_SE_[!"name(.)"!]</SHORT-NAME>
                      <START-ON-EVENT-REF DEST="RUNNABLE-ENTITY">/AUTOSAR_WdgM/[!"$swComponentTypePackageName"!]/WdgM/SwcInternalBehavior_0/RE_ActivateAliveSupervision</START-ON-EVENT-REF>
                      <OPERATION-IREF>
                        <CONTEXT-P-PORT-REF DEST="P-PORT-PROTOTYPE">/AUTOSAR_WdgM/[!"$swComponentTypePackageName"!]/WdgM/alive_[!"name(.)"!]</CONTEXT-P-PORT-REF>
                        <TARGET-PROVIDED-OPERATION-REF DEST="CLIENT-SERVER-OPERATION">/AUTOSAR_WdgM/PortInterfaces/WdgM_AliveSupervision/ActivateAliveSupervision</TARGET-PROVIDED-OPERATION-REF>
                      </OPERATION-IREF>
                    </OPERATION-INVOKED-EVENT>
      [!ENDIF!]
      [!IF "node:exists(../../WdgMServiceAPI/WdgMEnableASR32DeactivateAliveSupervisionAPI)"!]
                    <OPERATION-INVOKED-EVENT>
                      <SHORT-NAME>EV_DeactAliveSuperv_SE_[!"name(.)"!]</SHORT-NAME>
                      <START-ON-EVENT-REF DEST="RUNNABLE-ENTITY">/AUTOSAR_WdgM/[!"$swComponentTypePackageName"!]/WdgM/SwcInternalBehavior_0/RE_DeactivateAliveSupervision</START-ON-EVENT-REF>
                      <OPERATION-IREF>
                        <CONTEXT-P-PORT-REF DEST="P-PORT-PROTOTYPE">/AUTOSAR_WdgM/[!"$swComponentTypePackageName"!]/WdgM/alive_[!"name(.)"!]</CONTEXT-P-PORT-REF>
                        <TARGET-PROVIDED-OPERATION-REF DEST="CLIENT-SERVER-OPERATION">/AUTOSAR_WdgM/PortInterfaces/WdgM_AliveSupervision/DeactivateAliveSupervision</TARGET-PROVIDED-OPERATION-REF>
                      </OPERATION-IREF>
                    </OPERATION-INVOKED-EVENT>
      [!ENDIF!]
    [!ENDIF!]
  [!ENDLOOP!]
[!ENDIF!]
                  </EVENTS>
                  <HANDLE-TERMINATION-AND-RESTART>NO-SUPPORT</HANDLE-TERMINATION-AND-RESTART>
                  <PORT-API-OPTIONS>
[!IF "node:exists(WdgMGeneral/WdgMServiceAPI) and (WdgMGeneral/WdgMServiceAPI/WdgMEnableASR32ServiceAPI = 'true')"!]
<!-- Port API options for AUTOSAR 3.2 -->
                    <PORT-API-OPTION>
                      <ENABLE-TAKE-ADDRESS>true</ENABLE-TAKE-ADDRESS>
                      <INDIRECT-API>false</INDIRECT-API>
                      <PORT-REF DEST="P-PORT-PROTOTYPE">/AUTOSAR_WdgM/[!"$swComponentTypePackageName"!]/WdgM/WdgM_ASR32_globalMode</PORT-REF>
                    </PORT-API-OPTION>
  [!LOOP "WdgMGeneral/WdgMSupervisedEntity/*"!]
                    <PORT-API-OPTION>
                      <ENABLE-TAKE-ADDRESS>false</ENABLE-TAKE-ADDRESS>
                      <INDIRECT-API>false</INDIRECT-API>
                      <PORT-ARG-VALUES>
                        <PORT-DEFINED-ARGUMENT-VALUE>
                          <VALUE>
                            <NUMERICAL-VALUE-SPECIFICATION>
                              <SHORT-LABEL>PORTARG_ASR32_SE_[!"name(.)"!]</SHORT-LABEL>
                              <VALUE>[!"num:i(WdgMSupervisedEntityId)"!]</VALUE>
                            </NUMERICAL-VALUE-SPECIFICATION>
                          </VALUE>
                          <VALUE-TYPE-TREF DEST="IMPLEMENTATION-DATA-TYPE">/AUTOSAR_WdgM/ASR32/ImplementationDataTypes/WdgM_ASR32_SupervisedEntityIdType</VALUE-TYPE-TREF>
                        </PORT-DEFINED-ARGUMENT-VALUE>
                      </PORT-ARG-VALUES>
                      <PORT-REF DEST="P-PORT-PROTOTYPE">/AUTOSAR_WdgM/[!"$swComponentTypePackageName"!]/WdgM/alive_ASR32_[!"name(.)"!]</PORT-REF>
                    </PORT-API-OPTION>
                    <PORT-API-OPTION>
                      <ENABLE-TAKE-ADDRESS>true</ENABLE-TAKE-ADDRESS>
                      <INDIRECT-API>false</INDIRECT-API>
                      <PORT-REF DEST="P-PORT-PROTOTYPE">/AUTOSAR_WdgM/[!"$swComponentTypePackageName"!]/WdgM/mode_ASR32_[!"name(.)"!]</PORT-REF>
                    </PORT-API-OPTION>
  [!ENDLOOP!]
[!ENDIF!]
[!IF "node:exists(WdgMGeneral/WdgMServiceAPI) and (WdgMGeneral/WdgMServiceAPI/WdgMEnableASR40ServiceAPI = 'true')"!]
<!-- Port API options for AUTOSAR 4.0 -->
                    <PORT-API-OPTION>
                      <ENABLE-TAKE-ADDRESS>true</ENABLE-TAKE-ADDRESS>
                      <INDIRECT-API>false</INDIRECT-API>
                      <PORT-REF DEST="P-PORT-PROTOTYPE">/AUTOSAR_WdgM/[!"$swComponentTypePackageName"!]/WdgM/WdgM_ASR40_globalMode</PORT-REF>
                    </PORT-API-OPTION>
  [!LOOP "WdgMGeneral/WdgMSupervisedEntity/*"!]
                    <PORT-API-OPTION>
                      <ENABLE-TAKE-ADDRESS>false</ENABLE-TAKE-ADDRESS>
                      <INDIRECT-API>false</INDIRECT-API>
                      <PORT-ARG-VALUES>
                        <PORT-DEFINED-ARGUMENT-VALUE>
                          <VALUE>
                            <NUMERICAL-VALUE-SPECIFICATION>
                              <SHORT-LABEL>PORTARG_ASR40_SE_[!"name(.)"!]</SHORT-LABEL>
                              <VALUE>[!"num:i(WdgMSupervisedEntityId)"!]</VALUE>
                            </NUMERICAL-VALUE-SPECIFICATION>
                          </VALUE>
                          <VALUE-TYPE-TREF DEST="IMPLEMENTATION-DATA-TYPE">/AUTOSAR_WdgM/ASR40/ImplementationDataTypes/WdgM_ASR40_SupervisedEntityIdType</VALUE-TYPE-TREF>
                        </PORT-DEFINED-ARGUMENT-VALUE>
                      </PORT-ARG-VALUES>
                      <PORT-REF DEST="P-PORT-PROTOTYPE">/AUTOSAR_WdgM/[!"$swComponentTypePackageName"!]/WdgM/alive_ASR40_[!"name(.)"!]</PORT-REF>
                    </PORT-API-OPTION>
                    <PORT-API-OPTION>
                      <ENABLE-TAKE-ADDRESS>true</ENABLE-TAKE-ADDRESS>
                      <INDIRECT-API>false</INDIRECT-API>
                      <PORT-REF DEST="P-PORT-PROTOTYPE">/AUTOSAR_WdgM/[!"$swComponentTypePackageName"!]/WdgM/mode_ASR40_[!"name(.)"!]</PORT-REF>
                    </PORT-API-OPTION>
  [!ENDLOOP!]
[!ENDIF!]
[!IF "node:exists(WdgMGeneral/WdgMServiceAPI) and WdgMGeneral/WdgMServiceAPI/WdgMDefaultASRServiceAPI != 'NONE'"!]
<!-- Port API options for default service -->
                    <PORT-API-OPTION>
                      <ENABLE-TAKE-ADDRESS>true</ENABLE-TAKE-ADDRESS>
                      <INDIRECT-API>false</INDIRECT-API>
                      <PORT-REF DEST="P-PORT-PROTOTYPE">/AUTOSAR_WdgM/[!"$swComponentTypePackageName"!]/WdgM/globalMode</PORT-REF>
                    </PORT-API-OPTION>
  [!LOOP "WdgMGeneral/WdgMSupervisedEntity/*"!]
                    <PORT-API-OPTION>
                      <ENABLE-TAKE-ADDRESS>false</ENABLE-TAKE-ADDRESS>
                      <INDIRECT-API>false</INDIRECT-API>
                      <PORT-ARG-VALUES>
                        <PORT-DEFINED-ARGUMENT-VALUE>
                          <VALUE>
                            <NUMERICAL-VALUE-SPECIFICATION>
                              <SHORT-LABEL>PORTARG_SE_[!"name(.)"!]</SHORT-LABEL>
                              <VALUE>[!"num:i(WdgMSupervisedEntityId)"!]</VALUE>
                            </NUMERICAL-VALUE-SPECIFICATION>
                          </VALUE>
                          <VALUE-TYPE-TREF DEST="IMPLEMENTATION-DATA-TYPE">/AUTOSAR_WdgM/[!"$swcImplementationDataTypesPackageName"!]/WdgM_SupervisedEntityIdType</VALUE-TYPE-TREF>
                        </PORT-DEFINED-ARGUMENT-VALUE>
                      </PORT-ARG-VALUES>
                      <PORT-REF DEST="P-PORT-PROTOTYPE">/AUTOSAR_WdgM/[!"$swComponentTypePackageName"!]/WdgM/alive_[!"name(.)"!]</PORT-REF>
                    </PORT-API-OPTION>
                    <!-- switch functions must be accessible via function pointer -->
                    <PORT-API-OPTION>
                      <ENABLE-TAKE-ADDRESS>true</ENABLE-TAKE-ADDRESS>
                      <INDIRECT-API>false</INDIRECT-API>
                      <PORT-REF DEST="P-PORT-PROTOTYPE">/AUTOSAR_WdgM/[!"$swComponentTypePackageName"!]/WdgM/mode_[!"name(.)"!]</PORT-REF>
                    </PORT-API-OPTION>
  [!ENDLOOP!]
[!ENDIF!]
                  </PORT-API-OPTIONS>
                  <RUNNABLES>
                    <RUNNABLE-ENTITY>
                      <SHORT-NAME>RE_Main</SHORT-NAME>
                      <MINIMUM-START-INTERVAL>0</MINIMUM-START-INTERVAL>
                      <CAN-BE-INVOKED-CONCURRENTLY>false</CAN-BE-INVOKED-CONCURRENTLY>
                      <MODE-ACCESS-POINTS>
[!IF "node:exists(WdgMGeneral/WdgMServiceAPI) and (WdgMGeneral/WdgMServiceAPI/WdgMEnableASR32ServiceAPI = 'true')"!]
                        <MODE-ACCESS-POINT>
                          <MODE-GROUP-IREF>
                            <P-MODE-GROUP-IN-ATOMIC-SWC-INSTANCE-REF>
                              <CONTEXT-P-PORT-REF DEST="P-PORT-PROTOTYPE">/AUTOSAR_WdgM/[!"$swComponentTypePackageName"!]/WdgM/WdgM_ASR32_globalMode</CONTEXT-P-PORT-REF>
                              <TARGET-MODE-GROUP-REF DEST="MODE-DECLARATION-GROUP-PROTOTYPE">/AUTOSAR_WdgM/ASR32/PortInterfaces/WdgM_ASR32_GlobalMode/currentMode</TARGET-MODE-GROUP-REF>
                            </P-MODE-GROUP-IN-ATOMIC-SWC-INSTANCE-REF>
                          </MODE-GROUP-IREF>
                        </MODE-ACCESS-POINT>
  [!LOOP "WdgMGeneral/WdgMSupervisedEntity/*"!]
                        <MODE-ACCESS-POINT>
                          <MODE-GROUP-IREF>
                            <P-MODE-GROUP-IN-ATOMIC-SWC-INSTANCE-REF>
                              <CONTEXT-P-PORT-REF DEST="P-PORT-PROTOTYPE">/AUTOSAR_WdgM/[!"$swComponentTypePackageName"!]/WdgM/mode_ASR32_[!"name(.)"!]</CONTEXT-P-PORT-REF>
                              <TARGET-MODE-GROUP-REF DEST="MODE-DECLARATION-GROUP-PROTOTYPE">/AUTOSAR_WdgM/ASR32/PortInterfaces/WdgM_ASR32_IndividualMode/currentMode</TARGET-MODE-GROUP-REF>
                            </P-MODE-GROUP-IN-ATOMIC-SWC-INSTANCE-REF>
                          </MODE-GROUP-IREF>
                        </MODE-ACCESS-POINT>
  [!ENDLOOP!]
[!ENDIF!]
[!IF "node:exists(WdgMGeneral/WdgMServiceAPI) and (WdgMGeneral/WdgMServiceAPI/WdgMEnableASR40ServiceAPI = 'true')"!]
                        <MODE-ACCESS-POINT>
                          <MODE-GROUP-IREF>
                            <P-MODE-GROUP-IN-ATOMIC-SWC-INSTANCE-REF>
                              <CONTEXT-P-PORT-REF DEST="P-PORT-PROTOTYPE">/AUTOSAR_WdgM/[!"$swComponentTypePackageName"!]/WdgM/WdgM_ASR40_globalMode</CONTEXT-P-PORT-REF>
                              <TARGET-MODE-GROUP-REF DEST="MODE-DECLARATION-GROUP-PROTOTYPE">/AUTOSAR_WdgM/ASR40/PortInterfaces/WdgM_ASR40_GlobalMode/currentMode</TARGET-MODE-GROUP-REF>
                            </P-MODE-GROUP-IN-ATOMIC-SWC-INSTANCE-REF>
                          </MODE-GROUP-IREF>
                        </MODE-ACCESS-POINT>
  [!LOOP "WdgMGeneral/WdgMSupervisedEntity/*"!]
                        <MODE-ACCESS-POINT>
                          <MODE-GROUP-IREF>
                            <P-MODE-GROUP-IN-ATOMIC-SWC-INSTANCE-REF>
                              <CONTEXT-P-PORT-REF DEST="P-PORT-PROTOTYPE">/AUTOSAR_WdgM/[!"$swComponentTypePackageName"!]/WdgM/mode_ASR40_[!"name(.)"!]</CONTEXT-P-PORT-REF>
                              <TARGET-MODE-GROUP-REF DEST="MODE-DECLARATION-GROUP-PROTOTYPE">/AUTOSAR_WdgM/ASR40/PortInterfaces/WdgM_ASR40_IndividualMode/currentMode</TARGET-MODE-GROUP-REF>
                            </P-MODE-GROUP-IN-ATOMIC-SWC-INSTANCE-REF>
                          </MODE-GROUP-IREF>
                        </MODE-ACCESS-POINT>
  [!ENDLOOP!]
[!ENDIF!]
[!IF "node:exists(WdgMGeneral/WdgMServiceAPI) and WdgMGeneral/WdgMServiceAPI/WdgMDefaultASRServiceAPI != 'NONE'"!]
                        <MODE-ACCESS-POINT>
                          <MODE-GROUP-IREF>
                            <P-MODE-GROUP-IN-ATOMIC-SWC-INSTANCE-REF>
                              <CONTEXT-P-PORT-REF DEST="P-PORT-PROTOTYPE">/AUTOSAR_WdgM/[!"$swComponentTypePackageName"!]/WdgM/globalMode</CONTEXT-P-PORT-REF>
                              <TARGET-MODE-GROUP-REF DEST="MODE-DECLARATION-GROUP-PROTOTYPE">/AUTOSAR_WdgM/PortInterfaces/WdgM_GlobalMode/currentMode</TARGET-MODE-GROUP-REF>
                            </P-MODE-GROUP-IN-ATOMIC-SWC-INSTANCE-REF>
                          </MODE-GROUP-IREF>
                        </MODE-ACCESS-POINT>
  [!LOOP "WdgMGeneral/WdgMSupervisedEntity/*"!]
                        <MODE-ACCESS-POINT>
                          <MODE-GROUP-IREF>
                            <P-MODE-GROUP-IN-ATOMIC-SWC-INSTANCE-REF>
                              <CONTEXT-P-PORT-REF DEST="P-PORT-PROTOTYPE">/AUTOSAR_WdgM/[!"$swComponentTypePackageName"!]/WdgM/mode_[!"name(.)"!]</CONTEXT-P-PORT-REF>
                              <TARGET-MODE-GROUP-REF DEST="MODE-DECLARATION-GROUP-PROTOTYPE">/AUTOSAR_WdgM/PortInterfaces/WdgM_IndividualMode/currentMode</TARGET-MODE-GROUP-REF>
                            </P-MODE-GROUP-IN-ATOMIC-SWC-INSTANCE-REF>
                          </MODE-GROUP-IREF>
                        </MODE-ACCESS-POINT>
  [!ENDLOOP!]
[!ENDIF!]
                      </MODE-ACCESS-POINTS>
                      <MODE-SWITCH-POINTS>
[!IF "node:exists(WdgMGeneral/WdgMServiceAPI) and (WdgMGeneral/WdgMServiceAPI/WdgMEnableASR32ServiceAPI = 'true')"!]
                        <MODE-SWITCH-POINT>
                          <SHORT-NAME>MSP_ASR32_globalMode</SHORT-NAME>
                          <MODE-GROUP-IREF>
                            <CONTEXT-P-PORT-REF DEST="P-PORT-PROTOTYPE">/AUTOSAR_WdgM/[!"$swComponentTypePackageName"!]/WdgM/WdgM_ASR32_globalMode</CONTEXT-P-PORT-REF>
                            <TARGET-MODE-GROUP-REF DEST="MODE-DECLARATION-GROUP-PROTOTYPE">/AUTOSAR_WdgM/ASR32/PortInterfaces/WdgM_ASR32_GlobalMode/currentMode</TARGET-MODE-GROUP-REF>
                          </MODE-GROUP-IREF>
                        </MODE-SWITCH-POINT>
  [!LOOP "WdgMGeneral/WdgMSupervisedEntity/*"!]
                        <MODE-SWITCH-POINT>
                          <SHORT-NAME>MSP_ASR32_mode_[!"name(.)"!]</SHORT-NAME>
                          <MODE-GROUP-IREF>
                            <CONTEXT-P-PORT-REF DEST="P-PORT-PROTOTYPE">/AUTOSAR_WdgM/[!"$swComponentTypePackageName"!]/WdgM/mode_ASR32_[!"name(.)"!]</CONTEXT-P-PORT-REF>
                            <TARGET-MODE-GROUP-REF DEST="MODE-DECLARATION-GROUP-PROTOTYPE">/AUTOSAR_WdgM/ASR32/PortInterfaces/WdgM_ASR32_IndividualMode/currentMode</TARGET-MODE-GROUP-REF>
                          </MODE-GROUP-IREF>
                        </MODE-SWITCH-POINT>
  [!ENDLOOP!]
[!ENDIF!]
[!IF "node:exists(WdgMGeneral/WdgMServiceAPI) and (WdgMGeneral/WdgMServiceAPI/WdgMEnableASR40ServiceAPI = 'true')"!]
                        <MODE-SWITCH-POINT>
                          <SHORT-NAME>MSP_ASR40_globalMode</SHORT-NAME>
                          <MODE-GROUP-IREF>
                            <CONTEXT-P-PORT-REF DEST="P-PORT-PROTOTYPE">/AUTOSAR_WdgM/[!"$swComponentTypePackageName"!]/WdgM/WdgM_ASR40_globalMode</CONTEXT-P-PORT-REF>
                            <TARGET-MODE-GROUP-REF DEST="MODE-DECLARATION-GROUP-PROTOTYPE">/AUTOSAR_WdgM/ASR40/PortInterfaces/WdgM_ASR40_GlobalMode/currentMode</TARGET-MODE-GROUP-REF>
                          </MODE-GROUP-IREF>
                        </MODE-SWITCH-POINT>
  [!LOOP "WdgMGeneral/WdgMSupervisedEntity/*"!]
                        <MODE-SWITCH-POINT>
                          <SHORT-NAME>MSP_ASR40_mode_[!"name(.)"!]</SHORT-NAME>
                          <MODE-GROUP-IREF>
                            <CONTEXT-P-PORT-REF DEST="P-PORT-PROTOTYPE">/AUTOSAR_WdgM/[!"$swComponentTypePackageName"!]/WdgM/mode_ASR40_[!"name(.)"!]</CONTEXT-P-PORT-REF>
                            <TARGET-MODE-GROUP-REF DEST="MODE-DECLARATION-GROUP-PROTOTYPE">/AUTOSAR_WdgM/ASR40/PortInterfaces/WdgM_ASR40_IndividualMode/currentMode</TARGET-MODE-GROUP-REF>
                          </MODE-GROUP-IREF>
                        </MODE-SWITCH-POINT>
  [!ENDLOOP!]
[!ENDIF!]
[!IF "node:exists(WdgMGeneral/WdgMServiceAPI) and WdgMGeneral/WdgMServiceAPI/WdgMDefaultASRServiceAPI != 'NONE'"!]
                        <MODE-SWITCH-POINT>
                          <SHORT-NAME>MSP_globalMode</SHORT-NAME>
                          <MODE-GROUP-IREF>
                            <CONTEXT-P-PORT-REF DEST="P-PORT-PROTOTYPE">/AUTOSAR_WdgM/[!"$swComponentTypePackageName"!]/WdgM/globalMode</CONTEXT-P-PORT-REF>
                            <TARGET-MODE-GROUP-REF DEST="MODE-DECLARATION-GROUP-PROTOTYPE">/AUTOSAR_WdgM/PortInterfaces/WdgM_GlobalMode/currentMode</TARGET-MODE-GROUP-REF>
                          </MODE-GROUP-IREF>
                        </MODE-SWITCH-POINT>
  [!LOOP "WdgMGeneral/WdgMSupervisedEntity/*"!]
                        <MODE-SWITCH-POINT>
                          <SHORT-NAME>MSP_mode_[!"name(.)"!]</SHORT-NAME>
                          <MODE-GROUP-IREF>
                            <CONTEXT-P-PORT-REF DEST="P-PORT-PROTOTYPE">/AUTOSAR_WdgM/[!"$swComponentTypePackageName"!]/WdgM/mode_[!"name(.)"!]</CONTEXT-P-PORT-REF>
                            <TARGET-MODE-GROUP-REF DEST="MODE-DECLARATION-GROUP-PROTOTYPE">/AUTOSAR_WdgM/PortInterfaces/WdgM_IndividualMode/currentMode</TARGET-MODE-GROUP-REF>
                          </MODE-GROUP-IREF>
                        </MODE-SWITCH-POINT>
  [!ENDLOOP!]
[!ENDIF!]
                      </MODE-SWITCH-POINTS>
                      <SYMBOL>WdgM_MainFunction</SYMBOL>
                    </RUNNABLE-ENTITY>
[!IF "node:exists(WdgMGeneral/WdgMServiceAPI) and (WdgMGeneral/WdgMServiceAPI/WdgMEnableASR32ServiceAPI = 'true')"!]
                    <RUNNABLE-ENTITY>
                      <SHORT-NAME>RE_ASR32_UpdateAliveCounter</SHORT-NAME>
                      <MINIMUM-START-INTERVAL>0</MINIMUM-START-INTERVAL>
                      <ARGUMENTS>
                        <RUNNABLE-ENTITY-ARGUMENT>
                          <SYMBOL>SEID</SYMBOL>
                        </RUNNABLE-ENTITY-ARGUMENT>
                      </ARGUMENTS>
                      <CAN-BE-INVOKED-CONCURRENTLY>true</CAN-BE-INVOKED-CONCURRENTLY>
                      <SYMBOL>WdgM_ASR32_Rte_UpdateAliveCounter</SYMBOL>
                    </RUNNABLE-ENTITY>
[!IF "node:exists(WdgMGeneral/WdgMServiceAPI/WdgMEnableASR32ActivateAliveSupervisionAPI)"!]
                    <RUNNABLE-ENTITY>
                      <SHORT-NAME>RE_ASR32_ActivateAliveSupervision</SHORT-NAME>
                      <MINIMUM-START-INTERVAL>0</MINIMUM-START-INTERVAL>
                      <ARGUMENTS>
                        <RUNNABLE-ENTITY-ARGUMENT>
                          <SYMBOL>SEID</SYMBOL>
                        </RUNNABLE-ENTITY-ARGUMENT>
                      </ARGUMENTS>
                      <CAN-BE-INVOKED-CONCURRENTLY>true</CAN-BE-INVOKED-CONCURRENTLY>
                      <SYMBOL>WdgM_ASR32_Rte_ActivateAliveSupervision</SYMBOL>
                    </RUNNABLE-ENTITY>
[!ENDIF!]
[!IF "node:exists(WdgMGeneral/WdgMServiceAPI/WdgMEnableASR32DeactivateAliveSupervisionAPI)"!]
                    <RUNNABLE-ENTITY>
                      <SHORT-NAME>RE_ASR32_DeactivateAliveSupervision</SHORT-NAME>
                      <MINIMUM-START-INTERVAL>0</MINIMUM-START-INTERVAL>
                      <ARGUMENTS>
                        <RUNNABLE-ENTITY-ARGUMENT>
                          <SYMBOL>SEID</SYMBOL>
                        </RUNNABLE-ENTITY-ARGUMENT>
                      </ARGUMENTS>
                      <CAN-BE-INVOKED-CONCURRENTLY>true</CAN-BE-INVOKED-CONCURRENTLY>
                      <SYMBOL>WdgM_ASR32_Rte_DeactivateAliveSupervision</SYMBOL>
                    </RUNNABLE-ENTITY>
[!ENDIF!]
[!ENDIF!]
[!IF "node:exists(WdgMGeneral/WdgMServiceAPI) and (WdgMGeneral/WdgMServiceAPI/WdgMEnableASR40ServiceAPI = 'true')"!]
                    <RUNNABLE-ENTITY>
                      <SHORT-NAME>RE_ASR40_UpdateAliveCounter</SHORT-NAME>
                      <MINIMUM-START-INTERVAL>0</MINIMUM-START-INTERVAL>
                      <ARGUMENTS>
                        <RUNNABLE-ENTITY-ARGUMENT>
                          <SYMBOL>SEID</SYMBOL>
                        </RUNNABLE-ENTITY-ARGUMENT>
                      </ARGUMENTS>
                      <CAN-BE-INVOKED-CONCURRENTLY>true</CAN-BE-INVOKED-CONCURRENTLY>
                      <SYMBOL>WdgM_ASR40_Rte_UpdateAliveCounter</SYMBOL>
                    </RUNNABLE-ENTITY>
                    <RUNNABLE-ENTITY>
                      <SHORT-NAME>RE_ASR40_CheckpointReached</SHORT-NAME>
                      <MINIMUM-START-INTERVAL>0</MINIMUM-START-INTERVAL>
                      <ARGUMENTS>
                        <RUNNABLE-ENTITY-ARGUMENT>
                          <SYMBOL>SEID</SYMBOL>
                        </RUNNABLE-ENTITY-ARGUMENT>
                        <RUNNABLE-ENTITY-ARGUMENT>
                          <SYMBOL>CheckpointID</SYMBOL>
                        </RUNNABLE-ENTITY-ARGUMENT>
                      </ARGUMENTS>
                      <CAN-BE-INVOKED-CONCURRENTLY>true</CAN-BE-INVOKED-CONCURRENTLY>
                      <SYMBOL>WdgM_ASR40_Rte_CheckpointReached</SYMBOL>
                    </RUNNABLE-ENTITY>
[!ENDIF!]
[!IF "node:exists(WdgMGeneral/WdgMServiceAPI) and WdgMGeneral/WdgMServiceAPI/WdgMDefaultASRServiceAPI != 'NONE'"!]
                    <RUNNABLE-ENTITY>
                      <SHORT-NAME>RE_UpdateAliveCounter</SHORT-NAME>
                      <MINIMUM-START-INTERVAL>0</MINIMUM-START-INTERVAL>
                      <ARGUMENTS>
                        <RUNNABLE-ENTITY-ARGUMENT>
                          <SYMBOL>SEID</SYMBOL>
                        </RUNNABLE-ENTITY-ARGUMENT>
                      </ARGUMENTS>
                      <CAN-BE-INVOKED-CONCURRENTLY>true</CAN-BE-INVOKED-CONCURRENTLY>
                      <SYMBOL>WdgM_Rte_UpdateAliveCounter</SYMBOL>
                    </RUNNABLE-ENTITY>
  [!IF "WdgMGeneral/WdgMServiceAPI/WdgMDefaultASRServiceAPI = 'AUTOSAR_40'"!]
                    <RUNNABLE-ENTITY>
                      <SHORT-NAME>RE_CheckpointReached</SHORT-NAME>
                      <MINIMUM-START-INTERVAL>0</MINIMUM-START-INTERVAL>
                      <ARGUMENTS>
                        <RUNNABLE-ENTITY-ARGUMENT>
                          <SYMBOL>SEID</SYMBOL>
                        </RUNNABLE-ENTITY-ARGUMENT>
                        <RUNNABLE-ENTITY-ARGUMENT>
                          <SYMBOL>CheckpointID</SYMBOL>
                        </RUNNABLE-ENTITY-ARGUMENT>
                      </ARGUMENTS>
                      <CAN-BE-INVOKED-CONCURRENTLY>true</CAN-BE-INVOKED-CONCURRENTLY>
                      <SYMBOL>WdgM_Rte_CheckpointReached</SYMBOL>
                    </RUNNABLE-ENTITY>
  [!ENDIF!]
  [!IF "WdgMGeneral/WdgMServiceAPI/WdgMDefaultASRServiceAPI = 'AUTOSAR_32'"!]
    [!IF "node:exists(WdgMGeneral/WdgMServiceAPI/WdgMEnableASR32ActivateAliveSupervisionAPI)"!]
                    <RUNNABLE-ENTITY>
                      <SHORT-NAME>RE_ActivateAliveSupervision</SHORT-NAME>
                      <MINIMUM-START-INTERVAL>0</MINIMUM-START-INTERVAL>
                      <ARGUMENTS>
                        <RUNNABLE-ENTITY-ARGUMENT>
                          <SYMBOL>SEID</SYMBOL>
                        </RUNNABLE-ENTITY-ARGUMENT>
                      </ARGUMENTS>
                      <CAN-BE-INVOKED-CONCURRENTLY>true</CAN-BE-INVOKED-CONCURRENTLY>
                      <SYMBOL>WdgM_Rte_ActivateAliveSupervision</SYMBOL>
                    </RUNNABLE-ENTITY>
    [!ENDIF!]
    [!IF "node:exists(WdgMGeneral/WdgMServiceAPI/WdgMEnableASR32DeactivateAliveSupervisionAPI)"!]
                    <RUNNABLE-ENTITY>
                      <SHORT-NAME>RE_DeactivateAliveSupervision</SHORT-NAME>
                      <MINIMUM-START-INTERVAL>0</MINIMUM-START-INTERVAL>
                      <ARGUMENTS>
                        <RUNNABLE-ENTITY-ARGUMENT>
                          <SYMBOL>SEID</SYMBOL>
                        </RUNNABLE-ENTITY-ARGUMENT>
                      </ARGUMENTS>
                      <CAN-BE-INVOKED-CONCURRENTLY>true</CAN-BE-INVOKED-CONCURRENTLY>
                      <SYMBOL>WdgM_Rte_DeactivateAliveSupervision</SYMBOL>
                    </RUNNABLE-ENTITY>
    [!ENDIF!]
  [!ENDIF!]
[!ENDIF!]
                  </RUNNABLES>
                  <SUPPORTS-MULTIPLE-INSTANTIATION>false</SUPPORTS-MULTIPLE-INSTANTIATION>
                </SWC-INTERNAL-BEHAVIOR>
              </INTERNAL-BEHAVIORS>
            </SERVICE-SW-COMPONENT-TYPE>
          </ELEMENTS>
        </AR-PACKAGE>
      </AR-PACKAGES>
    </AR-PACKAGE>
    <AR-PACKAGE>
      <SHORT-NAME>EB_WdgM</SHORT-NAME>
      <AR-PACKAGES>
        <AR-PACKAGE>
          <SHORT-NAME>[!"$swcImplementationPackageName"!]</SHORT-NAME>
          <ELEMENTS>
            <SWC-IMPLEMENTATION>
              <SHORT-NAME>SwcImplementation_0</SHORT-NAME>
              <CODE-DESCRIPTORS>
                <CODE>
                  <SHORT-NAME>WdgMCode</SHORT-NAME>
                  <ARTIFACT-DESCRIPTORS>
                    <AUTOSAR-ENGINEERING-OBJECT>
                      <SHORT-LABEL>EngObject</SHORT-LABEL>
                      <CATEGORY>SWSRC</CATEGORY>
                    </AUTOSAR-ENGINEERING-OBJECT>
                  </ARTIFACT-DESCRIPTORS>
                </CODE>
              </CODE-DESCRIPTORS>
              <PROGRAMMING-LANGUAGE>C</PROGRAMMING-LANGUAGE>
              <RESOURCE-CONSUMPTION>
                <SHORT-NAME>Resources</SHORT-NAME>
                <MEMORY-SECTIONS>
                    <MEMORY-SECTION>
                        <SHORT-NAME>CODE</SHORT-NAME>
                        <SW-ADDRMETHOD-REF DEST="SW-ADDR-METHOD">/AUTOSAR_MemMap/SwAddrMethods/CODE</SW-ADDRMETHOD-REF>
                    </MEMORY-SECTION>
                </MEMORY-SECTIONS>
              </RESOURCE-CONSUMPTION>
              <SW-VERSION>6.1.39</SW-VERSION>
              <VENDOR-ID>1</VENDOR-ID>
              <BEHAVIOR-REF DEST="SWC-INTERNAL-BEHAVIOR">/AUTOSAR_WdgM/[!"$swComponentTypePackageName"!]/WdgM/SwcInternalBehavior_0</BEHAVIOR-REF>
            </SWC-IMPLEMENTATION>
          </ELEMENTS>
        </AR-PACKAGE>
      </AR-PACKAGES>
    </AR-PACKAGE>
  </AR-PACKAGES>
</AUTOSAR>
