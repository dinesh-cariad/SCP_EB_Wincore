<?xml version="1.0" encoding="UTF-8"?>
<AUTOSAR xmlns="http://autosar.org/3.2.2"
  xmlns:xsi="http://www.w3.org/2001/XMLSchema-instance"
  xsi:schemaLocation="http://autosar.org/3.2.2 AUTOSAR_STRICT_COMPACT.xsd">
[!AUTOSPACING!]
[!/* do not generate this file if RTE is not used */!][!//
[!SKIPFILE "WdgMGeneral/WdgMRteUsage = 'false'"!][!//
  <TOP-LEVEL-PACKAGES>
    <AR-PACKAGE> <!-- AUTOSAR_WdgM -->
      <SHORT-NAME>AUTOSAR_WdgM</SHORT-NAME>
      <SUB-PACKAGES>
[!IF "node:exists(WdgMGeneral/WdgMServiceAPI) and (WdgMGeneral/WdgMServiceAPI/WdgMEnableASR32ServiceAPI = 'true')"!]
        <!-- Provide AUTOSAR 3.2 service interface -->
        <AR-PACKAGE> <!-- ASR32 -->
          <SHORT-NAME>ASR32</SHORT-NAME>
          <SUB-PACKAGES>
            <AR-PACKAGE>  <!-- Datatypes -->
              <SHORT-NAME>Datatypes</SHORT-NAME>
              <CATEGORY>STANDARD</CATEGORY>
              <ELEMENTS>
                <INTEGER-TYPE>
                  <SHORT-NAME>WdgM_ASR32_SupervisedEntityIdType</SHORT-NAME>
                  <CATEGORY>TYPE_REFERENCE</CATEGORY>
                  <SW-DATA-DEF-PROPS>
                    <BASE-TYPE-REF DEST="SW-BASE-TYPE">/AUTOSAR_PlatformTypes/BaseTypes/uint16</BASE-TYPE-REF>
                  </SW-DATA-DEF-PROPS>
                  <LOWER-LIMIT INTERVAL-TYPE="CLOSED">0</LOWER-LIMIT>
                  <UPPER-LIMIT INTERVAL-TYPE="CLOSED">65535</UPPER-LIMIT>
                </INTEGER-TYPE>
              </ELEMENTS>
            </AR-PACKAGE>
            <AR-PACKAGE> <!-- ModeDeclarationGroups -->
              <SHORT-NAME>ModeDeclarationGroups</SHORT-NAME>
              <ELEMENTS>
                <MODE-DECLARATION-GROUP>
                  <SHORT-NAME>WdgM_ASR32_Mode</SHORT-NAME>
                  <INITIAL-MODE-REF DEST="MODE-DECLARATION">/AUTOSAR_WdgM/ASR32/ModeDeclarationGroups/WdgM_ASR32_Mode/ALIVE_OK</INITIAL-MODE-REF>
                  <MODE-DECLARATIONS>
                    <MODE-DECLARATION>
                      <SHORT-NAME>ALIVE_OK</SHORT-NAME>
                    </MODE-DECLARATION>
                    <MODE-DECLARATION>
                      <SHORT-NAME>ALIVE_FAILED</SHORT-NAME>
                    </MODE-DECLARATION>
                    <MODE-DECLARATION>
                      <SHORT-NAME>ALIVE_EXPIRED</SHORT-NAME>
                    </MODE-DECLARATION>
                    <MODE-DECLARATION>
                      <SHORT-NAME>ALIVE_STOPPED</SHORT-NAME>
                    </MODE-DECLARATION>
                    <MODE-DECLARATION>
                      <SHORT-NAME>ALIVE_DEACTIVATED</SHORT-NAME>
                    </MODE-DECLARATION>
                  </MODE-DECLARATIONS>
                </MODE-DECLARATION-GROUP>
              </ELEMENTS>
            </AR-PACKAGE>
            <AR-PACKAGE> <!-- PortInterfaces -->
              <SHORT-NAME>PortInterfaces</SHORT-NAME>
              <ELEMENTS>
                <CLIENT-SERVER-INTERFACE>
                  <SHORT-NAME>WdgM_ASR32_AliveSupervision</SHORT-NAME>
                  <IS-SERVICE>true</IS-SERVICE>
                  <OPERATIONS>
                    <!-- Operation UpdateAliveCounter -->
                    <OPERATION-PROTOTYPE>
                      <SHORT-NAME>UpdateAliveCounter</SHORT-NAME>
                      <ARGUMENTS />
                      <POSSIBLE-ERROR-REFS>
                        <POSSIBLE-ERROR-REF DEST="APPLICATION-ERROR">/AUTOSAR_WdgM/ASR32/PortInterfaces/WdgM_ASR32_AliveSupervision/E_NOT_OK</POSSIBLE-ERROR-REF>
                      </POSSIBLE-ERROR-REFS>
                    </OPERATION-PROTOTYPE>
    [!IF "node:exists(WdgMGeneral/WdgMServiceAPI/WdgMEnableASR32ActivateAliveSupervisionAPI)"!]
                    <!-- Operation ActivateAliveSupervision -->
                    <OPERATION-PROTOTYPE>
                      <SHORT-NAME>ActivateAliveSupervision</SHORT-NAME>
                      <ARGUMENTS />
                      <POSSIBLE-ERROR-REFS>
                        <POSSIBLE-ERROR-REF DEST="APPLICATION-ERROR">/AUTOSAR_WdgM/ASR32/PortInterfaces/WdgM_ASR32_AliveSupervision/E_NOT_OK</POSSIBLE-ERROR-REF>
                      </POSSIBLE-ERROR-REFS>
                    </OPERATION-PROTOTYPE>
    [!ENDIF!]
    [!IF "node:exists(WdgMGeneral/WdgMServiceAPI/WdgMEnableASR32DeactivateAliveSupervisionAPI)"!]
                    <!-- Operation DeactivateAliveSupervision -->
                    <OPERATION-PROTOTYPE>
                      <SHORT-NAME>DeactivateAliveSupervision</SHORT-NAME>
                      <ARGUMENTS />
                      <POSSIBLE-ERROR-REFS>
                        <POSSIBLE-ERROR-REF DEST="APPLICATION-ERROR">/AUTOSAR_WdgM/ASR32/PortInterfaces/WdgM_ASR32_AliveSupervision/E_NOT_OK</POSSIBLE-ERROR-REF>
                      </POSSIBLE-ERROR-REFS>
                    </OPERATION-PROTOTYPE>
    [!ENDIF!]
                  </OPERATIONS>
                  <!-- Possible Errors -->
                  <POSSIBLE-ERRORS>
                    <APPLICATION-ERROR>
                      <SHORT-NAME>E_NOT_OK</SHORT-NAME>
                      <ERROR-CODE>1</ERROR-CODE>
                    </APPLICATION-ERROR>
                  </POSSIBLE-ERRORS>
                </CLIENT-SERVER-INTERFACE>
                <SENDER-RECEIVER-INTERFACE>
                  <SHORT-NAME>WdgM_ASR32_IndividualMode</SHORT-NAME>
                  <IS-SERVICE>true</IS-SERVICE>
                  <DATA-ELEMENTS />
                  <MODE-GROUPS>
                    <MODE-DECLARATION-GROUP-PROTOTYPE>
                      <SHORT-NAME>currentMode</SHORT-NAME>
                      <TYPE-TREF DEST="MODE-DECLARATION-GROUP">/AUTOSAR_WdgM/ASR32/ModeDeclarationGroups/WdgM_ASR32_Mode</TYPE-TREF>
                    </MODE-DECLARATION-GROUP-PROTOTYPE>
                  </MODE-GROUPS>
                </SENDER-RECEIVER-INTERFACE>
                <SENDER-RECEIVER-INTERFACE>
                  <SHORT-NAME>WdgM_ASR32_GlobalMode</SHORT-NAME>
                  <IS-SERVICE>true</IS-SERVICE>
                  <DATA-ELEMENTS />
                  <MODE-GROUPS>
                    <MODE-DECLARATION-GROUP-PROTOTYPE>
                      <SHORT-NAME>currentMode</SHORT-NAME>
                      <TYPE-TREF DEST="MODE-DECLARATION-GROUP">/AUTOSAR_WdgM/ASR32/ModeDeclarationGroups/WdgM_ASR32_Mode</TYPE-TREF>
                    </MODE-DECLARATION-GROUP-PROTOTYPE>
                  </MODE-GROUPS>
                </SENDER-RECEIVER-INTERFACE>
              </ELEMENTS>
            </AR-PACKAGE>
          </SUB-PACKAGES>
        </AR-PACKAGE>
[!ENDIF!]
[!IF "node:exists(WdgMGeneral/WdgMServiceAPI) and (WdgMGeneral/WdgMServiceAPI/WdgMEnableASR40ServiceAPI = 'true')"!]
        <!-- Provide AUTOSAR 4.0 service interface -->
        <AR-PACKAGE> <!-- ASR40 -->
          <SHORT-NAME>ASR40</SHORT-NAME>
          <SUB-PACKAGES>
            <AR-PACKAGE> <!-- Datatypes -->
              <SHORT-NAME>Datatypes</SHORT-NAME>
               <!--
                 We do not use AUTOSAR 4.0.3 package name here for the sake of consistency, since for
                 the ServiceComponentType we _HAVE_ to use the AUTSOAR 3.2.1 package name unless 4.0.3
                 has been selected as default (i.e., we _CANNOT_ replicate the ServiceComponentType for
                 each activated version (e.g., one for 3.2.2 and one for 4.0.3)
               -->
              <CATEGORY>STANDARD</CATEGORY>
              <ELEMENTS>
                <INTEGER-TYPE>
                  <SHORT-NAME>WdgM_ASR40_SupervisedEntityIdType</SHORT-NAME>
                  <CATEGORY>TYPE_REFERENCE</CATEGORY>
                  <SW-DATA-DEF-PROPS>
                    <BASE-TYPE-REF DEST="SW-BASE-TYPE">/AUTOSAR_PlatformTypes/BaseTypes/uint16</BASE-TYPE-REF>
                  </SW-DATA-DEF-PROPS>
                  <LOWER-LIMIT INTERVAL-TYPE="CLOSED">0</LOWER-LIMIT>
                  <UPPER-LIMIT INTERVAL-TYPE="CLOSED">65535</UPPER-LIMIT>
                </INTEGER-TYPE>
                <INTEGER-TYPE>
                  <SHORT-NAME>WdgM_ASR40_CheckpointIdType</SHORT-NAME>
                  <CATEGORY>TYPE_REFERENCE</CATEGORY>
                  <SW-DATA-DEF-PROPS>
                    <BASE-TYPE-REF DEST="SW-BASE-TYPE">/AUTOSAR_PlatformTypes/BaseTypes/uint16</BASE-TYPE-REF>
                    <COMPU-METHOD-REF DEST="COMPU-METHOD">/AUTOSAR_WdgM/ASR40/CompuMethods/WdgM_ASR40_CheckpointIdTypeValues</COMPU-METHOD-REF>
                  </SW-DATA-DEF-PROPS>
                  <LOWER-LIMIT INTERVAL-TYPE="CLOSED">0</LOWER-LIMIT>
                  <UPPER-LIMIT INTERVAL-TYPE="CLOSED">65535</UPPER-LIMIT>
                </INTEGER-TYPE>
              </ELEMENTS>
            </AR-PACKAGE>
            <AR-PACKAGE> <!-- ModeDeclarationGroups -->
              <SHORT-NAME>ModeDeclarationGroups</SHORT-NAME>
              <ELEMENTS>
                <MODE-DECLARATION-GROUP>
                  <SHORT-NAME>WdgM_ASR40_Mode</SHORT-NAME>
                  <INITIAL-MODE-REF DEST="MODE-DECLARATION">/AUTOSAR_WdgM/ASR40/ModeDeclarationGroups/WdgM_ASR40_Mode/SUPERVISION_OK</INITIAL-MODE-REF>
                  <MODE-DECLARATIONS>
                    <MODE-DECLARATION>
                      <SHORT-NAME>SUPERVISION_OK</SHORT-NAME>
                    </MODE-DECLARATION>
                    <MODE-DECLARATION>
                      <SHORT-NAME>SUPERVISION_FAILED</SHORT-NAME>
                    </MODE-DECLARATION>
                    <MODE-DECLARATION>
                      <SHORT-NAME>SUPERVISION_EXPIRED</SHORT-NAME>
                    </MODE-DECLARATION>
                    <MODE-DECLARATION>
                      <SHORT-NAME>SUPERVISION_STOPPED</SHORT-NAME>
                    </MODE-DECLARATION>
                    <MODE-DECLARATION>
                      <SHORT-NAME>SUPERVISION_DEACTIVATED</SHORT-NAME>
                    </MODE-DECLARATION>
                  </MODE-DECLARATIONS>
                </MODE-DECLARATION-GROUP>
              </ELEMENTS>
            </AR-PACKAGE>
            <AR-PACKAGE> <!-- CompuMethods -->
              <SHORT-NAME>CompuMethods</SHORT-NAME>
              <ELEMENTS>
                <COMPU-METHOD>
                  <SHORT-NAME>WdgM_ASR40_CheckpointIdTypeValues</SHORT-NAME>
                  <CATEGORY>TEXTTABLE</CATEGORY>
                  <COMPU-INTERNAL-TO-PHYS>
                    <COMPU-SCALES>
                      [!IF "count(WdgMGeneral/WdgMSupervisedEntity/*) > 0"!]
                      [!LOOP "node:order(WdgMGeneral/WdgMSupervisedEntity/*, 'WdgMSupervisedEntityId')"!]
                      [!IF "count(WdgMCheckpoint/*) > 0"!]
                      [!LOOP "node:order(WdgMCheckpoint/*, 'WdgMCheckpointId')"!]
                      <COMPU-SCALE>
                        <SYMBOL>WdgMConf_WdgMCheckpoint_[!"@name"!]</SYMBOL>
                        <LOWER-LIMIT INTERVAL-TYPE="CLOSED">[!"WdgMCheckpointId"!]</LOWER-LIMIT>
                        <UPPER-LIMIT INTERVAL-TYPE="CLOSED">[!"WdgMCheckpointId"!]</UPPER-LIMIT>
                        <COMPU-CONST>
                          <VT>WdgMConf_WdgMCheckpoint_[!"@name"!]</VT>
                        </COMPU-CONST>
                      </COMPU-SCALE>
                      [!ENDLOOP!]
                      [!ENDIF!]
                      [!ENDLOOP!]
                      [!ENDIF!]
                    </COMPU-SCALES>
                  </COMPU-INTERNAL-TO-PHYS>
                </COMPU-METHOD>
              </ELEMENTS>
            </AR-PACKAGE>
            <AR-PACKAGE> <!-- PortInterfaces -->
              <SHORT-NAME>PortInterfaces</SHORT-NAME>
              <ELEMENTS>
                <CLIENT-SERVER-INTERFACE>
                  <SHORT-NAME>WdgM_ASR40_AliveSupervision</SHORT-NAME>
                  <IS-SERVICE>true</IS-SERVICE>
                  <OPERATIONS>
                    <!-- Operation UpdateAliveCounter -->
                    <OPERATION-PROTOTYPE>
                      <SHORT-NAME>UpdateAliveCounter</SHORT-NAME>
                      <ARGUMENTS />
                      <POSSIBLE-ERROR-REFS>
                        <POSSIBLE-ERROR-REF DEST="APPLICATION-ERROR">/AUTOSAR_WdgM/ASR40/PortInterfaces/WdgM_ASR40_AliveSupervision/E_NOT_OK</POSSIBLE-ERROR-REF>
                      </POSSIBLE-ERROR-REFS>
                    </OPERATION-PROTOTYPE>
                    <!-- Operation CheckpointReached -->
                    <OPERATION-PROTOTYPE>
                      <SHORT-NAME>CheckpointReached</SHORT-NAME>
                      <ARGUMENTS>
                        <ARGUMENT-PROTOTYPE>
                          <SHORT-NAME>CheckpointId</SHORT-NAME>
                          <TYPE-TREF DEST="INTEGER-TYPE">/AUTOSAR_WdgM/ASR40/Datatypes/WdgM_ASR40_CheckpointIdType</TYPE-TREF>
                          <DIRECTION>IN</DIRECTION>
                        </ARGUMENT-PROTOTYPE>
                      </ARGUMENTS>
                      <POSSIBLE-ERROR-REFS>
                        <POSSIBLE-ERROR-REF DEST="APPLICATION-ERROR">/AUTOSAR_WdgM/ASR40/PortInterfaces/WdgM_ASR40_AliveSupervision/E_NOT_OK</POSSIBLE-ERROR-REF>
                      </POSSIBLE-ERROR-REFS>
                    </OPERATION-PROTOTYPE>
                  </OPERATIONS>
                  <!-- Possible Errors -->
                  <POSSIBLE-ERRORS>
                    <APPLICATION-ERROR>
                      <SHORT-NAME>E_NOT_OK</SHORT-NAME>
                      <ERROR-CODE>1</ERROR-CODE>
                    </APPLICATION-ERROR>
                  </POSSIBLE-ERRORS>
                </CLIENT-SERVER-INTERFACE>
                <SENDER-RECEIVER-INTERFACE>
                  <SHORT-NAME>WdgM_ASR40_IndividualMode</SHORT-NAME>
                  <IS-SERVICE>true</IS-SERVICE>
                  <DATA-ELEMENTS />
                  <MODE-GROUPS>
                    <MODE-DECLARATION-GROUP-PROTOTYPE>
                      <SHORT-NAME>currentMode</SHORT-NAME>
                      <TYPE-TREF DEST="MODE-DECLARATION-GROUP">/AUTOSAR_WdgM/ASR40/ModeDeclarationGroups/WdgM_ASR40_Mode</TYPE-TREF>
                    </MODE-DECLARATION-GROUP-PROTOTYPE>
                  </MODE-GROUPS>
                </SENDER-RECEIVER-INTERFACE>
                <SENDER-RECEIVER-INTERFACE>
                  <SHORT-NAME>WdgM_ASR40_GlobalMode</SHORT-NAME>
                  <IS-SERVICE>true</IS-SERVICE>
                  <DATA-ELEMENTS />
                  <MODE-GROUPS>
                    <MODE-DECLARATION-GROUP-PROTOTYPE>
                      <SHORT-NAME>currentMode</SHORT-NAME>
                      <TYPE-TREF DEST="MODE-DECLARATION-GROUP">/AUTOSAR_WdgM/ASR40/ModeDeclarationGroups/WdgM_ASR40_Mode</TYPE-TREF>
                    </MODE-DECLARATION-GROUP-PROTOTYPE>
                  </MODE-GROUPS>
                </SENDER-RECEIVER-INTERFACE>
              </ELEMENTS>
            </AR-PACKAGE>
          </SUB-PACKAGES>
        </AR-PACKAGE>
[!ENDIF!]
[!IF "node:exists(WdgMGeneral/WdgMServiceAPI) and WdgMGeneral/WdgMServiceAPI/WdgMDefaultASRServiceAPI = 'AUTOSAR_32'"!]
        <!-- Provide default service interface as AUTOSAR 3.2 -->
        <AR-PACKAGE> <!-- Datatypes -->
          <SHORT-NAME>Datatypes</SHORT-NAME>
          <CATEGORY>STANDARD</CATEGORY>
          <ELEMENTS>
            <INTEGER-TYPE>
              <SHORT-NAME>WdgM_SupervisedEntityIdType</SHORT-NAME>
              <CATEGORY>TYPE_REFERENCE</CATEGORY>
              <SW-DATA-DEF-PROPS>
                <BASE-TYPE-REF DEST="SW-BASE-TYPE">/AUTOSAR_PlatformTypes/BaseTypes/uint16</BASE-TYPE-REF>
              </SW-DATA-DEF-PROPS>
              <LOWER-LIMIT INTERVAL-TYPE="CLOSED">0</LOWER-LIMIT>
              <UPPER-LIMIT INTERVAL-TYPE="CLOSED">65535</UPPER-LIMIT>
            </INTEGER-TYPE>
          </ELEMENTS>
        </AR-PACKAGE>
        <AR-PACKAGE> <!-- ModeDeclarationGroups -->
          <SHORT-NAME>ModeDeclarationGroups</SHORT-NAME>
          <ELEMENTS>
            <MODE-DECLARATION-GROUP>
              <SHORT-NAME>WdgMMode</SHORT-NAME>
              <INITIAL-MODE-REF DEST="MODE-DECLARATION">/AUTOSAR_WdgM/ModeDeclarationGroups/WdgMMode/ALIVE_OK</INITIAL-MODE-REF>
              <MODE-DECLARATIONS>
                <MODE-DECLARATION>
                  <SHORT-NAME>ALIVE_OK</SHORT-NAME>
                </MODE-DECLARATION>
                <MODE-DECLARATION>
                  <SHORT-NAME>ALIVE_FAILED</SHORT-NAME>
                </MODE-DECLARATION>
                <MODE-DECLARATION>
                  <SHORT-NAME>ALIVE_EXPIRED</SHORT-NAME>
                </MODE-DECLARATION>
                <MODE-DECLARATION>
                  <SHORT-NAME>ALIVE_STOPPED</SHORT-NAME>
                </MODE-DECLARATION>
                <MODE-DECLARATION>
                  <SHORT-NAME>ALIVE_DEACTIVATED</SHORT-NAME>
                </MODE-DECLARATION>
              </MODE-DECLARATIONS>
            </MODE-DECLARATION-GROUP>
          </ELEMENTS>
        </AR-PACKAGE>
        <AR-PACKAGE> <!-- PortInterfaces -->
          <SHORT-NAME>PortInterfaces</SHORT-NAME>
          <ELEMENTS>
            <CLIENT-SERVER-INTERFACE>
              <SHORT-NAME>WdgM_AliveSupervision</SHORT-NAME>
              <IS-SERVICE>true</IS-SERVICE>
              <OPERATIONS>
                <!-- Operation UpdateAliveCounter -->
                <OPERATION-PROTOTYPE>
                  <SHORT-NAME>UpdateAliveCounter</SHORT-NAME>
                  <ARGUMENTS />
                  <POSSIBLE-ERROR-REFS>
                    <POSSIBLE-ERROR-REF DEST="APPLICATION-ERROR">/AUTOSAR_WdgM/PortInterfaces/WdgM_AliveSupervision/E_NOT_OK</POSSIBLE-ERROR-REF>
                  </POSSIBLE-ERROR-REFS>
                </OPERATION-PROTOTYPE>
    [!IF "node:exists(WdgMGeneral/WdgMServiceAPI/WdgMEnableASR32ActivateAliveSupervisionAPI)"!]
                <!-- Operation ActivateAliveSupervision -->
                <OPERATION-PROTOTYPE>
                  <SHORT-NAME>ActivateAliveSupervision</SHORT-NAME>
                  <ARGUMENTS />
                  <POSSIBLE-ERROR-REFS>
                    <POSSIBLE-ERROR-REF DEST="APPLICATION-ERROR">/AUTOSAR_WdgM/PortInterfaces/WdgM_AliveSupervision/E_NOT_OK</POSSIBLE-ERROR-REF>
                  </POSSIBLE-ERROR-REFS>
                </OPERATION-PROTOTYPE>
    [!ENDIF!]
    [!IF "node:exists(WdgMGeneral/WdgMServiceAPI/WdgMEnableASR32DeactivateAliveSupervisionAPI)"!]
                <!-- Operation DeactivateAliveSupervision -->
                <OPERATION-PROTOTYPE>
                  <SHORT-NAME>DeactivateAliveSupervision</SHORT-NAME>
                  <ARGUMENTS />
                  <POSSIBLE-ERROR-REFS>
                    <POSSIBLE-ERROR-REF DEST="APPLICATION-ERROR">/AUTOSAR_WdgM/PortInterfaces/WdgM_AliveSupervision/E_NOT_OK</POSSIBLE-ERROR-REF>
                  </POSSIBLE-ERROR-REFS>
                </OPERATION-PROTOTYPE>
    [!ENDIF!]
              </OPERATIONS>
              <!-- Possible Errors -->
              <POSSIBLE-ERRORS>
                <APPLICATION-ERROR>
                  <SHORT-NAME>E_NOT_OK</SHORT-NAME>
                  <ERROR-CODE>1</ERROR-CODE>
                </APPLICATION-ERROR>
              </POSSIBLE-ERRORS>
            </CLIENT-SERVER-INTERFACE>
            <SENDER-RECEIVER-INTERFACE>
              <SHORT-NAME>WdgM_IndividualMode</SHORT-NAME>
              <IS-SERVICE>true</IS-SERVICE>
              <DATA-ELEMENTS />
              <MODE-GROUPS>
                <MODE-DECLARATION-GROUP-PROTOTYPE>
                  <SHORT-NAME>currentMode</SHORT-NAME>
                  <TYPE-TREF DEST="MODE-DECLARATION-GROUP">/AUTOSAR_WdgM/ModeDeclarationGroups/WdgMMode</TYPE-TREF>
                </MODE-DECLARATION-GROUP-PROTOTYPE>
              </MODE-GROUPS>
            </SENDER-RECEIVER-INTERFACE>
            <SENDER-RECEIVER-INTERFACE>
              <SHORT-NAME>WdgM_GlobalMode</SHORT-NAME>
              <IS-SERVICE>true</IS-SERVICE>
              <DATA-ELEMENTS />
              <MODE-GROUPS>
                <MODE-DECLARATION-GROUP-PROTOTYPE>
                  <SHORT-NAME>currentMode</SHORT-NAME>
                  <TYPE-TREF DEST="MODE-DECLARATION-GROUP">/AUTOSAR_WdgM/ModeDeclarationGroups/WdgMMode</TYPE-TREF>
                </MODE-DECLARATION-GROUP-PROTOTYPE>
              </MODE-GROUPS>
            </SENDER-RECEIVER-INTERFACE>
          </ELEMENTS>
        </AR-PACKAGE>
[!ENDIF!]
[!IF "node:exists(WdgMGeneral/WdgMServiceAPI) and WdgMGeneral/WdgMServiceAPI/WdgMDefaultASRServiceAPI = 'AUTOSAR_40'"!]
        <!-- Provide default service interface as AUTOSAR 4.0 -->
        <AR-PACKAGE> <!-- ImplementationDataTypes -->
          <SHORT-NAME>ImplementationDataTypes</SHORT-NAME>
          <!--
            We use AUTOSAR 4.0.3 package name here since the AUTOSAR 4.0.3 SWC will look in this package
          -->
          <CATEGORY>STANDARD</CATEGORY>
          <ELEMENTS>
            <INTEGER-TYPE>
              <SHORT-NAME>WdgM_SupervisedEntityIdType</SHORT-NAME>
              <CATEGORY>TYPE_REFERENCE</CATEGORY>
              <SW-DATA-DEF-PROPS>
                <BASE-TYPE-REF DEST="SW-BASE-TYPE">/AUTOSAR_PlatformTypes/BaseTypes/uint16</BASE-TYPE-REF>
              </SW-DATA-DEF-PROPS>
              <LOWER-LIMIT INTERVAL-TYPE="CLOSED">0</LOWER-LIMIT>
              <UPPER-LIMIT INTERVAL-TYPE="CLOSED">65535</UPPER-LIMIT>
            </INTEGER-TYPE>
            <INTEGER-TYPE>
              <SHORT-NAME>WdgM_CheckpointIdType</SHORT-NAME>
              <CATEGORY>TYPE_REFERENCE</CATEGORY>
              <SW-DATA-DEF-PROPS>
                <BASE-TYPE-REF DEST="SW-BASE-TYPE">/AUTOSAR_PlatformTypes/BaseTypes/uint16</BASE-TYPE-REF>
                <COMPU-METHOD-REF DEST="COMPU-METHOD">/AUTOSAR_WdgM/CompuMethods/WdgM_CheckpointIdTypeValues</COMPU-METHOD-REF>
              </SW-DATA-DEF-PROPS>
              <LOWER-LIMIT INTERVAL-TYPE="CLOSED">0</LOWER-LIMIT>
              <UPPER-LIMIT INTERVAL-TYPE="CLOSED">65535</UPPER-LIMIT>
            </INTEGER-TYPE>
          </ELEMENTS>
        </AR-PACKAGE>
        <AR-PACKAGE> <!-- ModeDeclarationGroups -->
          <SHORT-NAME>ModeDeclarationGroups</SHORT-NAME>
          <ELEMENTS>
            <MODE-DECLARATION-GROUP>
              <SHORT-NAME>WdgMMode</SHORT-NAME>
              <INITIAL-MODE-REF DEST="MODE-DECLARATION">/AUTOSAR_WdgM/ModeDeclarationGroups/WdgMMode/SUPERVISION_OK</INITIAL-MODE-REF>
              <MODE-DECLARATIONS>
                <MODE-DECLARATION>
                  <SHORT-NAME>SUPERVISION_OK</SHORT-NAME>
                </MODE-DECLARATION>
                <MODE-DECLARATION>
                  <SHORT-NAME>SUPERVISION_FAILED</SHORT-NAME>
                </MODE-DECLARATION>
                <MODE-DECLARATION>
                  <SHORT-NAME>SUPERVISION_EXPIRED</SHORT-NAME>
                </MODE-DECLARATION>
                <MODE-DECLARATION>
                  <SHORT-NAME>SUPERVISION_STOPPED</SHORT-NAME>
                </MODE-DECLARATION>
                <MODE-DECLARATION>
                  <SHORT-NAME>SUPERVISION_DEACTIVATED</SHORT-NAME>
                </MODE-DECLARATION>
              </MODE-DECLARATIONS>
            </MODE-DECLARATION-GROUP>
          </ELEMENTS>
        </AR-PACKAGE>
        <AR-PACKAGE> <!-- CompuMethods -->
          <SHORT-NAME>CompuMethods</SHORT-NAME>
          <ELEMENTS>
            <COMPU-METHOD>
              <SHORT-NAME>WdgM_CheckpointIdTypeValues</SHORT-NAME>
              <CATEGORY>TEXTTABLE</CATEGORY>
              <COMPU-INTERNAL-TO-PHYS>
                <COMPU-SCALES>
                  [!IF "count(WdgMGeneral/WdgMSupervisedEntity/*) > 0"!]
                  [!LOOP "node:order(WdgMGeneral/WdgMSupervisedEntity/*, 'WdgMSupervisedEntityId')"!]
                  [!IF "count(WdgMCheckpoint/*) > 0"!]
                  [!LOOP "node:order(WdgMCheckpoint/*, 'WdgMCheckpointId')"!]
                  <COMPU-SCALE>
                    <SYMBOL>WdgMConf_WdgMCheckpoint_[!"@name"!]</SYMBOL>
                    <LOWER-LIMIT INTERVAL-TYPE="CLOSED">[!"WdgMCheckpointId"!]</LOWER-LIMIT>
                    <UPPER-LIMIT INTERVAL-TYPE="CLOSED">[!"WdgMCheckpointId"!]</UPPER-LIMIT>
                    <COMPU-CONST>
                      <VT>WdgMConf_WdgMCheckpoint_[!"@name"!]</VT>
                    </COMPU-CONST>
                  </COMPU-SCALE>
                  [!ENDLOOP!]
                  [!ENDIF!]
                  [!ENDLOOP!]
                  [!ENDIF!]
                </COMPU-SCALES>
              </COMPU-INTERNAL-TO-PHYS>
            </COMPU-METHOD>
          </ELEMENTS>
        </AR-PACKAGE>
        <AR-PACKAGE> <!-- PortInterfaces -->
          <SHORT-NAME>PortInterfaces</SHORT-NAME>
          <ELEMENTS>
            <CLIENT-SERVER-INTERFACE>
              <SHORT-NAME>WdgM_AliveSupervision</SHORT-NAME>
              <IS-SERVICE>true</IS-SERVICE>
              <OPERATIONS>
                <!-- Operation UpdateAliveCounter -->
                <OPERATION-PROTOTYPE>
                  <SHORT-NAME>UpdateAliveCounter</SHORT-NAME>
                  <ARGUMENTS />
                  <POSSIBLE-ERROR-REFS>
                    <POSSIBLE-ERROR-REF DEST="APPLICATION-ERROR">/AUTOSAR_WdgM/PortInterfaces/WdgM_AliveSupervision/E_NOT_OK</POSSIBLE-ERROR-REF>
                  </POSSIBLE-ERROR-REFS>
                </OPERATION-PROTOTYPE>
                <!-- Operation CheckpointReached -->
                <OPERATION-PROTOTYPE>
                  <SHORT-NAME>CheckpointReached</SHORT-NAME>
                  <ARGUMENTS>
                    <ARGUMENT-PROTOTYPE>
                      <SHORT-NAME>CheckpointId</SHORT-NAME>
                      <TYPE-TREF DEST="INTEGER-TYPE">/AUTOSAR_WdgM/ImplementationDataTypes/WdgM_CheckpointIdType</TYPE-TREF>
                      <DIRECTION>IN</DIRECTION>
                    </ARGUMENT-PROTOTYPE>
                  </ARGUMENTS>
                  <POSSIBLE-ERROR-REFS>
                    <POSSIBLE-ERROR-REF DEST="APPLICATION-ERROR">/AUTOSAR_WdgM/PortInterfaces/WdgM_AliveSupervision/E_NOT_OK</POSSIBLE-ERROR-REF>
                  </POSSIBLE-ERROR-REFS>
                </OPERATION-PROTOTYPE>
              </OPERATIONS>
              <!-- Possible Errors -->
              <POSSIBLE-ERRORS>
                <APPLICATION-ERROR>
                  <SHORT-NAME>E_NOT_OK</SHORT-NAME>
                  <ERROR-CODE>1</ERROR-CODE>
                </APPLICATION-ERROR>
              </POSSIBLE-ERRORS>
            </CLIENT-SERVER-INTERFACE>
            <SENDER-RECEIVER-INTERFACE>
              <SHORT-NAME>WdgM_IndividualMode</SHORT-NAME>
              <IS-SERVICE>true</IS-SERVICE>
              <DATA-ELEMENTS />
              <MODE-GROUPS>
                <MODE-DECLARATION-GROUP-PROTOTYPE>
                  <SHORT-NAME>currentMode</SHORT-NAME>
                  <TYPE-TREF DEST="MODE-DECLARATION-GROUP">/AUTOSAR_WdgM/ModeDeclarationGroups/WdgMMode</TYPE-TREF>
                </MODE-DECLARATION-GROUP-PROTOTYPE>
              </MODE-GROUPS>
            </SENDER-RECEIVER-INTERFACE>
            <SENDER-RECEIVER-INTERFACE>
              <SHORT-NAME>WdgM_GlobalMode</SHORT-NAME>
              <IS-SERVICE>true</IS-SERVICE>
              <DATA-ELEMENTS />
              <MODE-GROUPS>
                <MODE-DECLARATION-GROUP-PROTOTYPE>
                  <SHORT-NAME>currentMode</SHORT-NAME>
                  <TYPE-TREF DEST="MODE-DECLARATION-GROUP">/AUTOSAR_WdgM/ModeDeclarationGroups/WdgMMode</TYPE-TREF>
                </MODE-DECLARATION-GROUP-PROTOTYPE>
              </MODE-GROUPS>
            </SENDER-RECEIVER-INTERFACE>
          </ELEMENTS>
        </AR-PACKAGE>
[!ENDIF!]
      </SUB-PACKAGES>
    </AR-PACKAGE>
  </TOP-LEVEL-PACKAGES>
</AUTOSAR>
