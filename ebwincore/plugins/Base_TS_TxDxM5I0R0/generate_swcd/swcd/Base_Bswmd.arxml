[part 1 of 2]
<?xml version="1.0" encoding="ISO-8859-1"?>
<AUTOSAR xmlns="http://autosar.org/schema/r4.0"
  xmlns:xsi="http://www.w3.org/2001/XMLSchema-instance"
  xsi:schemaLocation="http://autosar.org/schema/r4.0 AUTOSAR_4-0-3_STRICT_COMPACT.xsd">
[!AUTOSPACING!]
[!VAR "AutosarBaseTypeList"="'boolean uint8 uint16 uint32 sint8 sint16 sint32 float32 float64'"!]
[!VAR "AutosarImplTypeList"="'boolean uint8 uint16 uint32 sint8 sint16 sint32 float32 float64 sint8_least sint16_least sint32_least uint8_least uint16_least uint32_least'"!]
[!IF "node:exists(as:modconf('Base')[1]/BaseTypes/BaseTypes64bit) and (as:modconf('Base')[1]/BaseTypes/BaseTypes64bit = 'true')"!]
[!VAR "AutosarBaseTypeList"="concat($AutosarBaseTypeList,' sint64 uint64')"!]
[!VAR "AutosarImplTypeList"="concat($AutosarImplTypeList,' sint64 uint64')"!]
[!ENDIF!][!/*

* GetTypeInfo
*   Retrieve Native Type, Size and Alignment of an AUTOSAR Base type
*
*   Parameters:
*     AutosarType: Name of the AUTOSAR Base type
*
*/!][!MACRO "GetTypeInfo","AutosarType"!][!/*

  --- get Native Type --- */!][!//
  [!VAR "property"="concat('BaseType_',$AutosarType)"!]
  [!IF "node:exists(as:modconf('Base')[1]/BaseTypes/*[node:name(.)=$property])"!]
    [!VAR "NativeType"="as:modconf('Base')[1]/BaseTypes/*[node:name(.)=$property]"!]
    [!VAR "NativeTypeBase"="normalize-space(text:replace($NativeType,'(un)?signed',''))"!]
  [!ELSE!]
    [!ERROR!]
      Base: No mapping to C type found for AUTOSAR type [!"$AutosarType"!]
    [!ENDERROR!]
  [!ENDIF!][!/*

  --- get Size --- */!][!//
  [!VAR "property"="concat('BaseType_Size_',text:replace($NativeTypeBase,' ',''))"!]
  [!IF "node:exists(as:modconf('Base')[1]/BaseTypes/*[node:name(.)=$property])"!]
    [!VAR "Size"="as:modconf('Base')[1]/BaseTypes/*[node:name(.)=$property]"!]
    [!VAR "Size"="num:i(number($Size) * 8)"!]
  [!ELSE!]
    [!ERROR!]
      Base: Property '[!"$property"!]' not found for type '[!"$NativeTypeBase"!]'
    [!ENDERROR!]
  [!ENDIF!][!/*

  --- get Alignment --- */!][!//
  [!VAR "property"="concat('BaseType_Alignment_',text:replace($NativeTypeBase,' ',''))"!]
  [!IF "node:exists(as:modconf('Base')[1]/BaseTypes/*[node:name(.)=$property])"!]
    [!VAR "Alignment"="as:modconf('Base')[1]/BaseTypes/*[node:name(.)=$property]"!]
    [!VAR "Alignment"="num:i(number($Alignment) * 8)"!]
  [!ELSE!]
    [!ERROR!]
      Base: Property '[!"$property"!]' not found for type '[!"$NativeTypeBase"!]'
    [!ENDERROR!]
  [!ENDIF!][!/*

  --- determine Encoding --- */!][!//
  [!IF "text:match($NativeType,'(float)|(double)')"!]
    [!VAR "Encoding"="'IEEE754'"!]
  [!ELSEIF "not(text:match($NativeType,'^\s*unsigned\s+.*$'))"!]
    [!VAR "Encoding"="'2C'"!]
  [!ELSEIF "text:match($NativeType,'boolean')"!]
    [!VAR "Encoding"="'BOOLEAN'"!]
  [!ELSE!]
    [!VAR "Encoding"="'NONE'"!]
  [!ENDIF!][!/*

  --- get LowerLimit and UpperLimit ---
      don't use size of type, as the size MIGHT be bigger than the allowed values
      instead use the bit width expected by AUTOSAR
      exception: 64 bit unsigned type is hard-coded because it is not supported by bit:shl */!][!//
  [!VAR "AutosarTypeBitWidth" = "normalize-space(text:replace($AutosarType,'^\s*[su]int(\d\d?)(_least)?\s*$','$1'))"!]
  [!IF "$AutosarType = 'boolean'"!]
    [!VAR "LowerLimit"="num:i(0)"!]
    [!VAR "UpperLimit"="num:i(1)"!]
  [!ELSE!]
  [!IF "$Encoding = 'NONE'"!]
    [!VAR "LowerLimit"="num:i(0)"!]
    [!IF "$AutosarTypeBitWidth = '64'"!]
      [!VAR "UpperLimit"="18446744073709551615"!]
    [!ELSE!]
      [!VAR "UpperLimit"="num:i(bit:shl(1,$AutosarTypeBitWidth) - 1)"!]
    [!ENDIF!]
  [!ELSEIF "$Encoding = '2C'"!]
    [!IF "$AutosarTypeBitWidth = '64'"!]
      [!VAR "LowerLimit"="-9223372036854775808"!]
      [!VAR "UpperLimit"="9223372036854775807"!]
    [!ELSE!]
      [!VAR "LowerLimit"="num:i(- bit:shl(1,$AutosarTypeBitWidth - 1))"!]
      [!VAR "UpperLimit"="num:i(bit:shl(1,$AutosarTypeBitWidth - 1) - 1)"!]
    [!ENDIF!]
  [!ELSE!]
    [!VAR "LowerLimit"="num:i(0)"!]
    [!VAR "UpperLimit"="num:i(0)"!]
    [!ENDIF!]
  [!ENDIF!]
[!ENDMACRO!][!/*


* FindMatchingBaseType
*   Takes an ImplementationDataType as input and returns the name of the BaseType
*   1.) for all ImplementationDataType found in list of BaseTypes (var AutosarBaseTypeList)
*      return the name of the ImplementationDataType (input para) since there is a BaseType
*      of the same name.
*   2.) for all ImplementationDataType not contained in the list:
*      return the BaseType which matches with all of the following attributes:
*   - Size
*   - Encoding
*   - Alignment
*
* If there is no matching BaseType generation aborts
* with an error!
*
*/!][!MACRO "FindMatchingBaseType","ImplDataType"!]
  [!CALL "GetTypeInfo","AutosarType"="$ImplDataType"!]
  [!VAR "ImplTypeSize"="$Size"!]
  [!VAR "ImplTypeEncoding"="$Encoding"!]
  [!VAR "ImplTypeAlignment"="$Alignment"!]
  [!VAR "ImplTypeNativeType"="$NativeType"!]
  [!VAR "MatchingBaseType"="''"!]
  [!IF "text:match($AutosarBaseTypeList,$ImplDataType)"!]
    [!VAR "MatchingBaseType"="$ImplDataType"!]
  [!ELSE!]
    [!FOR "type"="1" TO  "num:i(count(text:split($AutosarBaseTypeList)))"!]
      [!VAR "BaseType"="text:split($AutosarBaseTypeList)[num:i($type)]"!]
      [!CALL "GetTypeInfo","AutosarType"="$BaseType"!]
      [!IF "($Size = $ImplTypeSize) and ($Encoding = $ImplTypeEncoding) and ($Alignment = $ImplTypeAlignment)"!]
        [!VAR "MatchingBaseType"="$AutosarType"!]
        [!BREAK!]
      [!ENDIF!]
    [!ENDFOR!]
  [!ENDIF!]
  [!IF "$MatchingBaseType = ''"!]
    [!ERROR!]
      Base: No matching BaseType found for ImplementationDataType [!"$ImplDataType"!]
      [!"$ImplTypeSize"!]
      [!"$ImplTypeEncoding"!]
      [!"$ImplTypeAlignment"!]
      [!"$ImplTypeNativeType"!]
    [!ENDERROR!]
  [!ENDIF!]
[!ENDMACRO!][!/*



* GetPduType
*   Get the base type of types in EcucPduCollection
*
*   Parameters:
*     TypeName: Name of the type in EcucPduCollection
*
*/!][!MACRO "GetPduTypeInfo","TypeName"!]
  [!IF "node:exists(as:modconf('EcuC')[1]/EcucPduCollection/*[node:name(.)=$TypeName])"!]
    [!VAR "Type"="text:tolower(as:modconf('EcuC')[1]/EcucPduCollection/*[node:name(.)=$TypeName])"!]
  [!ELSE!]
    [!VAR "Type" = "'uint16'"!]
  [!ENDIF!]
[!ENDMACRO!][!/*


* GenerateStdImplementationTypes
*   Generates the implementation types of the Std package
*
*   Parameters:
*     None.
*
*/!][!MACRO "GenerateStdImplementationTypes"!]
            <SHORT-NAME>ImplementationDataTypes</SHORT-NAME>
            <CATEGORY>STANDARD</CATEGORY>
            <ELEMENTS>
              <IMPLEMENTATION-DATA-TYPE>
                <SHORT-NAME>Std_ReturnType</SHORT-NAME>
                <CATEGORY>TYPE_REFERENCE</CATEGORY>
                <SW-DATA-DEF-PROPS>
                  <SW-DATA-DEF-PROPS-VARIANTS>
                    <SW-DATA-DEF-PROPS-CONDITIONAL>
                      <COMPU-METHOD-REF DEST="COMPU-METHOD">/AUTOSAR_Std/CompuMethods/Std_ReturnType</COMPU-METHOD-REF>
                      <IMPLEMENTATION-DATA-TYPE-REF DEST="IMPLEMENTATION-DATA-TYPE">/AUTOSAR_Platform/ImplementationDataTypes/uint8</IMPLEMENTATION-DATA-TYPE-REF>
                    </SW-DATA-DEF-PROPS-CONDITIONAL>
                  </SW-DATA-DEF-PROPS-VARIANTS>
                </SW-DATA-DEF-PROPS>
                <TYPE-EMITTER>Std_Types.h</TYPE-EMITTER>
              </IMPLEMENTATION-DATA-TYPE>
              <IMPLEMENTATION-DATA-TYPE>
                <SHORT-NAME>Std_VersionInfoType</SHORT-NAME>
                <CATEGORY>STRUCTURE</CATEGORY>
                <SUB-ELEMENTS>
                  <IMPLEMENTATION-DATA-TYPE-ELEMENT>
                    <SHORT-NAME>vendorID</SHORT-NAME>
                    <CATEGORY>TYPE_REFERENCE</CATEGORY>
                    <SW-DATA-DEF-PROPS>
                      <SW-DATA-DEF-PROPS-VARIANTS>
                        <SW-DATA-DEF-PROPS-CONDITIONAL>
                          <IMPLEMENTATION-DATA-TYPE-REF DEST="IMPLEMENTATION-DATA-TYPE">/AUTOSAR_Platform/ImplementationDataTypes/uint16</IMPLEMENTATION-DATA-TYPE-REF>
                        </SW-DATA-DEF-PROPS-CONDITIONAL>
                      </SW-DATA-DEF-PROPS-VARIANTS>
                    </SW-DATA-DEF-PROPS>
                  </IMPLEMENTATION-DATA-TYPE-ELEMENT>
                  <IMPLEMENTATION-DATA-TYPE-ELEMENT>
                    <SHORT-NAME>moduleID</SHORT-NAME>
                    <CATEGORY>TYPE_REFERENCE</CATEGORY>
                    <SW-DATA-DEF-PROPS>
                      <SW-DATA-DEF-PROPS-VARIANTS>
                        <SW-DATA-DEF-PROPS-CONDITIONAL>
                          <IMPLEMENTATION-DATA-TYPE-REF DEST="IMPLEMENTATION-DATA-TYPE">/AUTOSAR_Platform/ImplementationDataTypes/uint16</IMPLEMENTATION-DATA-TYPE-REF>
                        </SW-DATA-DEF-PROPS-CONDITIONAL>
                      </SW-DATA-DEF-PROPS-VARIANTS>
                    </SW-DATA-DEF-PROPS>
                  </IMPLEMENTATION-DATA-TYPE-ELEMENT>
                  <IMPLEMENTATION-DATA-TYPE-ELEMENT>
                    <SHORT-NAME>sw_major_version</SHORT-NAME>
                    <CATEGORY>TYPE_REFERENCE</CATEGORY>
                    <SW-DATA-DEF-PROPS>
                      <SW-DATA-DEF-PROPS-VARIANTS>
                        <SW-DATA-DEF-PROPS-CONDITIONAL>
                          <IMPLEMENTATION-DATA-TYPE-REF DEST="IMPLEMENTATION-DATA-TYPE">/AUTOSAR_Platform/ImplementationDataTypes/uint8</IMPLEMENTATION-DATA-TYPE-REF>
                        </SW-DATA-DEF-PROPS-CONDITIONAL>
                      </SW-DATA-DEF-PROPS-VARIANTS>
                    </SW-DATA-DEF-PROPS>
                  </IMPLEMENTATION-DATA-TYPE-ELEMENT>
                  <IMPLEMENTATION-DATA-TYPE-ELEMENT>
                    <SHORT-NAME>sw_minor_version</SHORT-NAME>
                    <CATEGORY>TYPE_REFERENCE</CATEGORY>
                    <SW-DATA-DEF-PROPS>
                      <SW-DATA-DEF-PROPS-VARIANTS>
                        <SW-DATA-DEF-PROPS-CONDITIONAL>
                          <IMPLEMENTATION-DATA-TYPE-REF DEST="IMPLEMENTATION-DATA-TYPE">/AUTOSAR_Platform/ImplementationDataTypes/uint8</IMPLEMENTATION-DATA-TYPE-REF>
                        </SW-DATA-DEF-PROPS-CONDITIONAL>
                      </SW-DATA-DEF-PROPS-VARIANTS>
                    </SW-DATA-DEF-PROPS>
                  </IMPLEMENTATION-DATA-TYPE-ELEMENT>
                  <IMPLEMENTATION-DATA-TYPE-ELEMENT>
                    <SHORT-NAME>sw_patch_version</SHORT-NAME>
                    <CATEGORY>TYPE_REFERENCE</CATEGORY>
                    <SW-DATA-DEF-PROPS>
                      <SW-DATA-DEF-PROPS-VARIANTS>
                        <SW-DATA-DEF-PROPS-CONDITIONAL>
                          <IMPLEMENTATION-DATA-TYPE-REF DEST="IMPLEMENTATION-DATA-TYPE">/AUTOSAR_Platform/ImplementationDataTypes/uint8</IMPLEMENTATION-DATA-TYPE-REF>
                        </SW-DATA-DEF-PROPS-CONDITIONAL>
                      </SW-DATA-DEF-PROPS-VARIANTS>
                    </SW-DATA-DEF-PROPS>
                  </IMPLEMENTATION-DATA-TYPE-ELEMENT>
                </SUB-ELEMENTS>
                <TYPE-EMITTER>Std_Types.h</TYPE-EMITTER>
              </IMPLEMENTATION-DATA-TYPE>
              <IMPLEMENTATION-DATA-TYPE>
                <SHORT-NAME>Std_MessageTypeType</SHORT-NAME>
                <CATEGORY>TYPE_REFERENCE</CATEGORY>
                <SW-DATA-DEF-PROPS>
                  <SW-DATA-DEF-PROPS-VARIANTS>
                    <SW-DATA-DEF-PROPS-CONDITIONAL>
                      <COMPU-METHOD-REF DEST="COMPU-METHOD">/AUTOSAR_Std/CompuMethods/Std_MessageTypeType</COMPU-METHOD-REF>
                      <IMPLEMENTATION-DATA-TYPE-REF DEST="IMPLEMENTATION-DATA-TYPE">/AUTOSAR_Platform/ImplementationDataTypes/uint8</IMPLEMENTATION-DATA-TYPE-REF>
                    </SW-DATA-DEF-PROPS-CONDITIONAL>
                  </SW-DATA-DEF-PROPS-VARIANTS>
                </SW-DATA-DEF-PROPS>
                <TYPE-EMITTER>Std_Types.h</TYPE-EMITTER>
              </IMPLEMENTATION-DATA-TYPE>
              <IMPLEMENTATION-DATA-TYPE>
                <SHORT-NAME>Std_MessageResultType</SHORT-NAME>
                <CATEGORY>TYPE_REFERENCE</CATEGORY>
                <SW-DATA-DEF-PROPS>
                  <SW-DATA-DEF-PROPS-VARIANTS>
                    <SW-DATA-DEF-PROPS-CONDITIONAL>
                      <COMPU-METHOD-REF DEST="COMPU-METHOD">/AUTOSAR_Std/CompuMethods/Std_MessageResultType</COMPU-METHOD-REF>
                      <IMPLEMENTATION-DATA-TYPE-REF DEST="IMPLEMENTATION-DATA-TYPE">/AUTOSAR_Platform/ImplementationDataTypes/uint8</IMPLEMENTATION-DATA-TYPE-REF>
                    </SW-DATA-DEF-PROPS-CONDITIONAL>
                  </SW-DATA-DEF-PROPS-VARIANTS>
                </SW-DATA-DEF-PROPS>
                <TYPE-EMITTER>Std_Types.h</TYPE-EMITTER>
              </IMPLEMENTATION-DATA-TYPE>
            </ELEMENTS>
[!ENDMACRO!][!/*

* GenerateStdCompuMethods
*   Generates the compu methods of the Std package
*
*   Parameters:
*     None.
*
*/!][!MACRO "GenerateStdCompuMethods"!]
            <SHORT-NAME>CompuMethods</SHORT-NAME>
            <CATEGORY>STANDARD</CATEGORY>
            <ELEMENTS>
              <COMPU-METHOD>
                 <SHORT-NAME>Std_ReturnType</SHORT-NAME>
                 <CATEGORY>TEXTTABLE</CATEGORY>
                 <COMPU-INTERNAL-TO-PHYS>
                    <COMPU-SCALES>
                       <COMPU-SCALE>
                          <LOWER-LIMIT INTERVAL-TYPE="CLOSED">0</LOWER-LIMIT>
                          <UPPER-LIMIT INTERVAL-TYPE="CLOSED">0</UPPER-LIMIT>
                          <COMPU-CONST>
                             <VT>E_OK</VT>
                          </COMPU-CONST>
                       </COMPU-SCALE>
                       <COMPU-SCALE>
                          <LOWER-LIMIT INTERVAL-TYPE="CLOSED">1</LOWER-LIMIT>
                          <UPPER-LIMIT INTERVAL-TYPE="CLOSED">1</UPPER-LIMIT>
                          <COMPU-CONST>
                             <VT>E_NOT_OK</VT>
                          </COMPU-CONST>
                       </COMPU-SCALE>
                    </COMPU-SCALES>
                 </COMPU-INTERNAL-TO-PHYS>
              </COMPU-METHOD>
              <COMPU-METHOD>
                 <SHORT-NAME>Std_MessageTypeType</SHORT-NAME>
                 <CATEGORY>TEXTTABLE</CATEGORY>
                 <COMPU-INTERNAL-TO-PHYS>
                    <COMPU-SCALES>
                       <COMPU-SCALE>
                          <LOWER-LIMIT INTERVAL-TYPE="CLOSED">0</LOWER-LIMIT>
                          <UPPER-LIMIT INTERVAL-TYPE="CLOSED">0</UPPER-LIMIT>
                          <COMPU-CONST>
                             <VT>STD_MESSAGETYPE_REQUEST</VT>
                          </COMPU-CONST>
                       </COMPU-SCALE>
                       <COMPU-SCALE>
                          <LOWER-LIMIT INTERVAL-TYPE="CLOSED">1</LOWER-LIMIT>
                          <UPPER-LIMIT INTERVAL-TYPE="CLOSED">1</UPPER-LIMIT>
                          <COMPU-CONST>
                             <VT>STD_MESSAGETYPE_RESPONSE</VT>
                          </COMPU-CONST>
                       </COMPU-SCALE>
                    </COMPU-SCALES>
                 </COMPU-INTERNAL-TO-PHYS>
              </COMPU-METHOD>
              <COMPU-METHOD>
                 <SHORT-NAME>Std_MessageResultType</SHORT-NAME>
                 <CATEGORY>TEXTTABLE</CATEGORY>
                 <COMPU-INTERNAL-TO-PHYS>
                    <COMPU-SCALES>
                       <COMPU-SCALE>
                          <LOWER-LIMIT INTERVAL-TYPE="CLOSED">0</LOWER-LIMIT>
                          <UPPER-LIMIT INTERVAL-TYPE="CLOSED">0</UPPER-LIMIT>
                          <COMPU-CONST>
                             <VT>STD_MESSAGRESULT_OK</VT>
                          </COMPU-CONST>
                       </COMPU-SCALE>
                       <COMPU-SCALE>
                          <LOWER-LIMIT INTERVAL-TYPE="CLOSED">1</LOWER-LIMIT>
                          <UPPER-LIMIT INTERVAL-TYPE="CLOSED">1</UPPER-LIMIT>
                          <COMPU-CONST>
                             <VT>STD_MESSAGERESULT_ERROR</VT>
                          </COMPU-CONST>
                       </COMPU-SCALE>
                    </COMPU-SCALES>
                 </COMPU-INTERNAL-TO-PHYS>
              </COMPU-METHOD>
           </ELEMENTS>
[!ENDMACRO!][!/*

* GeneratePlatformImplementationTypes
*   Generates the implementation types of the Platform package
*
*   Parameters:
*     None.
*
*/!][!MACRO "GeneratePlatformImplementationTypes"!]
            <SHORT-NAME>ImplementationDataTypes</SHORT-NAME>
            <CATEGORY>STANDARD</CATEGORY>
            <ELEMENTS>
              <!-- kept for backward compatibility, deprecated, AUTOSAR/GenDef/ImplementationDataTypes/ConstVoidPtr shall be used instead -->
              <IMPLEMENTATION-DATA-TYPE>
                <SHORT-NAME>ConstVoidPtr</SHORT-NAME>
                <CATEGORY>DATA_REFERENCE</CATEGORY>
                <SW-DATA-DEF-PROPS>
                  <SW-DATA-DEF-PROPS-VARIANTS>
                    <SW-DATA-DEF-PROPS-CONDITIONAL>
                      <SW-POINTER-TARGET-PROPS>
                        <TARGET-CATEGORY>VALUE</TARGET-CATEGORY>
                        <SW-DATA-DEF-PROPS>
                          <SW-DATA-DEF-PROPS-VARIANTS>
                            <SW-DATA-DEF-PROPS-CONDITIONAL>
                              <BASE-TYPE-REF DEST="SW-BASE-TYPE">/AUTOSAR_Platform/BaseTypes/void</BASE-TYPE-REF>
                              <SW-IMPL-POLICY>CONST</SW-IMPL-POLICY>
                            </SW-DATA-DEF-PROPS-CONDITIONAL>
                          </SW-DATA-DEF-PROPS-VARIANTS>
                        </SW-DATA-DEF-PROPS>
                      </SW-POINTER-TARGET-PROPS>
                    </SW-DATA-DEF-PROPS-CONDITIONAL>
                  </SW-DATA-DEF-PROPS-VARIANTS>
                </SW-DATA-DEF-PROPS>
                <TYPE-EMITTER>BSW</TYPE-EMITTER>
              </IMPLEMENTATION-DATA-TYPE>
              <!-- kept for backward compatibility, deprecated, AUTOSAR/GenDef/ImplementationDataTypes/VoidPtr shall be used instead -->
              <IMPLEMENTATION-DATA-TYPE>
                <SHORT-NAME>VoidPtr</SHORT-NAME>
                <CATEGORY>DATA_REFERENCE</CATEGORY>
                <SW-DATA-DEF-PROPS>
                  <SW-DATA-DEF-PROPS-VARIANTS>
                    <SW-DATA-DEF-PROPS-CONDITIONAL>
                      <SW-POINTER-TARGET-PROPS>
                        <TARGET-CATEGORY>VALUE</TARGET-CATEGORY>
                        <SW-DATA-DEF-PROPS>
                          <SW-DATA-DEF-PROPS-VARIANTS>
                            <SW-DATA-DEF-PROPS-CONDITIONAL>
                              <BASE-TYPE-REF DEST="SW-BASE-TYPE">/AUTOSAR_Platform/BaseTypes/void</BASE-TYPE-REF>
                            </SW-DATA-DEF-PROPS-CONDITIONAL>
                          </SW-DATA-DEF-PROPS-VARIANTS>
                        </SW-DATA-DEF-PROPS>
                      </SW-POINTER-TARGET-PROPS>
                    </SW-DATA-DEF-PROPS-CONDITIONAL>
                  </SW-DATA-DEF-PROPS-VARIANTS>
                </SW-DATA-DEF-PROPS>
                <TYPE-EMITTER>BSW</TYPE-EMITTER>
              </IMPLEMENTATION-DATA-TYPE>

              <!-- !LINKSTO Base.DataConstr.References, 1 -->
[!FOR "i"="1" TO  "num:i(count(text:split($AutosarImplTypeList)))"!]
  [!VAR "ImplDataType"="text:split($AutosarImplTypeList)[num:i($i)]"!]
  [!CALL "FindMatchingBaseType","ImplDataType"="$ImplDataType"!]
              <IMPLEMENTATION-DATA-TYPE>
                <SHORT-NAME>[!"$ImplDataType"!]</SHORT-NAME>
                <CATEGORY>VALUE</CATEGORY>
                <SW-DATA-DEF-PROPS>
                  <SW-DATA-DEF-PROPS-VARIANTS>
                    <SW-DATA-DEF-PROPS-CONDITIONAL>
                      <BASE-TYPE-REF DEST="SW-BASE-TYPE">/AUTOSAR_Platform/BaseTypes/[!"$MatchingBaseType"!]</BASE-TYPE-REF>
[!IF "$AutosarType = 'boolean'"!]
                      <COMPU-METHOD-REF DEST="COMPU-METHOD">/AUTOSAR_Platform/CompuMethods/boolean</COMPU-METHOD-REF>
  [!ENDIF!]
                    </SW-DATA-DEF-PROPS-CONDITIONAL>
                  </SW-DATA-DEF-PROPS-VARIANTS>
                </SW-DATA-DEF-PROPS>
                <TYPE-EMITTER>Platform_Types.h</TYPE-EMITTER>
              </IMPLEMENTATION-DATA-TYPE>
[!ENDFOR!]
            </ELEMENTS>
[!ENDMACRO!][!/*


* GenerateComtypeImplementationTypes
*   Generates the implementation types of the Comtype package
*
*   Parameters:
*     None.
*
*/!][!MACRO "GenerateComtypeImplementationTypes"!]
            <SHORT-NAME>ImplementationDataTypes</SHORT-NAME>
            <CATEGORY>STANDARD</CATEGORY>
            <ELEMENTS>
              <IMPLEMENTATION-DATA-TYPE>
                 <SHORT-NAME>IcomConfigIdType</SHORT-NAME>
                <CATEGORY>TYPE_REFERENCE</CATEGORY>
                <SW-DATA-DEF-PROPS>
                  <SW-DATA-DEF-PROPS-VARIANTS>
                    <SW-DATA-DEF-PROPS-CONDITIONAL>
                          <DATA-CONSTR-REF DEST="DATA-CONSTR">/AUTOSAR_ComStack_Types/DataConstrs/IcomConfigIdType</DATA-CONSTR-REF>
                          <IMPLEMENTATION-DATA-TYPE-REF DEST="IMPLEMENTATION-DATA-TYPE">/AUTOSAR_Platform/ImplementationDataTypes/uint8</IMPLEMENTATION-DATA-TYPE-REF>
                    </SW-DATA-DEF-PROPS-CONDITIONAL>
                  </SW-DATA-DEF-PROPS-VARIANTS>
                </SW-DATA-DEF-PROPS>
                <TYPE-EMITTER>BSW</TYPE-EMITTER>
              </IMPLEMENTATION-DATA-TYPE>
              <IMPLEMENTATION-DATA-TYPE>
                <SHORT-NAME>IcomSwitch_ErrorType</SHORT-NAME>
                <CATEGORY>TYPE_REFERENCE</CATEGORY>
                 <SW-DATA-DEF-PROPS>
                    <SW-DATA-DEF-PROPS-VARIANTS>
                       <SW-DATA-DEF-PROPS-CONDITIONAL>
                          <COMPU-METHOD-REF DEST="COMPU-METHOD">/AUTOSAR_ComStack_Types/CompuMethods/IcomSwitch_ErrorType</COMPU-METHOD-REF>
                          <DATA-CONSTR-REF DEST="DATA-CONSTR">/AUTOSAR_ComStack_Types/DataConstrs/IcomSwitch_ErrorType</DATA-CONSTR-REF>
                          <IMPLEMENTATION-DATA-TYPE-REF DEST="IMPLEMENTATION-DATA-TYPE">/AUTOSAR_Platform/ImplementationDataTypes/uint8</IMPLEMENTATION-DATA-TYPE-REF>
                       </SW-DATA-DEF-PROPS-CONDITIONAL>
                    </SW-DATA-DEF-PROPS-VARIANTS>
                 </SW-DATA-DEF-PROPS>
                <TYPE-EMITTER>BSW</TYPE-EMITTER>
              </IMPLEMENTATION-DATA-TYPE>
              <IMPLEMENTATION-DATA-TYPE>
                <SHORT-NAME>NetworkHandleType</SHORT-NAME>
                <CATEGORY>TYPE_REFERENCE</CATEGORY>
                <SW-DATA-DEF-PROPS>
                  <SW-DATA-DEF-PROPS-VARIANTS>
                    <SW-DATA-DEF-PROPS-CONDITIONAL>
                      <DATA-CONSTR-REF DEST="DATA-CONSTR">/AUTOSAR_ComStack_Types/DataConstrs/NetworkHandleType</DATA-CONSTR-REF>
                      <IMPLEMENTATION-DATA-TYPE-REF DEST="IMPLEMENTATION-DATA-TYPE">/AUTOSAR_Platform/ImplementationDataTypes/uint8</IMPLEMENTATION-DATA-TYPE-REF>
                    </SW-DATA-DEF-PROPS-CONDITIONAL>
                  </SW-DATA-DEF-PROPS-VARIANTS>
                </SW-DATA-DEF-PROPS>
                <TYPE-EMITTER>BSW</TYPE-EMITTER>
              </IMPLEMENTATION-DATA-TYPE>
              <IMPLEMENTATION-DATA-TYPE>
                <SHORT-NAME>PduInfoType</SHORT-NAME>
                <CATEGORY>STRUCTURE</CATEGORY>
                <SUB-ELEMENTS>
                  <IMPLEMENTATION-DATA-TYPE-ELEMENT>
                    <SHORT-NAME>SduDataPtr</SHORT-NAME>
                    <CATEGORY>DATA_REFERENCE</CATEGORY>
                    <SW-DATA-DEF-PROPS>
                      <SW-DATA-DEF-PROPS-VARIANTS>
                        <SW-DATA-DEF-PROPS-CONDITIONAL>
                          <SW-POINTER-TARGET-PROPS>
                            <TARGET-CATEGORY>TYPE_REFERENCE</TARGET-CATEGORY>
                            <SW-DATA-DEF-PROPS>
                              <SW-DATA-DEF-PROPS-VARIANTS>
                                <SW-DATA-DEF-PROPS-CONDITIONAL>
                                  <IMPLEMENTATION-DATA-TYPE-REF DEST="IMPLEMENTATION-DATA-TYPE">/AUTOSAR_Platform/ImplementationDataTypes/uint8</IMPLEMENTATION-DATA-TYPE-REF>
                                </SW-DATA-DEF-PROPS-CONDITIONAL>
                              </SW-DATA-DEF-PROPS-VARIANTS>
                            </SW-DATA-DEF-PROPS>
                          </SW-POINTER-TARGET-PROPS>
                        </SW-DATA-DEF-PROPS-CONDITIONAL>
                      </SW-DATA-DEF-PROPS-VARIANTS>
                    </SW-DATA-DEF-PROPS>
                  </IMPLEMENTATION-DATA-TYPE-ELEMENT>
                  <IMPLEMENTATION-DATA-TYPE-ELEMENT>
                    <SHORT-NAME>SduLength</SHORT-NAME>
                    <CATEGORY>TYPE_REFERENCE</CATEGORY>
                    <SW-DATA-DEF-PROPS>
                      <SW-DATA-DEF-PROPS-VARIANTS>
                        <SW-DATA-DEF-PROPS-CONDITIONAL>
                          <IMPLEMENTATION-DATA-TYPE-REF DEST="IMPLEMENTATION-DATA-TYPE">/AUTOSAR_ComStack_Types/ImplementationDataTypes/PduLengthType</IMPLEMENTATION-DATA-TYPE-REF>
                        </SW-DATA-DEF-PROPS-CONDITIONAL>
                      </SW-DATA-DEF-PROPS-VARIANTS>
                    </SW-DATA-DEF-PROPS>
                  </IMPLEMENTATION-DATA-TYPE-ELEMENT>
                </SUB-ELEMENTS>
                <TYPE-EMITTER>BSW</TYPE-EMITTER>
              </IMPLEMENTATION-DATA-TYPE>
              <IMPLEMENTATION-DATA-TYPE>
	              <SHORT-NAME>PNCHandleType</SHORT-NAME>
	              <CATEGORY>TYPE_REFERENCE</CATEGORY>
	              <SW-DATA-DEF-PROPS>
	                 <SW-DATA-DEF-PROPS-VARIANTS>
	                    <SW-DATA-DEF-PROPS-CONDITIONAL>
	                       <DATA-CONSTR-REF DEST="DATA-CONSTR">/AUTOSAR_ComStack_Types/DataConstrs/PNCHandleType</DATA-CONSTR-REF>
	                       <IMPLEMENTATION-DATA-TYPE-REF DEST="IMPLEMENTATION-DATA-TYPE">/AUTOSAR_Platform/ImplementationDataTypes/uint8</IMPLEMENTATION-DATA-TYPE-REF>
	                    </SW-DATA-DEF-PROPS-CONDITIONAL>
	                 </SW-DATA-DEF-PROPS-VARIANTS>
	              </SW-DATA-DEF-PROPS>
                <TYPE-EMITTER>BSW</TYPE-EMITTER>
	           </IMPLEMENTATION-DATA-TYPE>
	            <IMPLEMENTATION-DATA-TYPE>
                <SHORT-NAME>RetryInfoType</SHORT-NAME>
                <CATEGORY>STRUCTURE</CATEGORY>
                <SUB-ELEMENTS>
                  <IMPLEMENTATION-DATA-TYPE-ELEMENT>
                    <SHORT-NAME>TpDataState</SHORT-NAME>
                    <CATEGORY>TYPE_REFERENCE</CATEGORY>
                    <SW-DATA-DEF-PROPS>
                      <SW-DATA-DEF-PROPS-VARIANTS>
                        <SW-DATA-DEF-PROPS-CONDITIONAL>
                          <IMPLEMENTATION-DATA-TYPE-REF DEST="IMPLEMENTATION-DATA-TYPE">/AUTOSAR_ComStack_Types/ImplementationDataTypes/TpDataStateType</IMPLEMENTATION-DATA-TYPE-REF>
                        </SW-DATA-DEF-PROPS-CONDITIONAL>
                      </SW-DATA-DEF-PROPS-VARIANTS>
                    </SW-DATA-DEF-PROPS>
                  </IMPLEMENTATION-DATA-TYPE-ELEMENT>
                  <IMPLEMENTATION-DATA-TYPE-ELEMENT>
                    <SHORT-NAME>TxTpDataCnt</SHORT-NAME>
                    <CATEGORY>TYPE_REFERENCE</CATEGORY>
                    <SW-DATA-DEF-PROPS>
                      <SW-DATA-DEF-PROPS-VARIANTS>
                        <SW-DATA-DEF-PROPS-CONDITIONAL>
                          <IMPLEMENTATION-DATA-TYPE-REF DEST="IMPLEMENTATION-DATA-TYPE">/AUTOSAR_ComStack_Types/ImplementationDataTypes/PduLengthType</IMPLEMENTATION-DATA-TYPE-REF>
                        </SW-DATA-DEF-PROPS-CONDITIONAL>
                      </SW-DATA-DEF-PROPS-VARIANTS>
                    </SW-DATA-DEF-PROPS>
                  </IMPLEMENTATION-DATA-TYPE-ELEMENT>
                </SUB-ELEMENTS>
                <TYPE-EMITTER>BSW</TYPE-EMITTER>
              </IMPLEMENTATION-DATA-TYPE>
              <IMPLEMENTATION-DATA-TYPE>
                <SHORT-NAME>TpDataStateType</SHORT-NAME>
                <CATEGORY>TYPE_REFERENCE</CATEGORY>
                <SW-DATA-DEF-PROPS>
                  <SW-DATA-DEF-PROPS-VARIANTS>
                    <SW-DATA-DEF-PROPS-CONDITIONAL>
	                    <COMPU-METHOD-REF DEST="COMPU-METHOD">/AUTOSAR_ComStack_Types/CompuMethods/TpDataStateType</COMPU-METHOD-REF>
	                    <DATA-CONSTR-REF DEST="DATA-CONSTR">/AUTOSAR_ComStack_Types/DataConstrs/TpDataStateType</DATA-CONSTR-REF>
                      <IMPLEMENTATION-DATA-TYPE-REF DEST="IMPLEMENTATION-DATA-TYPE">/AUTOSAR_Platform/ImplementationDataTypes/uint8</IMPLEMENTATION-DATA-TYPE-REF>
                    </SW-DATA-DEF-PROPS-CONDITIONAL>
                  </SW-DATA-DEF-PROPS-VARIANTS>
                </SW-DATA-DEF-PROPS>
                <TYPE-EMITTER>BSW</TYPE-EMITTER>
              </IMPLEMENTATION-DATA-TYPE>
              <IMPLEMENTATION-DATA-TYPE>
                <SHORT-NAME>TPParameterType</SHORT-NAME>
                <CATEGORY>TYPE_REFERENCE</CATEGORY>
                <SW-DATA-DEF-PROPS>
                  <SW-DATA-DEF-PROPS-VARIANTS>
                    <SW-DATA-DEF-PROPS-CONDITIONAL>
	                   <COMPU-METHOD-REF DEST="COMPU-METHOD">/AUTOSAR_ComStack_Types/CompuMethods/TPParameterType</COMPU-METHOD-REF>
	                   <DATA-CONSTR-REF DEST="DATA-CONSTR">/AUTOSAR_ComStack_Types/DataConstrs/TPParameterType</DATA-CONSTR-REF>
                     <IMPLEMENTATION-DATA-TYPE-REF DEST="IMPLEMENTATION-DATA-TYPE">/AUTOSAR_Platform/ImplementationDataTypes/uint8</IMPLEMENTATION-DATA-TYPE-REF>
                    </SW-DATA-DEF-PROPS-CONDITIONAL>
                  </SW-DATA-DEF-PROPS-VARIANTS>
                </SW-DATA-DEF-PROPS>
                <TYPE-EMITTER>BSW</TYPE-EMITTER>
              </IMPLEMENTATION-DATA-TYPE>
              <IMPLEMENTATION-DATA-TYPE>
                <SHORT-NAME>PduIdType</SHORT-NAME>
                <CATEGORY>TYPE_REFERENCE</CATEGORY>
                <ADMIN-DATA>
                  <SDGS>
                    <SDG GID="EB:PROVIDING-HEADER-FILE">
                      <SD GID="PROVIDING-HEADER-FILE">ComStack_Types.h</SD>
                    </SDG>
                  </SDGS>
                </ADMIN-DATA>
                <SW-DATA-DEF-PROPS>
                  <SW-DATA-DEF-PROPS-VARIANTS>
                    <SW-DATA-DEF-PROPS-CONDITIONAL>
                      <DATA-CONSTR-REF DEST="DATA-CONSTR">/AUTOSAR_ComStack_Types/DataConstrs/PduIdType</DATA-CONSTR-REF>
                      [!CALL "GetPduTypeInfo", "TypeName"="'PduIdTypeEnum'"!]
                      <IMPLEMENTATION-DATA-TYPE-REF DEST="IMPLEMENTATION-DATA-TYPE">/AUTOSAR_Platform/ImplementationDataTypes/[!"$Type"!]</IMPLEMENTATION-DATA-TYPE-REF>
                    </SW-DATA-DEF-PROPS-CONDITIONAL>
                  </SW-DATA-DEF-PROPS-VARIANTS>
                </SW-DATA-DEF-PROPS>
                <TYPE-EMITTER>BSW</TYPE-EMITTER>
              </IMPLEMENTATION-DATA-TYPE>
              <IMPLEMENTATION-DATA-TYPE>
                <SHORT-NAME>PduLengthType</SHORT-NAME>
                <CATEGORY>TYPE_REFERENCE</CATEGORY>
                <ADMIN-DATA>
                  <SDGS>
                    <SDG GID="EB:PROVIDING-HEADER-FILE">
                      <SD GID="PROVIDING-HEADER-FILE">ComStack_Types.h</SD>
                    </SDG>
                  </SDGS>
                </ADMIN-DATA>
                <SW-DATA-DEF-PROPS>
                  <SW-DATA-DEF-PROPS-VARIANTS>
                    <SW-DATA-DEF-PROPS-CONDITIONAL>
                      <DATA-CONSTR-REF DEST="DATA-CONSTR">/AUTOSAR_ComStack_Types/DataConstrs/PduLengthType</DATA-CONSTR-REF>
                      [!CALL "GetPduTypeInfo", "TypeName"="'PduLengthTypeEnum'"!]
                      <IMPLEMENTATION-DATA-TYPE-REF DEST="IMPLEMENTATION-DATA-TYPE">/AUTOSAR_Platform/ImplementationDataTypes/[!"$Type"!]</IMPLEMENTATION-DATA-TYPE-REF>
                    </SW-DATA-DEF-PROPS-CONDITIONAL>
                  </SW-DATA-DEF-PROPS-VARIANTS>
                </SW-DATA-DEF-PROPS>
                <TYPE-EMITTER>BSW</TYPE-EMITTER>
              </IMPLEMENTATION-DATA-TYPE>
              <IMPLEMENTATION-DATA-TYPE>
                <SHORT-NAME>BufReq_ReturnType</SHORT-NAME>
                <CATEGORY>TYPE_REFERENCE</CATEGORY>
                <SW-DATA-DEF-PROPS>
                  <SW-DATA-DEF-PROPS-VARIANTS>
                    <SW-DATA-DEF-PROPS-CONDITIONAL>
                      <COMPU-METHOD-REF DEST="COMPU-METHOD">/AUTOSAR_ComStack_Types/CompuMethods/BufReq_ReturnType</COMPU-METHOD-REF>
                      <DATA-CONSTR-REF DEST="DATA-CONSTR">/AUTOSAR_ComStack_Types/DataConstrs/BufReq_ReturnType</DATA-CONSTR-REF>
                      <IMPLEMENTATION-DATA-TYPE-REF DEST="IMPLEMENTATION-DATA-TYPE">/AUTOSAR_Platform/ImplementationDataTypes/uint8</IMPLEMENTATION-DATA-TYPE-REF>
                    </SW-DATA-DEF-PROPS-CONDITIONAL>
                  </SW-DATA-DEF-PROPS-VARIANTS>
                </SW-DATA-DEF-PROPS>
                <TYPE-EMITTER>BSW</TYPE-EMITTER>
              </IMPLEMENTATION-DATA-TYPE>
              <IMPLEMENTATION-DATA-TYPE>
                <SHORT-NAME>NotifResultType</SHORT-NAME>
                <CATEGORY>TYPE_REFERENCE</CATEGORY>
                <SW-DATA-DEF-PROPS>
                  <SW-DATA-DEF-PROPS-VARIANTS>
                    <SW-DATA-DEF-PROPS-CONDITIONAL>
                      <IMPLEMENTATION-DATA-TYPE-REF DEST="IMPLEMENTATION-DATA-TYPE">/AUTOSAR_Platform/ImplementationDataTypes/uint8</IMPLEMENTATION-DATA-TYPE-REF>
                    </SW-DATA-DEF-PROPS-CONDITIONAL>
                  </SW-DATA-DEF-PROPS-VARIANTS>
                </SW-DATA-DEF-PROPS>
                <TYPE-EMITTER>BSW</TYPE-EMITTER>
              </IMPLEMENTATION-DATA-TYPE>
              <IMPLEMENTATION-DATA-TYPE>
                <SHORT-NAME>BusTrcvErrorType</SHORT-NAME>
                <CATEGORY>TYPE_REFERENCE</CATEGORY>
                <SW-DATA-DEF-PROPS>
                  <SW-DATA-DEF-PROPS-VARIANTS>
                    <SW-DATA-DEF-PROPS-CONDITIONAL>
                      <COMPU-METHOD-REF DEST="COMPU-METHOD">/AUTOSAR_ComStack_Types/CompuMethods/BusTrcvErrorType</COMPU-METHOD-REF>
                      <DATA-CONSTR-REF DEST="DATA-CONSTR">/AUTOSAR_ComStack_Types/DataConstrs/BusTrcvErrorType</DATA-CONSTR-REF>
                      <IMPLEMENTATION-DATA-TYPE-REF DEST="IMPLEMENTATION-DATA-TYPE">/AUTOSAR_Platform/ImplementationDataTypes/uint8</IMPLEMENTATION-DATA-TYPE-REF>
                    </SW-DATA-DEF-PROPS-CONDITIONAL>
                  </SW-DATA-DEF-PROPS-VARIANTS>
                </SW-DATA-DEF-PROPS>
                <TYPE-EMITTER>BSW</TYPE-EMITTER>
              </IMPLEMENTATION-DATA-TYPE>
            </ELEMENTS>
[!ENDMACRO!][!/*


* GenerateFrImplementationTypes
*   Generates the implementation types of the Fr package
*
*   Parameters:
*     None.
*
*/!][!MACRO "GenerateFrImplementationTypes"!]
            <SHORT-NAME>ImplementationDataTypes</SHORT-NAME>
            <CATEGORY>STANDARD</CATEGORY>
            <ELEMENTS>
              <IMPLEMENTATION-DATA-TYPE>
                <SHORT-NAME>Fr_SyncStateType</SHORT-NAME>
                <CATEGORY>TYPE_REFERENCE</CATEGORY>
                <SW-DATA-DEF-PROPS>
                  <SW-DATA-DEF-PROPS-VARIANTS>
                    <SW-DATA-DEF-PROPS-CONDITIONAL>
                      <COMPU-METHOD-REF DEST="COMPU-METHOD">/AUTOSAR_Fr/CompuMethods/Fr_SyncStateType_Literals</COMPU-METHOD-REF>
                      <IMPLEMENTATION-DATA-TYPE-REF DEST="IMPLEMENTATION-DATA-TYPE">/AUTOSAR_Platform/ImplementationDataTypes/uint32</IMPLEMENTATION-DATA-TYPE-REF>
                    </SW-DATA-DEF-PROPS-CONDITIONAL>
                  </SW-DATA-DEF-PROPS-VARIANTS>
                </SW-DATA-DEF-PROPS>
                <TYPE-EMITTER>BSW</TYPE-EMITTER>
              </IMPLEMENTATION-DATA-TYPE>
              <IMPLEMENTATION-DATA-TYPE>
                <SHORT-NAME>Fr_OffsetCorrectionType</SHORT-NAME>
                <CATEGORY>TYPE_REFERENCE</CATEGORY>
                <SW-DATA-DEF-PROPS>
                  <SW-DATA-DEF-PROPS-VARIANTS>
                    <SW-DATA-DEF-PROPS-CONDITIONAL>
                      <COMPU-METHOD-REF DEST="COMPU-METHOD">/AUTOSAR_Fr/CompuMethods/Fr_OffsetCorrectionType_Literals</COMPU-METHOD-REF>
                      <IMPLEMENTATION-DATA-TYPE-REF DEST="IMPLEMENTATION-DATA-TYPE">/AUTOSAR_Platform/ImplementationDataTypes/uint32</IMPLEMENTATION-DATA-TYPE-REF>
                    </SW-DATA-DEF-PROPS-CONDITIONAL>
                  </SW-DATA-DEF-PROPS-VARIANTS>
                </SW-DATA-DEF-PROPS>
                <TYPE-EMITTER>BSW</TYPE-EMITTER>
              </IMPLEMENTATION-DATA-TYPE>
              <IMPLEMENTATION-DATA-TYPE>
                <SHORT-NAME>Fr_RateCorrectionType</SHORT-NAME>
                <CATEGORY>TYPE_REFERENCE</CATEGORY>
                <SW-DATA-DEF-PROPS>
                  <SW-DATA-DEF-PROPS-VARIANTS>
                    <SW-DATA-DEF-PROPS-CONDITIONAL>
                      <COMPU-METHOD-REF DEST="COMPU-METHOD">/AUTOSAR_Fr/CompuMethods/Fr_RateCorrectionType_Literals</COMPU-METHOD-REF>
                      <IMPLEMENTATION-DATA-TYPE-REF DEST="IMPLEMENTATION-DATA-TYPE">/AUTOSAR_Platform/ImplementationDataTypes/uint32</IMPLEMENTATION-DATA-TYPE-REF>
                    </SW-DATA-DEF-PROPS-CONDITIONAL>
                  </SW-DATA-DEF-PROPS-VARIANTS>
                </SW-DATA-DEF-PROPS>
                <TYPE-EMITTER>BSW</TYPE-EMITTER>
              </IMPLEMENTATION-DATA-TYPE>
              <IMPLEMENTATION-DATA-TYPE>
                <SHORT-NAME>Fr_POCStateType</SHORT-NAME>
                <CATEGORY>TYPE_REFERENCE</CATEGORY>
                <SW-DATA-DEF-PROPS>
                  <SW-DATA-DEF-PROPS-VARIANTS>
                    <SW-DATA-DEF-PROPS-CONDITIONAL>
                      <COMPU-METHOD-REF DEST="COMPU-METHOD">/AUTOSAR_Fr/CompuMethods/Fr_POCStateType_Literals</COMPU-METHOD-REF>
                      <IMPLEMENTATION-DATA-TYPE-REF DEST="IMPLEMENTATION-DATA-TYPE">/AUTOSAR_Platform/ImplementationDataTypes/uint32</IMPLEMENTATION-DATA-TYPE-REF>
                    </SW-DATA-DEF-PROPS-CONDITIONAL>
                  </SW-DATA-DEF-PROPS-VARIANTS>
                </SW-DATA-DEF-PROPS>
                <TYPE-EMITTER>BSW</TYPE-EMITTER>
              </IMPLEMENTATION-DATA-TYPE>
              <IMPLEMENTATION-DATA-TYPE>
                <SHORT-NAME>Fr_SlotModeType</SHORT-NAME>
                <CATEGORY>TYPE_REFERENCE</CATEGORY>
                <SW-DATA-DEF-PROPS>
                  <SW-DATA-DEF-PROPS-VARIANTS>
                    <SW-DATA-DEF-PROPS-CONDITIONAL>
                      <COMPU-METHOD-REF DEST="COMPU-METHOD">/AUTOSAR_Fr/CompuMethods/Fr_SlotModeType_Literals</COMPU-METHOD-REF>
                      <IMPLEMENTATION-DATA-TYPE-REF DEST="IMPLEMENTATION-DATA-TYPE">/AUTOSAR_Platform/ImplementationDataTypes/uint32</IMPLEMENTATION-DATA-TYPE-REF>
                    </SW-DATA-DEF-PROPS-CONDITIONAL>
                  </SW-DATA-DEF-PROPS-VARIANTS>
                </SW-DATA-DEF-PROPS>
                <TYPE-EMITTER>BSW</TYPE-EMITTER>
              </IMPLEMENTATION-DATA-TYPE>
              <IMPLEMENTATION-DATA-TYPE>
                <SHORT-NAME>Fr_ErrorModeType</SHORT-NAME>
                <CATEGORY>TYPE_REFERENCE</CATEGORY>
                <SW-DATA-DEF-PROPS>
                  <SW-DATA-DEF-PROPS-VARIANTS>
                    <SW-DATA-DEF-PROPS-CONDITIONAL>
                      <COMPU-METHOD-REF DEST="COMPU-METHOD">/AUTOSAR_Fr/CompuMethods/Fr_ErrorModeType_Literals</COMPU-METHOD-REF>
                      <IMPLEMENTATION-DATA-TYPE-REF DEST="IMPLEMENTATION-DATA-TYPE">/AUTOSAR_Platform/ImplementationDataTypes/uint32</IMPLEMENTATION-DATA-TYPE-REF>
                    </SW-DATA-DEF-PROPS-CONDITIONAL>
                  </SW-DATA-DEF-PROPS-VARIANTS>
                </SW-DATA-DEF-PROPS>
                <TYPE-EMITTER>BSW</TYPE-EMITTER>
              </IMPLEMENTATION-DATA-TYPE>
              <IMPLEMENTATION-DATA-TYPE>
                <SHORT-NAME>Fr_WakeupStatusType</SHORT-NAME>
                <CATEGORY>TYPE_REFERENCE</CATEGORY>
                <SW-DATA-DEF-PROPS>
                  <SW-DATA-DEF-PROPS-VARIANTS>
                    <SW-DATA-DEF-PROPS-CONDITIONAL>
                      <COMPU-METHOD-REF DEST="COMPU-METHOD">/AUTOSAR_Fr/CompuMethods/Fr_WakeupStatusType_Literals</COMPU-METHOD-REF>
                      <IMPLEMENTATION-DATA-TYPE-REF DEST="IMPLEMENTATION-DATA-TYPE">/AUTOSAR_Platform/ImplementationDataTypes/uint32</IMPLEMENTATION-DATA-TYPE-REF>
                    </SW-DATA-DEF-PROPS-CONDITIONAL>
                  </SW-DATA-DEF-PROPS-VARIANTS>
                </SW-DATA-DEF-PROPS>
                <TYPE-EMITTER>BSW</TYPE-EMITTER>
              </IMPLEMENTATION-DATA-TYPE>
              <IMPLEMENTATION-DATA-TYPE>
                <SHORT-NAME>Fr_StartupStateType</SHORT-NAME>
                <CATEGORY>TYPE_REFERENCE</CATEGORY>
                <SW-DATA-DEF-PROPS>
                  <SW-DATA-DEF-PROPS-VARIANTS>
                    <SW-DATA-DEF-PROPS-CONDITIONAL>
                      <COMPU-METHOD-REF DEST="COMPU-METHOD">/AUTOSAR_Fr/CompuMethods/Fr_StartupStateType_Literals</COMPU-METHOD-REF>
                      <IMPLEMENTATION-DATA-TYPE-REF DEST="IMPLEMENTATION-DATA-TYPE">/AUTOSAR_Platform/ImplementationDataTypes/uint32</IMPLEMENTATION-DATA-TYPE-REF>
                    </SW-DATA-DEF-PROPS-CONDITIONAL>
                  </SW-DATA-DEF-PROPS-VARIANTS>
                </SW-DATA-DEF-PROPS>
                <TYPE-EMITTER>BSW</TYPE-EMITTER>
              </IMPLEMENTATION-DATA-TYPE>
              <IMPLEMENTATION-DATA-TYPE>
                <SHORT-NAME>Fr_POCStatusType</SHORT-NAME>
                <CATEGORY>STRUCTURE</CATEGORY>
                      <ADMIN-DATA>
                        <SDGS>
                          <SDG GID="EB:PROVIDING-HEADER-FILE">
                            <SD GID="PROVIDING-HEADER-FILE">Fr_GeneralTypes.h</SD>
                          </SDG>
                        </SDGS>
                      </ADMIN-DATA>
                <SUB-ELEMENTS>
                  <IMPLEMENTATION-DATA-TYPE-ELEMENT>
                    <SHORT-NAME>CHIHaltRequest</SHORT-NAME>
                    <CATEGORY>TYPE_REFERENCE</CATEGORY>
                    <SW-DATA-DEF-PROPS>
                      <SW-DATA-DEF-PROPS-VARIANTS>
                        <SW-DATA-DEF-PROPS-CONDITIONAL>
                          <IMPLEMENTATION-DATA-TYPE-REF DEST="IMPLEMENTATION-DATA-TYPE">/AUTOSAR_Platform/ImplementationDataTypes/boolean</IMPLEMENTATION-DATA-TYPE-REF>
                        </SW-DATA-DEF-PROPS-CONDITIONAL>
                      </SW-DATA-DEF-PROPS-VARIANTS>
                    </SW-DATA-DEF-PROPS>
                  </IMPLEMENTATION-DATA-TYPE-ELEMENT>
                  <IMPLEMENTATION-DATA-TYPE-ELEMENT>
                    <SHORT-NAME>CHIReadyRequest</SHORT-NAME>
                    <CATEGORY>TYPE_REFERENCE</CATEGORY>
                    <SW-DATA-DEF-PROPS>
                      <SW-DATA-DEF-PROPS-VARIANTS>
                        <SW-DATA-DEF-PROPS-CONDITIONAL>
                          <IMPLEMENTATION-DATA-TYPE-REF DEST="IMPLEMENTATION-DATA-TYPE">/AUTOSAR_Platform/ImplementationDataTypes/boolean</IMPLEMENTATION-DATA-TYPE-REF>
                        </SW-DATA-DEF-PROPS-CONDITIONAL>
                      </SW-DATA-DEF-PROPS-VARIANTS>
                    </SW-DATA-DEF-PROPS>
                  </IMPLEMENTATION-DATA-TYPE-ELEMENT>
                  <IMPLEMENTATION-DATA-TYPE-ELEMENT>
                    <SHORT-NAME>ColdstartNoise</SHORT-NAME>
                    <CATEGORY>TYPE_REFERENCE</CATEGORY>
                    <SW-DATA-DEF-PROPS>
                      <SW-DATA-DEF-PROPS-VARIANTS>
                        <SW-DATA-DEF-PROPS-CONDITIONAL>
                          <IMPLEMENTATION-DATA-TYPE-REF DEST="IMPLEMENTATION-DATA-TYPE">/AUTOSAR_Platform/ImplementationDataTypes/boolean</IMPLEMENTATION-DATA-TYPE-REF>
                        </SW-DATA-DEF-PROPS-CONDITIONAL>
                      </SW-DATA-DEF-PROPS-VARIANTS>
                    </SW-DATA-DEF-PROPS>
                  </IMPLEMENTATION-DATA-TYPE-ELEMENT>
                  <IMPLEMENTATION-DATA-TYPE-ELEMENT>
                    <SHORT-NAME>ErrorMode</SHORT-NAME>
                    <CATEGORY>TYPE_REFERENCE</CATEGORY>
                    <SW-DATA-DEF-PROPS>
                      <SW-DATA-DEF-PROPS-VARIANTS>
                        <SW-DATA-DEF-PROPS-CONDITIONAL>
                          <IMPLEMENTATION-DATA-TYPE-REF DEST="IMPLEMENTATION-DATA-TYPE">/AUTOSAR_Fr/ImplementationDataTypes/Fr_ErrorModeType</IMPLEMENTATION-DATA-TYPE-REF>
                        </SW-DATA-DEF-PROPS-CONDITIONAL>
                      </SW-DATA-DEF-PROPS-VARIANTS>
                    </SW-DATA-DEF-PROPS>
                  </IMPLEMENTATION-DATA-TYPE-ELEMENT>
                  <IMPLEMENTATION-DATA-TYPE-ELEMENT>
                    <SHORT-NAME>Freeze</SHORT-NAME>
                    <CATEGORY>TYPE_REFERENCE</CATEGORY>
                    <SW-DATA-DEF-PROPS>
                      <SW-DATA-DEF-PROPS-VARIANTS>
                        <SW-DATA-DEF-PROPS-CONDITIONAL>
                          <IMPLEMENTATION-DATA-TYPE-REF DEST="IMPLEMENTATION-DATA-TYPE">/AUTOSAR_Platform/ImplementationDataTypes/boolean</IMPLEMENTATION-DATA-TYPE-REF>
                        </SW-DATA-DEF-PROPS-CONDITIONAL>
                      </SW-DATA-DEF-PROPS-VARIANTS>
                    </SW-DATA-DEF-PROPS>
                  </IMPLEMENTATION-DATA-TYPE-ELEMENT>
                  <IMPLEMENTATION-DATA-TYPE-ELEMENT>
                    <SHORT-NAME>SlotMode</SHORT-NAME>
                    <CATEGORY>TYPE_REFERENCE</CATEGORY>
                    <SW-DATA-DEF-PROPS>
                      <SW-DATA-DEF-PROPS-VARIANTS>
                        <SW-DATA-DEF-PROPS-CONDITIONAL>
                          <IMPLEMENTATION-DATA-TYPE-REF DEST="IMPLEMENTATION-DATA-TYPE">/AUTOSAR_Fr/ImplementationDataTypes/Fr_SlotModeType</IMPLEMENTATION-DATA-TYPE-REF>
                        </SW-DATA-DEF-PROPS-CONDITIONAL>
                      </SW-DATA-DEF-PROPS-VARIANTS>
                    </SW-DATA-DEF-PROPS>
                  </IMPLEMENTATION-DATA-TYPE-ELEMENT>
                  <IMPLEMENTATION-DATA-TYPE-ELEMENT>
                    <SHORT-NAME>StartupState</SHORT-NAME>
                    <CATEGORY>TYPE_REFERENCE</CATEGORY>
                    <SW-DATA-DEF-PROPS>
                      <SW-DATA-DEF-PROPS-VARIANTS>
                        <SW-DATA-DEF-PROPS-CONDITIONAL>
                          <IMPLEMENTATION-DATA-TYPE-REF DEST="IMPLEMENTATION-DATA-TYPE">/AUTOSAR_Fr/ImplementationDataTypes/Fr_StartupStateType</IMPLEMENTATION-DATA-TYPE-REF>
                        </SW-DATA-DEF-PROPS-CONDITIONAL>
                      </SW-DATA-DEF-PROPS-VARIANTS>
                    </SW-DATA-DEF-PROPS>
                  </IMPLEMENTATION-DATA-TYPE-ELEMENT>
                  <IMPLEMENTATION-DATA-TYPE-ELEMENT>
                    <SHORT-NAME>State</SHORT-NAME>
                    <CATEGORY>TYPE_REFERENCE</CATEGORY>
                    <SW-DATA-DEF-PROPS>
                      <SW-DATA-DEF-PROPS-VARIANTS>
                        <SW-DATA-DEF-PROPS-CONDITIONAL>
                          <IMPLEMENTATION-DATA-TYPE-REF DEST="IMPLEMENTATION-DATA-TYPE">/AUTOSAR_Fr/ImplementationDataTypes/Fr_POCStateType</IMPLEMENTATION-DATA-TYPE-REF>
                        </SW-DATA-DEF-PROPS-CONDITIONAL>
                      </SW-DATA-DEF-PROPS-VARIANTS>
                    </SW-DATA-DEF-PROPS>
                  </IMPLEMENTATION-DATA-TYPE-ELEMENT>
                  <IMPLEMENTATION-DATA-TYPE-ELEMENT>
                    <SHORT-NAME>WakeupStatus</SHORT-NAME>
                    <CATEGORY>TYPE_REFERENCE</CATEGORY>
                    <SW-DATA-DEF-PROPS>
                      <SW-DATA-DEF-PROPS-VARIANTS>
                        <SW-DATA-DEF-PROPS-CONDITIONAL>
                          <IMPLEMENTATION-DATA-TYPE-REF DEST="IMPLEMENTATION-DATA-TYPE">/AUTOSAR_Fr/ImplementationDataTypes/Fr_WakeupStatusType</IMPLEMENTATION-DATA-TYPE-REF>
                        </SW-DATA-DEF-PROPS-CONDITIONAL>
                      </SW-DATA-DEF-PROPS-VARIANTS>
                    </SW-DATA-DEF-PROPS>
                  </IMPLEMENTATION-DATA-TYPE-ELEMENT>
                </SUB-ELEMENTS>
                <TYPE-EMITTER>BSW</TYPE-EMITTER>
              </IMPLEMENTATION-DATA-TYPE>
              <IMPLEMENTATION-DATA-TYPE>
                <SHORT-NAME>Fr_TxLPduStatusType</SHORT-NAME>
                <CATEGORY>TYPE_REFERENCE</CATEGORY>
                <SW-DATA-DEF-PROPS>
                  <SW-DATA-DEF-PROPS-VARIANTS>
                    <SW-DATA-DEF-PROPS-CONDITIONAL>
                      <COMPU-METHOD-REF DEST="COMPU-METHOD">/AUTOSAR_Fr/CompuMethods/Fr_TxLPduStatusType_Literals</COMPU-METHOD-REF>
                      <IMPLEMENTATION-DATA-TYPE-REF DEST="IMPLEMENTATION-DATA-TYPE">/AUTOSAR_Platform/ImplementationDataTypes/uint32</IMPLEMENTATION-DATA-TYPE-REF>
                    </SW-DATA-DEF-PROPS-CONDITIONAL>
                  </SW-DATA-DEF-PROPS-VARIANTS>
                </SW-DATA-DEF-PROPS>
                <TYPE-EMITTER>BSW</TYPE-EMITTER>
              </IMPLEMENTATION-DATA-TYPE>
              <IMPLEMENTATION-DATA-TYPE>
                <SHORT-NAME>Fr_RxLPduStatusType</SHORT-NAME>
                <CATEGORY>TYPE_REFERENCE</CATEGORY>
                <SW-DATA-DEF-PROPS>
                  <SW-DATA-DEF-PROPS-VARIANTS>
                    <SW-DATA-DEF-PROPS-CONDITIONAL>
                      <COMPU-METHOD-REF DEST="COMPU-METHOD">/AUTOSAR_Fr/CompuMethods/Fr_RxLPduStatusType_Literals</COMPU-METHOD-REF>
                      <IMPLEMENTATION-DATA-TYPE-REF DEST="IMPLEMENTATION-DATA-TYPE">/AUTOSAR_Platform/ImplementationDataTypes/uint32</IMPLEMENTATION-DATA-TYPE-REF>
                    </SW-DATA-DEF-PROPS-CONDITIONAL>
                  </SW-DATA-DEF-PROPS-VARIANTS>
                </SW-DATA-DEF-PROPS>
                <TYPE-EMITTER>BSW</TYPE-EMITTER>
              </IMPLEMENTATION-DATA-TYPE>
              <IMPLEMENTATION-DATA-TYPE>
                <SHORT-NAME>Fr_MTSStatusType</SHORT-NAME>
                <CATEGORY>TYPE_REFERENCE</CATEGORY>
                <SW-DATA-DEF-PROPS>
                  <SW-DATA-DEF-PROPS-VARIANTS>
                    <SW-DATA-DEF-PROPS-CONDITIONAL>
                      <COMPU-METHOD-REF DEST="COMPU-METHOD">/AUTOSAR_Fr/CompuMethods/Fr_MTSStatusType_Literals</COMPU-METHOD-REF>
                      <IMPLEMENTATION-DATA-TYPE-REF DEST="IMPLEMENTATION-DATA-TYPE">/AUTOSAR_Platform/ImplementationDataTypes/uint32</IMPLEMENTATION-DATA-TYPE-REF>
                    </SW-DATA-DEF-PROPS-CONDITIONAL>
                  </SW-DATA-DEF-PROPS-VARIANTS>
                </SW-DATA-DEF-PROPS>
                <TYPE-EMITTER>BSW</TYPE-EMITTER>
              </IMPLEMENTATION-DATA-TYPE>
              <IMPLEMENTATION-DATA-TYPE>
                <SHORT-NAME>Fr_ChannelType</SHORT-NAME>
                <CATEGORY>TYPE_REFERENCE</CATEGORY>
                <SW-DATA-DEF-PROPS>
                  <SW-DATA-DEF-PROPS-VARIANTS>
                    <SW-DATA-DEF-PROPS-CONDITIONAL>
                      <COMPU-METHOD-REF DEST="COMPU-METHOD">/AUTOSAR_Fr/CompuMethods/Fr_ChannelType_Literals</COMPU-METHOD-REF>
                      <IMPLEMENTATION-DATA-TYPE-REF DEST="IMPLEMENTATION-DATA-TYPE">/AUTOSAR_Platform/ImplementationDataTypes/uint32</IMPLEMENTATION-DATA-TYPE-REF>
                    </SW-DATA-DEF-PROPS-CONDITIONAL>
                  </SW-DATA-DEF-PROPS-VARIANTS>
                </SW-DATA-DEF-PROPS>
                <TYPE-EMITTER>BSW</TYPE-EMITTER>
              </IMPLEMENTATION-DATA-TYPE>
            </ELEMENTS>
[!ENDMACRO!][!/*


* GenerateFrTrcvImplementationTypes
*   Generates the implementation types of the FrTrcv package
*
*   Parameters:
*     None.
*
*/!][!MACRO "GenerateFrTrcvImplementationTypes"!]
            <SHORT-NAME>ImplementationDataTypes</SHORT-NAME>
            <CATEGORY>STANDARD</CATEGORY>
            <ELEMENTS>
              <IMPLEMENTATION-DATA-TYPE>
                <SHORT-NAME>FrTrcv_TrcvModeType</SHORT-NAME>
                <CATEGORY>TYPE_REFERENCE</CATEGORY>
                <SW-DATA-DEF-PROPS>
                  <SW-DATA-DEF-PROPS-VARIANTS>
                    <SW-DATA-DEF-PROPS-CONDITIONAL>
                      <COMPU-METHOD-REF DEST="COMPU-METHOD">/AUTOSAR_FrTrcv/CompuMethods/FrTrcv_TrcvModeType_Literals</COMPU-METHOD-REF>
                      <IMPLEMENTATION-DATA-TYPE-REF DEST="IMPLEMENTATION-DATA-TYPE">/AUTOSAR_Platform/ImplementationDataTypes/uint32</IMPLEMENTATION-DATA-TYPE-REF>
                    </SW-DATA-DEF-PROPS-CONDITIONAL>
                  </SW-DATA-DEF-PROPS-VARIANTS>
                </SW-DATA-DEF-PROPS>
                <TYPE-EMITTER>BSW</TYPE-EMITTER>
              </IMPLEMENTATION-DATA-TYPE>
              <IMPLEMENTATION-DATA-TYPE>
                <SHORT-NAME>FrTrcv_TrcvWUReasonType</SHORT-NAME>
                <CATEGORY>TYPE_REFERENCE</CATEGORY>
                <SW-DATA-DEF-PROPS>
                  <SW-DATA-DEF-PROPS-VARIANTS>
                    <SW-DATA-DEF-PROPS-CONDITIONAL>
                      <COMPU-METHOD-REF DEST="COMPU-METHOD">/AUTOSAR_FrTrcv/CompuMethods/FrTrcv_TrcvWUReasonType_Literals</COMPU-METHOD-REF>
                      <IMPLEMENTATION-DATA-TYPE-REF DEST="IMPLEMENTATION-DATA-TYPE">/AUTOSAR_Platform/ImplementationDataTypes/uint32</IMPLEMENTATION-DATA-TYPE-REF>
                    </SW-DATA-DEF-PROPS-CONDITIONAL>
                  </SW-DATA-DEF-PROPS-VARIANTS>
                </SW-DATA-DEF-PROPS>
                <TYPE-EMITTER>BSW</TYPE-EMITTER>
              </IMPLEMENTATION-DATA-TYPE>
            </ELEMENTS>
[!ENDMACRO!][!/*


* GenerateCanImplementationTypes
*   Generates the implementation types of the Can package
*
*   Parameters:
*     None.
*
*/!][!MACRO "GenerateCanImplementationTypes"!]
            <SHORT-NAME>ImplementationDataTypes</SHORT-NAME>
            <CATEGORY>STANDARD</CATEGORY>
            <ELEMENTS>
              <IMPLEMENTATION-DATA-TYPE>
                <SHORT-NAME>Can_IdType</SHORT-NAME>
                <CATEGORY>TYPE_REFERENCE</CATEGORY>
                <SW-DATA-DEF-PROPS>
                  <SW-DATA-DEF-PROPS-VARIANTS>
                    <SW-DATA-DEF-PROPS-CONDITIONAL>
[!IF "node:exists(as:modconf('CanIf')[1]/CanIfPublicCfg/CanIfPublicCanIdTypeEnum) and (as:modconf('CanIf')[1]/CanIfPublicCfg/CanIfPublicCanIdTypeEnum = 'UINT16')"!]
                      <IMPLEMENTATION-DATA-TYPE-REF DEST="IMPLEMENTATION-DATA-TYPE">/AUTOSAR_Platform/ImplementationDataTypes/uint16</IMPLEMENTATION-DATA-TYPE-REF>
[!ELSE!]
                      <IMPLEMENTATION-DATA-TYPE-REF DEST="IMPLEMENTATION-DATA-TYPE">/AUTOSAR_Platform/ImplementationDataTypes/uint32</IMPLEMENTATION-DATA-TYPE-REF>
[!ENDIF!]
                    </SW-DATA-DEF-PROPS-CONDITIONAL>
                  </SW-DATA-DEF-PROPS-VARIANTS>
                </SW-DATA-DEF-PROPS>
                <TYPE-EMITTER>BSW</TYPE-EMITTER>
              </IMPLEMENTATION-DATA-TYPE>
              <IMPLEMENTATION-DATA-TYPE>
                <SHORT-NAME>Can_HwHandleType</SHORT-NAME>
                <CATEGORY>TYPE_REFERENCE</CATEGORY>
                <SW-DATA-DEF-PROPS>
                  <SW-DATA-DEF-PROPS-VARIANTS>
                    <SW-DATA-DEF-PROPS-CONDITIONAL>
[!IF "node:exists(as:modconf('CanIf')[1]/CanIfPublicCfg/CanIfPublicHandleTypeEnum) and (as:modconf('CanIf')[1]/CanIfPublicCfg/CanIfPublicHandleTypeEnum = 'UINT16')"!]
                      <IMPLEMENTATION-DATA-TYPE-REF DEST="IMPLEMENTATION-DATA-TYPE">/AUTOSAR_Platform/ImplementationDataTypes/uint16</IMPLEMENTATION-DATA-TYPE-REF>
[!ELSE!]
                      <IMPLEMENTATION-DATA-TYPE-REF DEST="IMPLEMENTATION-DATA-TYPE">/AUTOSAR_Platform/ImplementationDataTypes/uint8</IMPLEMENTATION-DATA-TYPE-REF>
[!ENDIF!]
                    </SW-DATA-DEF-PROPS-CONDITIONAL>
                  </SW-DATA-DEF-PROPS-VARIANTS>
                </SW-DATA-DEF-PROPS>
                <TYPE-EMITTER>BSW</TYPE-EMITTER>
              </IMPLEMENTATION-DATA-TYPE>
              <IMPLEMENTATION-DATA-TYPE>
                <SHORT-NAME>Can_PduType</SHORT-NAME>
                <CATEGORY>STRUCTURE</CATEGORY>
                <SUB-ELEMENTS>
                  <IMPLEMENTATION-DATA-TYPE-ELEMENT>
                    <SHORT-NAME>id</SHORT-NAME>
                    <CATEGORY>TYPE_REFERENCE</CATEGORY>
                    <SW-DATA-DEF-PROPS>
                      <SW-DATA-DEF-PROPS-VARIANTS>
                        <SW-DATA-DEF-PROPS-CONDITIONAL>
                          <IMPLEMENTATION-DATA-TYPE-REF DEST="IMPLEMENTATION-DATA-TYPE">/AUTOSAR_Can/ImplementationDataTypes/Can_IdType</IMPLEMENTATION-DATA-TYPE-REF>
                        </SW-DATA-DEF-PROPS-CONDITIONAL>
                      </SW-DATA-DEF-PROPS-VARIANTS>
                    </SW-DATA-DEF-PROPS>
                  </IMPLEMENTATION-DATA-TYPE-ELEMENT>
                  <IMPLEMENTATION-DATA-TYPE-ELEMENT>
                    <SHORT-NAME>length</SHORT-NAME>
                    <CATEGORY>TYPE_REFERENCE</CATEGORY>
                    <SW-DATA-DEF-PROPS>
                      <SW-DATA-DEF-PROPS-VARIANTS>
                        <SW-DATA-DEF-PROPS-CONDITIONAL>
                          <IMPLEMENTATION-DATA-TYPE-REF DEST="IMPLEMENTATION-DATA-TYPE">/AUTOSAR_Platform/ImplementationDataTypes/uint8</IMPLEMENTATION-DATA-TYPE-REF>
                        </SW-DATA-DEF-PROPS-CONDITIONAL>
                      </SW-DATA-DEF-PROPS-VARIANTS>
                    </SW-DATA-DEF-PROPS>
                  </IMPLEMENTATION-DATA-TYPE-ELEMENT>
                  <IMPLEMENTATION-DATA-TYPE-ELEMENT>
                    <SHORT-NAME>sdu</SHORT-NAME>
                    <CATEGORY>DATA_REFERENCE</CATEGORY>
                    <SW-DATA-DEF-PROPS>
                      <SW-DATA-DEF-PROPS-VARIANTS>
                        <SW-DATA-DEF-PROPS-CONDITIONAL>
                          <SW-POINTER-TARGET-PROPS>
                            <TARGET-CATEGORY>TYPE_REFERENCE</TARGET-CATEGORY>
                            <SW-DATA-DEF-PROPS>
                              <SW-DATA-DEF-PROPS-VARIANTS>
                                <SW-DATA-DEF-PROPS-CONDITIONAL>
                                  <IMPLEMENTATION-DATA-TYPE-REF DEST="IMPLEMENTATION-DATA-TYPE">/AUTOSAR_Platform/ImplementationDataTypes/uint8</IMPLEMENTATION-DATA-TYPE-REF>
                                </SW-DATA-DEF-PROPS-CONDITIONAL>
                              </SW-DATA-DEF-PROPS-VARIANTS>
                            </SW-DATA-DEF-PROPS>
                          </SW-POINTER-TARGET-PROPS>
                        </SW-DATA-DEF-PROPS-CONDITIONAL>
                      </SW-DATA-DEF-PROPS-VARIANTS>
                    </SW-DATA-DEF-PROPS>
                  </IMPLEMENTATION-DATA-TYPE-ELEMENT>
                  <IMPLEMENTATION-DATA-TYPE-ELEMENT>
                    <SHORT-NAME>swPduHandle</SHORT-NAME>
                    <CATEGORY>TYPE_REFERENCE</CATEGORY>
                    <SW-DATA-DEF-PROPS>
                      <SW-DATA-DEF-PROPS-VARIANTS>
                        <SW-DATA-DEF-PROPS-CONDITIONAL>
                          <IMPLEMENTATION-DATA-TYPE-REF DEST="IMPLEMENTATION-DATA-TYPE">/AUTOSAR_Comtype/ImplementationDataTypes/PduIdType</IMPLEMENTATION-DATA-TYPE-REF>
                        </SW-DATA-DEF-PROPS-CONDITIONAL>
                      </SW-DATA-DEF-PROPS-VARIANTS>
                    </SW-DATA-DEF-PROPS>
                  </IMPLEMENTATION-DATA-TYPE-ELEMENT>
                </SUB-ELEMENTS>
                <TYPE-EMITTER>BSW</TYPE-EMITTER>
              </IMPLEMENTATION-DATA-TYPE>
              <IMPLEMENTATION-DATA-TYPE>
                <SHORT-NAME>Can_StateTransitionType</SHORT-NAME>
                <CATEGORY>TYPE_REFERENCE</CATEGORY>
                <SW-DATA-DEF-PROPS>
                  <SW-DATA-DEF-PROPS-VARIANTS>
                    <SW-DATA-DEF-PROPS-CONDITIONAL>
                      <COMPU-METHOD-REF DEST="COMPU-METHOD">/AUTOSAR_Can/CompuMethods/Can_StateTransitionType_Literals</COMPU-METHOD-REF>
                      <IMPLEMENTATION-DATA-TYPE-REF DEST="IMPLEMENTATION-DATA-TYPE">/AUTOSAR_Platform/ImplementationDataTypes/uint32</IMPLEMENTATION-DATA-TYPE-REF>
                    </SW-DATA-DEF-PROPS-CONDITIONAL>
                  </SW-DATA-DEF-PROPS-VARIANTS>
                </SW-DATA-DEF-PROPS>
                <TYPE-EMITTER>BSW</TYPE-EMITTER>
              </IMPLEMENTATION-DATA-TYPE>
              <IMPLEMENTATION-DATA-TYPE>
                <SHORT-NAME>Can_ReturnType</SHORT-NAME>
                <CATEGORY>TYPE_REFERENCE</CATEGORY>
                <SW-DATA-DEF-PROPS>
                  <SW-DATA-DEF-PROPS-VARIANTS>
                    <SW-DATA-DEF-PROPS-CONDITIONAL>
                      <COMPU-METHOD-REF DEST="COMPU-METHOD">/AUTOSAR_Can/CompuMethods/Can_ReturnType_Literals</COMPU-METHOD-REF>
                      <IMPLEMENTATION-DATA-TYPE-REF DEST="IMPLEMENTATION-DATA-TYPE">/AUTOSAR_Platform/ImplementationDataTypes/uint32</IMPLEMENTATION-DATA-TYPE-REF>
                    </SW-DATA-DEF-PROPS-CONDITIONAL>
                  </SW-DATA-DEF-PROPS-VARIANTS>
                </SW-DATA-DEF-PROPS>
                <TYPE-EMITTER>BSW</TYPE-EMITTER>
              </IMPLEMENTATION-DATA-TYPE>
              <IMPLEMENTATION-DATA-TYPE>
                <SHORT-NAME>Can_ErrorStateType</SHORT-NAME>
                <CATEGORY>TYPE_REFERENCE</CATEGORY>
                <ADMIN-DATA>
                  <SDGS>
                    <SDG GID="EB:PROVIDING-HEADER-FILE">
                      <SD GID="PROVIDING-HEADER-FILE">Can_GeneralTypes.h</SD>
                    </SDG>
                  </SDGS>
                </ADMIN-DATA>
                <SW-DATA-DEF-PROPS>
                  <SW-DATA-DEF-PROPS-VARIANTS>
                    <SW-DATA-DEF-PROPS-CONDITIONAL>
                      <COMPU-METHOD-REF DEST="COMPU-METHOD">/AUTOSAR_Can/CompuMethods/Can_ErrorStateType</COMPU-METHOD-REF>
                      <IMPLEMENTATION-DATA-TYPE-REF DEST="IMPLEMENTATION-DATA-TYPE">/AUTOSAR_Platform/ImplementationDataTypes/uint32</IMPLEMENTATION-DATA-TYPE-REF>
                    </SW-DATA-DEF-PROPS-CONDITIONAL>
                  </SW-DATA-DEF-PROPS-VARIANTS>
                </SW-DATA-DEF-PROPS>
                <TYPE-EMITTER>BSW</TYPE-EMITTER>
              </IMPLEMENTATION-DATA-TYPE>
[!IF "node:value(as:modconf('Base')[1]/GeneralTypes/GeneralTypes_Can_ControllerStateType) = 'true'"!]
              <IMPLEMENTATION-DATA-TYPE>
                <SHORT-NAME>Can_ControllerStateType</SHORT-NAME>
                <CATEGORY>TYPE_REFERENCE</CATEGORY>
                <ADMIN-DATA>
                  <SDGS>
                    <SDG GID="EB:PROVIDING-HEADER-FILE">
                      <SD GID="PROVIDING-HEADER-FILE">Can_GeneralTypes.h</SD>
                    </SDG>
                  </SDGS>
                </ADMIN-DATA>
                <SW-DATA-DEF-PROPS>
                  <SW-DATA-DEF-PROPS-VARIANTS>
                    <SW-DATA-DEF-PROPS-CONDITIONAL>
                      <COMPU-METHOD-REF DEST="COMPU-METHOD">/AUTOSAR_Can/CompuMethods/Can_ControllerStateType</COMPU-METHOD-REF>
                      <IMPLEMENTATION-DATA-TYPE-REF DEST="IMPLEMENTATION-DATA-TYPE">/AUTOSAR_Platform/ImplementationDataTypes/uint32</IMPLEMENTATION-DATA-TYPE-REF>
                    </SW-DATA-DEF-PROPS-CONDITIONAL>
                  </SW-DATA-DEF-PROPS-VARIANTS>
                </SW-DATA-DEF-PROPS>
                <TYPE-EMITTER>BSW</TYPE-EMITTER>
              </IMPLEMENTATION-DATA-TYPE>
[!ENDIF!]
            </ELEMENTS>
[!ENDMACRO!][!/*


* GenerateCanTrcvImplementationTypes
*   Generates the implementation types of the CanTrcv package
*
*   Parameters:
*     None.
*
*/!][!MACRO "GenerateCanTrcvImplementationTypes"!]
            <SHORT-NAME>ImplementationDataTypes</SHORT-NAME>
            <CATEGORY>STANDARD</CATEGORY>
            <ELEMENTS>
              <IMPLEMENTATION-DATA-TYPE>
                <SHORT-NAME>CanTrcv_TrcvModeType</SHORT-NAME>
                <CATEGORY>TYPE_REFERENCE</CATEGORY>
                <SW-DATA-DEF-PROPS>
                  <SW-DATA-DEF-PROPS-VARIANTS>
                    <SW-DATA-DEF-PROPS-CONDITIONAL>
                      <COMPU-METHOD-REF DEST="COMPU-METHOD">/AUTOSAR_CanTrcv/CompuMethods/CanTrcv_TrcvModeType_Literals</COMPU-METHOD-REF>
                      <IMPLEMENTATION-DATA-TYPE-REF DEST="IMPLEMENTATION-DATA-TYPE">/AUTOSAR_Platform/ImplementationDataTypes/uint32</IMPLEMENTATION-DATA-TYPE-REF>
                    </SW-DATA-DEF-PROPS-CONDITIONAL>
                  </SW-DATA-DEF-PROPS-VARIANTS>
                </SW-DATA-DEF-PROPS>
                <TYPE-EMITTER>BSW</TYPE-EMITTER>
              </IMPLEMENTATION-DATA-TYPE>
              <IMPLEMENTATION-DATA-TYPE>
                <SHORT-NAME>CanTrcv_TrcvWakeupReasonType</SHORT-NAME>
                <CATEGORY>TYPE_REFERENCE</CATEGORY>
                <SW-DATA-DEF-PROPS>
                  <SW-DATA-DEF-PROPS-VARIANTS>
                    <SW-DATA-DEF-PROPS-CONDITIONAL>
                      <COMPU-METHOD-REF DEST="COMPU-METHOD">/AUTOSAR_CanTrcv/CompuMethods/CanTrcv_TrcvWakeupReasonType_Literals</COMPU-METHOD-REF>
                      <IMPLEMENTATION-DATA-TYPE-REF DEST="IMPLEMENTATION-DATA-TYPE">/AUTOSAR_Platform/ImplementationDataTypes/uint32</IMPLEMENTATION-DATA-TYPE-REF>
                    </SW-DATA-DEF-PROPS-CONDITIONAL>
                  </SW-DATA-DEF-PROPS-VARIANTS>
                </SW-DATA-DEF-PROPS>
                <TYPE-EMITTER>BSW</TYPE-EMITTER>
              </IMPLEMENTATION-DATA-TYPE>
              <IMPLEMENTATION-DATA-TYPE>
                <SHORT-NAME>CanTrcv_TrcvWakeupModeType</SHORT-NAME>
                <CATEGORY>TYPE_REFERENCE</CATEGORY>
                <SW-DATA-DEF-PROPS>
                  <SW-DATA-DEF-PROPS-VARIANTS>
                    <SW-DATA-DEF-PROPS-CONDITIONAL>
                      <COMPU-METHOD-REF DEST="COMPU-METHOD">/AUTOSAR_CanTrcv/CompuMethods/CanTrcv_TrcvWakeupModeType_Literals</COMPU-METHOD-REF>
                      <IMPLEMENTATION-DATA-TYPE-REF DEST="IMPLEMENTATION-DATA-TYPE">/AUTOSAR_Platform/ImplementationDataTypes/uint32</IMPLEMENTATION-DATA-TYPE-REF>
                    </SW-DATA-DEF-PROPS-CONDITIONAL>
                  </SW-DATA-DEF-PROPS-VARIANTS>
                </SW-DATA-DEF-PROPS>
                <TYPE-EMITTER>BSW</TYPE-EMITTER>
              </IMPLEMENTATION-DATA-TYPE>
              <IMPLEMENTATION-DATA-TYPE>
                <SHORT-NAME>CanTrcv_PNActivationType</SHORT-NAME>
                <CATEGORY>TYPE_REFERENCE</CATEGORY>
                <SW-DATA-DEF-PROPS>
                  <SW-DATA-DEF-PROPS-VARIANTS>
                    <SW-DATA-DEF-PROPS-CONDITIONAL>
                      <COMPU-METHOD-REF DEST="COMPU-METHOD">/AUTOSAR_CanTrcv/CompuMethods/CanTrcv_PNActivationType_Literals</COMPU-METHOD-REF>
                      <IMPLEMENTATION-DATA-TYPE-REF DEST="IMPLEMENTATION-DATA-TYPE">/AUTOSAR_Platform/ImplementationDataTypes/uint32</IMPLEMENTATION-DATA-TYPE-REF>
                    </SW-DATA-DEF-PROPS-CONDITIONAL>
                  </SW-DATA-DEF-PROPS-VARIANTS>
                </SW-DATA-DEF-PROPS>
                <TYPE-EMITTER>BSW</TYPE-EMITTER>
              </IMPLEMENTATION-DATA-TYPE>
              <IMPLEMENTATION-DATA-TYPE>
                <SHORT-NAME>CanTrcv_TrcvFlagStateType</SHORT-NAME>
                <CATEGORY>TYPE_REFERENCE</CATEGORY>
                <SW-DATA-DEF-PROPS>
                  <SW-DATA-DEF-PROPS-VARIANTS>
                    <SW-DATA-DEF-PROPS-CONDITIONAL>
                      <COMPU-METHOD-REF DEST="COMPU-METHOD">/AUTOSAR_CanTrcv/CompuMethods/CanTrcv_TrcvFlagStateType_Literals</COMPU-METHOD-REF>
                      <IMPLEMENTATION-DATA-TYPE-REF DEST="IMPLEMENTATION-DATA-TYPE">/AUTOSAR_Platform/ImplementationDataTypes/uint32</IMPLEMENTATION-DATA-TYPE-REF>
                    </SW-DATA-DEF-PROPS-CONDITIONAL>
                  </SW-DATA-DEF-PROPS-VARIANTS>
                </SW-DATA-DEF-PROPS>
                <TYPE-EMITTER>BSW</TYPE-EMITTER>
              </IMPLEMENTATION-DATA-TYPE>
            </ELEMENTS>
[!ENDMACRO!][!/*

* GenerateLinImplementationTypes
*   Generates the implementation types of the Lin package
*
*   Parameters:
*     None.
*
*/!][!MACRO "GenerateLinImplementationTypes"!]
            <SHORT-NAME>ImplementationDataTypes</SHORT-NAME>
            <CATEGORY>STANDARD</CATEGORY>
            <ELEMENTS>
              <IMPLEMENTATION-DATA-TYPE>
                <SHORT-NAME>Lin_FramePidType</SHORT-NAME>
                <CATEGORY>TYPE_REFERENCE</CATEGORY>
                <SW-DATA-DEF-PROPS>
                  <SW-DATA-DEF-PROPS-VARIANTS>
                    <SW-DATA-DEF-PROPS-CONDITIONAL>
                      <IMPLEMENTATION-DATA-TYPE-REF DEST="IMPLEMENTATION-DATA-TYPE">/AUTOSAR_Platform/ImplementationDataTypes/uint8</IMPLEMENTATION-DATA-TYPE-REF>
                    </SW-DATA-DEF-PROPS-CONDITIONAL>
                  </SW-DATA-DEF-PROPS-VARIANTS>
                </SW-DATA-DEF-PROPS>
                <TYPE-EMITTER>BSW</TYPE-EMITTER>
              </IMPLEMENTATION-DATA-TYPE>
              <IMPLEMENTATION-DATA-TYPE>
                <SHORT-NAME>Lin_FrameCsModelType</SHORT-NAME>
                <CATEGORY>TYPE_REFERENCE</CATEGORY>
                <SW-DATA-DEF-PROPS>
                  <SW-DATA-DEF-PROPS-VARIANTS>
                    <SW-DATA-DEF-PROPS-CONDITIONAL>
                      <COMPU-METHOD-REF DEST="COMPU-METHOD">/AUTOSAR_Lin/CompuMethods/Lin_FrameCsModelType_Literals</COMPU-METHOD-REF>
                      <IMPLEMENTATION-DATA-TYPE-REF DEST="IMPLEMENTATION-DATA-TYPE">/AUTOSAR_Platform/ImplementationDataTypes/uint32</IMPLEMENTATION-DATA-TYPE-REF>
                    </SW-DATA-DEF-PROPS-CONDITIONAL>
                  </SW-DATA-DEF-PROPS-VARIANTS>
                </SW-DATA-DEF-PROPS>
                <TYPE-EMITTER>BSW</TYPE-EMITTER>
              </IMPLEMENTATION-DATA-TYPE>
              <IMPLEMENTATION-DATA-TYPE>
                <SHORT-NAME>Lin_FrameResponseType</SHORT-NAME>
                <CATEGORY>TYPE_REFERENCE</CATEGORY>
                <SW-DATA-DEF-PROPS>
                  <SW-DATA-DEF-PROPS-VARIANTS>
                    <SW-DATA-DEF-PROPS-CONDITIONAL>
                      <COMPU-METHOD-REF DEST="COMPU-METHOD">/AUTOSAR_Lin/CompuMethods/Lin_FrameResponseType_Literals</COMPU-METHOD-REF>
                      <IMPLEMENTATION-DATA-TYPE-REF DEST="IMPLEMENTATION-DATA-TYPE">/AUTOSAR_Platform/ImplementationDataTypes/uint32</IMPLEMENTATION-DATA-TYPE-REF>
                    </SW-DATA-DEF-PROPS-CONDITIONAL>
                  </SW-DATA-DEF-PROPS-VARIANTS>
                </SW-DATA-DEF-PROPS>
                <TYPE-EMITTER>BSW</TYPE-EMITTER>
              </IMPLEMENTATION-DATA-TYPE>
              <IMPLEMENTATION-DATA-TYPE>
                <SHORT-NAME>Lin_FrameDlType</SHORT-NAME>
                <CATEGORY>TYPE_REFERENCE</CATEGORY>
                <SW-DATA-DEF-PROPS>
                  <SW-DATA-DEF-PROPS-VARIANTS>
                    <SW-DATA-DEF-PROPS-CONDITIONAL>
                      <IMPLEMENTATION-DATA-TYPE-REF DEST="IMPLEMENTATION-DATA-TYPE">/AUTOSAR_Platform/ImplementationDataTypes/uint8</IMPLEMENTATION-DATA-TYPE-REF>
                    </SW-DATA-DEF-PROPS-CONDITIONAL>
                  </SW-DATA-DEF-PROPS-VARIANTS>
                </SW-DATA-DEF-PROPS>
                <TYPE-EMITTER>BSW</TYPE-EMITTER>
              </IMPLEMENTATION-DATA-TYPE>
              <IMPLEMENTATION-DATA-TYPE>
                <SHORT-NAME>Lin_PduType</SHORT-NAME>
                <CATEGORY>STRUCTURE</CATEGORY>
                <SUB-ELEMENTS>
                  <IMPLEMENTATION-DATA-TYPE-ELEMENT>
                    <SHORT-NAME>Pid</SHORT-NAME>
                    <CATEGORY>TYPE_REFERENCE</CATEGORY>
                    <SW-DATA-DEF-PROPS>
                      <SW-DATA-DEF-PROPS-VARIANTS>
                        <SW-DATA-DEF-PROPS-CONDITIONAL>
                          <IMPLEMENTATION-DATA-TYPE-REF DEST="IMPLEMENTATION-DATA-TYPE">/AUTOSAR_Lin/ImplementationDataTypes/Lin_FramePidType</IMPLEMENTATION-DATA-TYPE-REF>
                        </SW-DATA-DEF-PROPS-CONDITIONAL>
                      </SW-DATA-DEF-PROPS-VARIANTS>
                    </SW-DATA-DEF-PROPS>
                  </IMPLEMENTATION-DATA-TYPE-ELEMENT>
                  <IMPLEMENTATION-DATA-TYPE-ELEMENT>
                    <SHORT-NAME>Cs</SHORT-NAME>
                    <CATEGORY>TYPE_REFERENCE</CATEGORY>
                    <SW-DATA-DEF-PROPS>
                      <SW-DATA-DEF-PROPS-VARIANTS>
                        <SW-DATA-DEF-PROPS-CONDITIONAL>
                          <IMPLEMENTATION-DATA-TYPE-REF DEST="IMPLEMENTATION-DATA-TYPE">/AUTOSAR_Lin/ImplementationDataTypes/Lin_FrameCsModelType</IMPLEMENTATION-DATA-TYPE-REF>
                        </SW-DATA-DEF-PROPS-CONDITIONAL>
                      </SW-DATA-DEF-PROPS-VARIANTS>
                    </SW-DATA-DEF-PROPS>
                  </IMPLEMENTATION-DATA-TYPE-ELEMENT>
                  <IMPLEMENTATION-DATA-TYPE-ELEMENT>
                    <SHORT-NAME>Drc</SHORT-NAME>
                    <CATEGORY>TYPE_REFERENCE</CATEGORY>
                    <SW-DATA-DEF-PROPS>
                      <SW-DATA-DEF-PROPS-VARIANTS>
                        <SW-DATA-DEF-PROPS-CONDITIONAL>
                          <IMPLEMENTATION-DATA-TYPE-REF DEST="IMPLEMENTATION-DATA-TYPE">/AUTOSAR_Lin/ImplementationDataTypes/Lin_FrameResponseType</IMPLEMENTATION-DATA-TYPE-REF>
                        </SW-DATA-DEF-PROPS-CONDITIONAL>
                      </SW-DATA-DEF-PROPS-VARIANTS>
                    </SW-DATA-DEF-PROPS>
                  </IMPLEMENTATION-DATA-TYPE-ELEMENT>
                  <IMPLEMENTATION-DATA-TYPE-ELEMENT>
                    <SHORT-NAME>Dl</SHORT-NAME>
                    <CATEGORY>TYPE_REFERENCE</CATEGORY>
                    <SW-DATA-DEF-PROPS>
                      <SW-DATA-DEF-PROPS-VARIANTS>
                        <SW-DATA-DEF-PROPS-CONDITIONAL>
                          <IMPLEMENTATION-DATA-TYPE-REF DEST="IMPLEMENTATION-DATA-TYPE">/AUTOSAR_Lin/ImplementationDataTypes/Lin_FrameDlType</IMPLEMENTATION-DATA-TYPE-REF>
                        </SW-DATA-DEF-PROPS-CONDITIONAL>
                      </SW-DATA-DEF-PROPS-VARIANTS>
                    </SW-DATA-DEF-PROPS>
                  </IMPLEMENTATION-DATA-TYPE-ELEMENT>
                  <IMPLEMENTATION-DATA-TYPE-ELEMENT>
                    <SHORT-NAME>SduPtr</SHORT-NAME>
                    <CATEGORY>DATA_REFERENCE</CATEGORY>
                    <SW-DATA-DEF-PROPS>
                      <SW-DATA-DEF-PROPS-VARIANTS>
                        <SW-DATA-DEF-PROPS-CONDITIONAL>
                          <SW-POINTER-TARGET-PROPS>
                            <TARGET-CATEGORY>TYPE_REFERENCE</TARGET-CATEGORY>
                            <SW-DATA-DEF-PROPS>
                              <SW-DATA-DEF-PROPS-VARIANTS>
                                <SW-DATA-DEF-PROPS-CONDITIONAL>
                                  <IMPLEMENTATION-DATA-TYPE-REF DEST="IMPLEMENTATION-DATA-TYPE">/AUTOSAR_Platform/ImplementationDataTypes/uint8</IMPLEMENTATION-DATA-TYPE-REF>
                                </SW-DATA-DEF-PROPS-CONDITIONAL>
                              </SW-DATA-DEF-PROPS-VARIANTS>
                            </SW-DATA-DEF-PROPS>
                          </SW-POINTER-TARGET-PROPS>
                        </SW-DATA-DEF-PROPS-CONDITIONAL>
                      </SW-DATA-DEF-PROPS-VARIANTS>
                    </SW-DATA-DEF-PROPS>
                  </IMPLEMENTATION-DATA-TYPE-ELEMENT>
                </SUB-ELEMENTS>
                <TYPE-EMITTER>BSW</TYPE-EMITTER>
              </IMPLEMENTATION-DATA-TYPE>
              <IMPLEMENTATION-DATA-TYPE>
                <SHORT-NAME>Lin_StatusType</SHORT-NAME>
                <CATEGORY>TYPE_REFERENCE</CATEGORY>
                <SW-DATA-DEF-PROPS>
                  <SW-DATA-DEF-PROPS-VARIANTS>
                    <SW-DATA-DEF-PROPS-CONDITIONAL>
                      <COMPU-METHOD-REF DEST="COMPU-METHOD">/AUTOSAR_Lin/CompuMethods/Lin_StatusType_Literals</COMPU-METHOD-REF>
                      <IMPLEMENTATION-DATA-TYPE-REF DEST="IMPLEMENTATION-DATA-TYPE">/AUTOSAR_Platform/ImplementationDataTypes/uint32</IMPLEMENTATION-DATA-TYPE-REF>
                    </SW-DATA-DEF-PROPS-CONDITIONAL>
                  </SW-DATA-DEF-PROPS-VARIANTS>
                </SW-DATA-DEF-PROPS>
                <TYPE-EMITTER>BSW</TYPE-EMITTER>
              </IMPLEMENTATION-DATA-TYPE>
              <IMPLEMENTATION-DATA-TYPE>
                <SHORT-NAME>Lin_SlaveErrorType</SHORT-NAME>
                <CATEGORY>TYPE_REFERENCE</CATEGORY>
                <SW-DATA-DEF-PROPS>
                  <SW-DATA-DEF-PROPS-VARIANTS>
                    <SW-DATA-DEF-PROPS-CONDITIONAL>
                      <COMPU-METHOD-REF DEST="COMPU-METHOD">/AUTOSAR_Lin/CompuMethods/Lin_SlaveErrorType_Literals</COMPU-METHOD-REF>
                      <IMPLEMENTATION-DATA-TYPE-REF DEST="IMPLEMENTATION-DATA-TYPE">/AUTOSAR_Platform/ImplementationDataTypes/uint32</IMPLEMENTATION-DATA-TYPE-REF>
                    </SW-DATA-DEF-PROPS-CONDITIONAL>
                  </SW-DATA-DEF-PROPS-VARIANTS>
                </SW-DATA-DEF-PROPS>
                <TYPE-EMITTER>BSW</TYPE-EMITTER>
              </IMPLEMENTATION-DATA-TYPE>
            </ELEMENTS>
[!ENDMACRO!][!/*

* GenerateLinTrcvImplementationTypes
*   Generates the implementation types of the LinTrcv package
*
*   Parameters:
*     None.
*
*/!][!MACRO "GenerateLinTrcvImplementationTypes"!]
            <SHORT-NAME>ImplementationDataTypes</SHORT-NAME>
            <CATEGORY>STANDARD</CATEGORY>
            <ELEMENTS>
              <IMPLEMENTATION-DATA-TYPE>
                <SHORT-NAME>LinTrcv_TrcvModeType</SHORT-NAME>
                <CATEGORY>TYPE_REFERENCE</CATEGORY>
                <ADMIN-DATA>
                  <SDGS>
                    <SDG GID="EB:PROVIDING-HEADER-FILE">
                      <SD GID="PROVIDING-HEADER-FILE">Lin_GeneralTypes.h</SD>
                    </SDG>
                  </SDGS>
                </ADMIN-DATA>
                <SW-DATA-DEF-PROPS>
                  <SW-DATA-DEF-PROPS-VARIANTS>
                    <SW-DATA-DEF-PROPS-CONDITIONAL>
                      <COMPU-METHOD-REF DEST="COMPU-METHOD">/AUTOSAR_LinTrcv/CompuMethods/LinTrcv_TrcvModeType_Literals</COMPU-METHOD-REF>
                      <IMPLEMENTATION-DATA-TYPE-REF DEST="IMPLEMENTATION-DATA-TYPE">/AUTOSAR_Platform/ImplementationDataTypes/uint32</IMPLEMENTATION-DATA-TYPE-REF>
                    </SW-DATA-DEF-PROPS-CONDITIONAL>
                  </SW-DATA-DEF-PROPS-VARIANTS>
                </SW-DATA-DEF-PROPS>
                <TYPE-EMITTER>BSW</TYPE-EMITTER>
              </IMPLEMENTATION-DATA-TYPE>
              <IMPLEMENTATION-DATA-TYPE>
                <SHORT-NAME>LinTrcv_TrcvWakeupModeType</SHORT-NAME>
                <CATEGORY>TYPE_REFERENCE</CATEGORY>
                <SW-DATA-DEF-PROPS>
                  <SW-DATA-DEF-PROPS-VARIANTS>
                    <SW-DATA-DEF-PROPS-CONDITIONAL>
                      <COMPU-METHOD-REF DEST="COMPU-METHOD">/AUTOSAR_LinTrcv/CompuMethods/LinTrcv_TrcvWakeupModeType_Literals</COMPU-METHOD-REF>
                      <IMPLEMENTATION-DATA-TYPE-REF DEST="IMPLEMENTATION-DATA-TYPE">/AUTOSAR_Platform/ImplementationDataTypes/uint32</IMPLEMENTATION-DATA-TYPE-REF>
                    </SW-DATA-DEF-PROPS-CONDITIONAL>
                  </SW-DATA-DEF-PROPS-VARIANTS>
                </SW-DATA-DEF-PROPS>
                <TYPE-EMITTER>BSW</TYPE-EMITTER>
              </IMPLEMENTATION-DATA-TYPE>
              <IMPLEMENTATION-DATA-TYPE>
                <SHORT-NAME>LinTrcv_TrcvWakeupReasonType</SHORT-NAME>
                <CATEGORY>TYPE_REFERENCE</CATEGORY>
                <SW-DATA-DEF-PROPS>
                  <SW-DATA-DEF-PROPS-VARIANTS>
                    <SW-DATA-DEF-PROPS-CONDITIONAL>
                      <COMPU-METHOD-REF DEST="COMPU-METHOD">/AUTOSAR_LinTrcv/CompuMethods/LinTrcv_TrcvWakeupReasonType_Literals</COMPU-METHOD-REF>
                      <IMPLEMENTATION-DATA-TYPE-REF DEST="IMPLEMENTATION-DATA-TYPE">/AUTOSAR_Platform/ImplementationDataTypes/uint32</IMPLEMENTATION-DATA-TYPE-REF>
                    </SW-DATA-DEF-PROPS-CONDITIONAL>
                  </SW-DATA-DEF-PROPS-VARIANTS>
                </SW-DATA-DEF-PROPS>
                <TYPE-EMITTER>BSW</TYPE-EMITTER>
              </IMPLEMENTATION-DATA-TYPE>
            </ELEMENTS>
[!ENDMACRO!][!/*

* GenerateMemMapSwAddrMethods
*   Generates the SwAddrMethods of the MemMap
*
*   Parameters:
*     None.
*
*/!][!MACRO "GenerateMemMapSwAddrMethods"!]
            <SHORT-NAME>SwAddrMethods</SHORT-NAME>
            <CATEGORY>STANDARD</CATEGORY>
            <ELEMENTS>
              <!-- !LINKSTO Base.VAR.CoreScope, 1
                   !LINKSTO Base.CODE.CoreScope, 1
                   !LINKSTO Base.Safety, 1-->
              <SW-ADDR-METHOD>
                <SHORT-NAME>CODE</SHORT-NAME>
                <MEMORY-ALLOCATION-KEYWORD-POLICY>ADDR-METHOD-SHORT-NAME</MEMORY-ALLOCATION-KEYWORD-POLICY>
                <SECTION-TYPE>CODE</SECTION-TYPE>
              </SW-ADDR-METHOD>
              <SW-ADDR-METHOD>
                <SHORT-NAME>CODE_ASIL_A</SHORT-NAME>
                <MEMORY-ALLOCATION-KEYWORD-POLICY>ADDR-METHOD-SHORT-NAME</MEMORY-ALLOCATION-KEYWORD-POLICY>
                <OPTIONS>
                  <OPTION>safetyAsilA</OPTION>
                </OPTIONS>
                <SECTION-TYPE>CODE</SECTION-TYPE>
              </SW-ADDR-METHOD>
              <SW-ADDR-METHOD>
                <SHORT-NAME>CODE_ASIL_B</SHORT-NAME>
                <MEMORY-ALLOCATION-KEYWORD-POLICY>ADDR-METHOD-SHORT-NAME</MEMORY-ALLOCATION-KEYWORD-POLICY>
                <OPTIONS>
                  <OPTION>safetyAsilB</OPTION>
                </OPTIONS>
                <SECTION-TYPE>CODE</SECTION-TYPE>
              </SW-ADDR-METHOD>
              <SW-ADDR-METHOD>
                <SHORT-NAME>CODE_ASIL_C</SHORT-NAME>
                <MEMORY-ALLOCATION-KEYWORD-POLICY>ADDR-METHOD-SHORT-NAME</MEMORY-ALLOCATION-KEYWORD-POLICY>
                <OPTIONS>
                  <OPTION>safetyAsilC</OPTION>
                </OPTIONS>
                <SECTION-TYPE>CODE</SECTION-TYPE>
              </SW-ADDR-METHOD>
              <SW-ADDR-METHOD>
                <SHORT-NAME>CODE_ASIL_D</SHORT-NAME>
                <MEMORY-ALLOCATION-KEYWORD-POLICY>ADDR-METHOD-SHORT-NAME</MEMORY-ALLOCATION-KEYWORD-POLICY>
                <OPTIONS>
                  <OPTION>safetyAsilD</OPTION>
                </OPTIONS>
                <SECTION-TYPE>CODE</SECTION-TYPE>
              </SW-ADDR-METHOD>
              <SW-ADDR-METHOD>
                <SHORT-NAME>CODE_LOCAL</SHORT-NAME>
                <MEMORY-ALLOCATION-KEYWORD-POLICY>ADDR-METHOD-SHORT-NAME</MEMORY-ALLOCATION-KEYWORD-POLICY>
                <OPTIONS>
                  <OPTION>coreLocal</OPTION>
                </OPTIONS>
                <SECTION-TYPE>CODE</SECTION-TYPE>
              </SW-ADDR-METHOD>
              <SW-ADDR-METHOD>
                <SHORT-NAME>CODE_ASIL_A_LOCAL</SHORT-NAME>
                <MEMORY-ALLOCATION-KEYWORD-POLICY>ADDR-METHOD-SHORT-NAME</MEMORY-ALLOCATION-KEYWORD-POLICY>
                <OPTIONS>
                  <OPTION>safetyAsilA</OPTION>
                  <OPTION>coreLocal</OPTION>
                </OPTIONS>
                <SECTION-TYPE>CODE</SECTION-TYPE>
              </SW-ADDR-METHOD>
              <SW-ADDR-METHOD>
                <SHORT-NAME>CODE_ASIL_B_LOCAL</SHORT-NAME>
                <MEMORY-ALLOCATION-KEYWORD-POLICY>ADDR-METHOD-SHORT-NAME</MEMORY-ALLOCATION-KEYWORD-POLICY>
                <OPTIONS>
                  <OPTION>safetyAsilB</OPTION>
                  <OPTION>coreLocal</OPTION>
                </OPTIONS>
                <SECTION-TYPE>CODE</SECTION-TYPE>
              </SW-ADDR-METHOD>
              <SW-ADDR-METHOD>
                <SHORT-NAME>CODE_ASIL_C_LOCAL</SHORT-NAME>
                <MEMORY-ALLOCATION-KEYWORD-POLICY>ADDR-METHOD-SHORT-NAME</MEMORY-ALLOCATION-KEYWORD-POLICY>
                <OPTIONS>
                  <OPTION>safetyAsilC</OPTION>
                  <OPTION>coreLocal</OPTION>
                </OPTIONS>
                <SECTION-TYPE>CODE</SECTION-TYPE>
              </SW-ADDR-METHOD>
              <SW-ADDR-METHOD>
                <SHORT-NAME>CODE_ASIL_D_LOCAL</SHORT-NAME>
                <MEMORY-ALLOCATION-KEYWORD-POLICY>ADDR-METHOD-SHORT-NAME</MEMORY-ALLOCATION-KEYWORD-POLICY>
                <OPTIONS>
                  <OPTION>safetyAsilD</OPTION>
                  <OPTION>coreLocal</OPTION>
                </OPTIONS>
                <SECTION-TYPE>CODE</SECTION-TYPE>
              </SW-ADDR-METHOD>
              <SW-ADDR-METHOD>
                <SHORT-NAME>CALLOUT_CODE</SHORT-NAME>
                <MEMORY-ALLOCATION-KEYWORD-POLICY>ADDR-METHOD-SHORT-NAME</MEMORY-ALLOCATION-KEYWORD-POLICY>
                <SECTION-TYPE>CODE</SECTION-TYPE>
              </SW-ADDR-METHOD>
              <SW-ADDR-METHOD>
                <SHORT-NAME>CALLOUT_CODE_ASIL_A</SHORT-NAME>
                <MEMORY-ALLOCATION-KEYWORD-POLICY>ADDR-METHOD-SHORT-NAME</MEMORY-ALLOCATION-KEYWORD-POLICY>
                <OPTIONS>
                  <OPTION>safetyAsilA</OPTION>
                </OPTIONS>
                <SECTION-TYPE>CODE</SECTION-TYPE>
              </SW-ADDR-METHOD>
              <SW-ADDR-METHOD>
                <SHORT-NAME>CALLOUT_CODE_ASIL_B</SHORT-NAME>
                <MEMORY-ALLOCATION-KEYWORD-POLICY>ADDR-METHOD-SHORT-NAME</MEMORY-ALLOCATION-KEYWORD-POLICY>
                <OPTIONS>
                  <OPTION>safetyAsilB</OPTION>
                </OPTIONS>
                <SECTION-TYPE>CODE</SECTION-TYPE>
              </SW-ADDR-METHOD>
              <SW-ADDR-METHOD>
                <SHORT-NAME>CALLOUT_CODE_ASIL_C</SHORT-NAME>
                <MEMORY-ALLOCATION-KEYWORD-POLICY>ADDR-METHOD-SHORT-NAME</MEMORY-ALLOCATION-KEYWORD-POLICY>
                <OPTIONS>
                  <OPTION>safetyAsilC</OPTION>
                </OPTIONS>
                <SECTION-TYPE>CODE</SECTION-TYPE>
              </SW-ADDR-METHOD>
              <SW-ADDR-METHOD>
                <SHORT-NAME>CALLOUT_CODE_ASIL_D</SHORT-NAME>
                <MEMORY-ALLOCATION-KEYWORD-POLICY>ADDR-METHOD-SHORT-NAME</MEMORY-ALLOCATION-KEYWORD-POLICY>
                <OPTIONS>
                  <OPTION>safetyAsilD</OPTION>
                </OPTIONS>
                <SECTION-TYPE>CODE</SECTION-TYPE>
              </SW-ADDR-METHOD>
              <SW-ADDR-METHOD>
                <SHORT-NAME>CALLOUT_CODE_LOCAL</SHORT-NAME>
                <MEMORY-ALLOCATION-KEYWORD-POLICY>ADDR-METHOD-SHORT-NAME</MEMORY-ALLOCATION-KEYWORD-POLICY>
                <OPTIONS>
                  <OPTION>coreLocal</OPTION>
                </OPTIONS>
                <SECTION-TYPE>CODE</SECTION-TYPE>
              </SW-ADDR-METHOD>
              <SW-ADDR-METHOD>
                <SHORT-NAME>CALLOUT_CODE_ASIL_A_LOCAL</SHORT-NAME>
                <MEMORY-ALLOCATION-KEYWORD-POLICY>ADDR-METHOD-SHORT-NAME</MEMORY-ALLOCATION-KEYWORD-POLICY>
                <OPTIONS>
                  <OPTION>safetyAsilA</OPTION>
                  <OPTION>coreLocal</OPTION>
                </OPTIONS>
                <SECTION-TYPE>CODE</SECTION-TYPE>
              </SW-ADDR-METHOD>
              <SW-ADDR-METHOD>
                <SHORT-NAME>CALLOUT_CODE_ASIL_B_LOCAL</SHORT-NAME>
                <MEMORY-ALLOCATION-KEYWORD-POLICY>ADDR-METHOD-SHORT-NAME</MEMORY-ALLOCATION-KEYWORD-POLICY>
                <OPTIONS>
                  <OPTION>safetyAsilB</OPTION>
                  <OPTION>coreLocal</OPTION>
                </OPTIONS>
                <SECTION-TYPE>CODE</SECTION-TYPE>
              </SW-ADDR-METHOD>
              <SW-ADDR-METHOD>
                <SHORT-NAME>CALLOUT_CODE_ASIL_C_LOCAL</SHORT-NAME>
                <MEMORY-ALLOCATION-KEYWORD-POLICY>ADDR-METHOD-SHORT-NAME</MEMORY-ALLOCATION-KEYWORD-POLICY>
                <OPTIONS>
                  <OPTION>safetyAsilC</OPTION>
                  <OPTION>coreLocal</OPTION>
                </OPTIONS>
                <SECTION-TYPE>CODE</SECTION-TYPE>
              </SW-ADDR-METHOD>
              <SW-ADDR-METHOD>
                <SHORT-NAME>CALLOUT_CODE_ASIL_D_LOCAL</SHORT-NAME>
                <MEMORY-ALLOCATION-KEYWORD-POLICY>ADDR-METHOD-SHORT-NAME</MEMORY-ALLOCATION-KEYWORD-POLICY>
                <OPTIONS>
                  <OPTION>safetyAsilD</OPTION>
                  <OPTION>coreLocal</OPTION>
                </OPTIONS>
                <SECTION-TYPE>CODE</SECTION-TYPE>
              </SW-ADDR-METHOD>
              <SW-ADDR-METHOD>
                <SHORT-NAME>VAR</SHORT-NAME> <!-- keeping this for legacy reasons -->
                <MEMORY-ALLOCATION-KEYWORD-POLICY>ADDR-METHOD-SHORT-NAME-AND-ALIGNMENT</MEMORY-ALLOCATION-KEYWORD-POLICY>
                <SECTION-INITIALIZATION-POLICY>INIT</SECTION-INITIALIZATION-POLICY>
                <SECTION-TYPE>VAR</SECTION-TYPE>
              </SW-ADDR-METHOD>
              <SW-ADDR-METHOD>
                <SHORT-NAME>VAR_INIT</SHORT-NAME>
                <MEMORY-ALLOCATION-KEYWORD-POLICY>ADDR-METHOD-SHORT-NAME-AND-ALIGNMENT</MEMORY-ALLOCATION-KEYWORD-POLICY>
                <SECTION-INITIALIZATION-POLICY>INIT</SECTION-INITIALIZATION-POLICY>
                <SECTION-TYPE>VAR</SECTION-TYPE>
              </SW-ADDR-METHOD>
              <SW-ADDR-METHOD>
                <SHORT-NAME>VAR_INIT_ASIL_A</SHORT-NAME>
                <MEMORY-ALLOCATION-KEYWORD-POLICY>ADDR-METHOD-SHORT-NAME-AND-ALIGNMENT</MEMORY-ALLOCATION-KEYWORD-POLICY>
                <OPTIONS>
                  <OPTION>safetyAsilA</OPTION>
                </OPTIONS>
                <SECTION-INITIALIZATION-POLICY>INIT</SECTION-INITIALIZATION-POLICY>
                <SECTION-TYPE>VAR</SECTION-TYPE>
              </SW-ADDR-METHOD>
              <SW-ADDR-METHOD>
                <SHORT-NAME>VAR_INIT_ASIL_B</SHORT-NAME>
                <MEMORY-ALLOCATION-KEYWORD-POLICY>ADDR-METHOD-SHORT-NAME-AND-ALIGNMENT</MEMORY-ALLOCATION-KEYWORD-POLICY>
                <OPTIONS>
                  <OPTION>safetyAsilB</OPTION>
                </OPTIONS>
                <SECTION-INITIALIZATION-POLICY>INIT</SECTION-INITIALIZATION-POLICY>
                <SECTION-TYPE>VAR</SECTION-TYPE>
              </SW-ADDR-METHOD>
              <SW-ADDR-METHOD>
                <SHORT-NAME>VAR_INIT_ASIL_C</SHORT-NAME>
                <MEMORY-ALLOCATION-KEYWORD-POLICY>ADDR-METHOD-SHORT-NAME-AND-ALIGNMENT</MEMORY-ALLOCATION-KEYWORD-POLICY>
                <OPTIONS>
                  <OPTION>safetyAsilC</OPTION>
                </OPTIONS>
                <SECTION-INITIALIZATION-POLICY>INIT</SECTION-INITIALIZATION-POLICY>
                <SECTION-TYPE>VAR</SECTION-TYPE>
              </SW-ADDR-METHOD>
              <SW-ADDR-METHOD>
                <SHORT-NAME>VAR_INIT_ASIL_D</SHORT-NAME>
                <MEMORY-ALLOCATION-KEYWORD-POLICY>ADDR-METHOD-SHORT-NAME-AND-ALIGNMENT</MEMORY-ALLOCATION-KEYWORD-POLICY>
                <OPTIONS>
                  <OPTION>safetyAsilD</OPTION>
                </OPTIONS>
                <SECTION-INITIALIZATION-POLICY>INIT</SECTION-INITIALIZATION-POLICY>
                <SECTION-TYPE>VAR</SECTION-TYPE>
              </SW-ADDR-METHOD>
              <SW-ADDR-METHOD>
                <SHORT-NAME>VAR_INIT_LOCAL</SHORT-NAME>
                <MEMORY-ALLOCATION-KEYWORD-POLICY>ADDR-METHOD-SHORT-NAME-AND-ALIGNMENT</MEMORY-ALLOCATION-KEYWORD-POLICY>
                <OPTIONS>
                  <OPTION>coreLocal</OPTION>
                </OPTIONS>
                <SECTION-INITIALIZATION-POLICY>INIT</SECTION-INITIALIZATION-POLICY>
                <SECTION-TYPE>VAR</SECTION-TYPE>
              </SW-ADDR-METHOD>
              <SW-ADDR-METHOD>
                <SHORT-NAME>VAR_INIT_ASIL_A_LOCAL</SHORT-NAME>
                <MEMORY-ALLOCATION-KEYWORD-POLICY>ADDR-METHOD-SHORT-NAME-AND-ALIGNMENT</MEMORY-ALLOCATION-KEYWORD-POLICY>
                <OPTIONS>
                  <OPTION>safetyAsilA</OPTION>
                  <OPTION>coreLocal</OPTION>
                </OPTIONS>
                <SECTION-INITIALIZATION-POLICY>INIT</SECTION-INITIALIZATION-POLICY>
                <SECTION-TYPE>VAR</SECTION-TYPE>
              </SW-ADDR-METHOD>
              <SW-ADDR-METHOD>
                <SHORT-NAME>VAR_INIT_ASIL_B_LOCAL</SHORT-NAME>
                <MEMORY-ALLOCATION-KEYWORD-POLICY>ADDR-METHOD-SHORT-NAME-AND-ALIGNMENT</MEMORY-ALLOCATION-KEYWORD-POLICY>
                <OPTIONS>
                  <OPTION>safetyAsilB</OPTION>
                  <OPTION>coreLocal</OPTION>
                </OPTIONS>
                <SECTION-INITIALIZATION-POLICY>INIT</SECTION-INITIALIZATION-POLICY>
                <SECTION-TYPE>VAR</SECTION-TYPE>
              </SW-ADDR-METHOD>
              <SW-ADDR-METHOD>
                <SHORT-NAME>VAR_INIT_ASIL_C_LOCAL</SHORT-NAME>
                <MEMORY-ALLOCATION-KEYWORD-POLICY>ADDR-METHOD-SHORT-NAME-AND-ALIGNMENT</MEMORY-ALLOCATION-KEYWORD-POLICY>
                <OPTIONS>
                  <OPTION>safetyAsilC</OPTION>
                  <OPTION>coreLocal</OPTION>
                </OPTIONS>
                <SECTION-INITIALIZATION-POLICY>INIT</SECTION-INITIALIZATION-POLICY>
                <SECTION-TYPE>VAR</SECTION-TYPE>
              </SW-ADDR-METHOD>
              <SW-ADDR-METHOD>
                <SHORT-NAME>VAR_INIT_ASIL_D_LOCAL</SHORT-NAME>
                <MEMORY-ALLOCATION-KEYWORD-POLICY>ADDR-METHOD-SHORT-NAME-AND-ALIGNMENT</MEMORY-ALLOCATION-KEYWORD-POLICY>
                <OPTIONS>
                  <OPTION>safetyAsilD</OPTION>
                  <OPTION>coreLocal</OPTION>
                </OPTIONS>
                <SECTION-INITIALIZATION-POLICY>INIT</SECTION-INITIALIZATION-POLICY>
                <SECTION-TYPE>VAR</SECTION-TYPE>
              </SW-ADDR-METHOD>
              <SW-ADDR-METHOD>
                <SHORT-NAME>VAR_NOINIT</SHORT-NAME> <!-- keeping this for legacy reasons -->
                <MEMORY-ALLOCATION-KEYWORD-POLICY>ADDR-METHOD-SHORT-NAME-AND-ALIGNMENT</MEMORY-ALLOCATION-KEYWORD-POLICY>
                <SECTION-INITIALIZATION-POLICY>NO-INIT</SECTION-INITIALIZATION-POLICY>
                <SECTION-TYPE>VAR</SECTION-TYPE>
              </SW-ADDR-METHOD>
              <SW-ADDR-METHOD>
                <SHORT-NAME>VAR_NO_INIT</SHORT-NAME>
                <MEMORY-ALLOCATION-KEYWORD-POLICY>ADDR-METHOD-SHORT-NAME-AND-ALIGNMENT</MEMORY-ALLOCATION-KEYWORD-POLICY>
                <SECTION-INITIALIZATION-POLICY>NO-INIT</SECTION-INITIALIZATION-POLICY>
                <SECTION-TYPE>VAR</SECTION-TYPE>
              </SW-ADDR-METHOD>
              <SW-ADDR-METHOD>
                <SHORT-NAME>VAR_NO_INIT_ASIL_A</SHORT-NAME>
                <MEMORY-ALLOCATION-KEYWORD-POLICY>ADDR-METHOD-SHORT-NAME-AND-ALIGNMENT</MEMORY-ALLOCATION-KEYWORD-POLICY>
                <OPTIONS>
                  <OPTION>safetyAsilA</OPTION>
                </OPTIONS>
                <SECTION-INITIALIZATION-POLICY>NO-INIT</SECTION-INITIALIZATION-POLICY>
                <SECTION-TYPE>VAR</SECTION-TYPE>
              </SW-ADDR-METHOD>
              <SW-ADDR-METHOD>
                <SHORT-NAME>VAR_NO_INIT_ASIL_B</SHORT-NAME>
                <MEMORY-ALLOCATION-KEYWORD-POLICY>ADDR-METHOD-SHORT-NAME-AND-ALIGNMENT</MEMORY-ALLOCATION-KEYWORD-POLICY>
                <OPTIONS>
                  <OPTION>safetyAsilB</OPTION>
                </OPTIONS>
                <SECTION-INITIALIZATION-POLICY>NO-INIT</SECTION-INITIALIZATION-POLICY>
                <SECTION-TYPE>VAR</SECTION-TYPE>
              </SW-ADDR-METHOD>
              <SW-ADDR-METHOD>
                <SHORT-NAME>VAR_NO_INIT_ASIL_C</SHORT-NAME>
                <MEMORY-ALLOCATION-KEYWORD-POLICY>ADDR-METHOD-SHORT-NAME-AND-ALIGNMENT</MEMORY-ALLOCATION-KEYWORD-POLICY>
                <OPTIONS>
                  <OPTION>safetyAsilC</OPTION>
                </OPTIONS>
                <SECTION-INITIALIZATION-POLICY>NO-INIT</SECTION-INITIALIZATION-POLICY>
                <SECTION-TYPE>VAR</SECTION-TYPE>
              </SW-ADDR-METHOD>
              <SW-ADDR-METHOD>
                <SHORT-NAME>VAR_NO_INIT_ASIL_D</SHORT-NAME>
                <MEMORY-ALLOCATION-KEYWORD-POLICY>ADDR-METHOD-SHORT-NAME-AND-ALIGNMENT</MEMORY-ALLOCATION-KEYWORD-POLICY>
                <OPTIONS>
                  <OPTION>safetyAsilD</OPTION>
                </OPTIONS>
                <SECTION-INITIALIZATION-POLICY>NO-INIT</SECTION-INITIALIZATION-POLICY>
                <SECTION-TYPE>VAR</SECTION-TYPE>
              </SW-ADDR-METHOD>
              <SW-ADDR-METHOD>
                <SHORT-NAME>VAR_SAVED_ZONE</SHORT-NAME>
                <MEMORY-ALLOCATION-KEYWORD-POLICY>ADDR-METHOD-SHORT-NAME-AND-ALIGNMENT</MEMORY-ALLOCATION-KEYWORD-POLICY>
                <SECTION-INITIALIZATION-POLICY>NO-INIT</SECTION-INITIALIZATION-POLICY>
                <SECTION-TYPE>VAR</SECTION-TYPE>
              </SW-ADDR-METHOD>
              <SW-ADDR-METHOD>
                <SHORT-NAME>VAR_SAVED_ZONE_ASIL_A</SHORT-NAME>
                <MEMORY-ALLOCATION-KEYWORD-POLICY>ADDR-METHOD-SHORT-NAME-AND-ALIGNMENT</MEMORY-ALLOCATION-KEYWORD-POLICY>
                <OPTIONS>
                  <OPTION>safetyAsilA</OPTION>
                </OPTIONS>
                <SECTION-INITIALIZATION-POLICY>NO-INIT</SECTION-INITIALIZATION-POLICY>
                <SECTION-TYPE>VAR</SECTION-TYPE>
              </SW-ADDR-METHOD>
              <SW-ADDR-METHOD>
                <SHORT-NAME>VAR_SAVED_ZONE_ASIL_B</SHORT-NAME>
                <MEMORY-ALLOCATION-KEYWORD-POLICY>ADDR-METHOD-SHORT-NAME-AND-ALIGNMENT</MEMORY-ALLOCATION-KEYWORD-POLICY>
                <OPTIONS>
                  <OPTION>safetyAsilB</OPTION>
                </OPTIONS>
                <SECTION-INITIALIZATION-POLICY>NO-INIT</SECTION-INITIALIZATION-POLICY>
                <SECTION-TYPE>VAR</SECTION-TYPE>
              </SW-ADDR-METHOD>
              <SW-ADDR-METHOD>
                <SHORT-NAME>VAR_SAVED_ZONE_ASIL_C</SHORT-NAME>
                <MEMORY-ALLOCATION-KEYWORD-POLICY>ADDR-METHOD-SHORT-NAME-AND-ALIGNMENT</MEMORY-ALLOCATION-KEYWORD-POLICY>
                <OPTIONS>
                  <OPTION>safetyAsilC</OPTION>
                </OPTIONS>
                <SECTION-INITIALIZATION-POLICY>NO-INIT</SECTION-INITIALIZATION-POLICY>
                <SECTION-TYPE>VAR</SECTION-TYPE>
              </SW-ADDR-METHOD>
              <SW-ADDR-METHOD>
                <SHORT-NAME>VAR_SAVED_ZONE_ASIL_D</SHORT-NAME>
                <MEMORY-ALLOCATION-KEYWORD-POLICY>ADDR-METHOD-SHORT-NAME-AND-ALIGNMENT</MEMORY-ALLOCATION-KEYWORD-POLICY>
                <OPTIONS>
                  <OPTION>safetyAsilD</OPTION>
                </OPTIONS>
                <SECTION-INITIALIZATION-POLICY>NO-INIT</SECTION-INITIALIZATION-POLICY>
                <SECTION-TYPE>VAR</SECTION-TYPE>
              </SW-ADDR-METHOD>
              <SW-ADDR-METHOD>
                <SHORT-NAME>VAR_CLEARED</SHORT-NAME>
                <MEMORY-ALLOCATION-KEYWORD-POLICY>ADDR-METHOD-SHORT-NAME-AND-ALIGNMENT</MEMORY-ALLOCATION-KEYWORD-POLICY>
                <SECTION-INITIALIZATION-POLICY>CLEARED</SECTION-INITIALIZATION-POLICY>
                <SECTION-TYPE>VAR</SECTION-TYPE>
              </SW-ADDR-METHOD>
              <SW-ADDR-METHOD>
                <SHORT-NAME>VAR_CLEARED_ASIL_A</SHORT-NAME>
                <MEMORY-ALLOCATION-KEYWORD-POLICY>ADDR-METHOD-SHORT-NAME-AND-ALIGNMENT</MEMORY-ALLOCATION-KEYWORD-POLICY>
                <OPTIONS>
                  <OPTION>safetyAsilA</OPTION>
                </OPTIONS>
                <SECTION-INITIALIZATION-POLICY>CLEARED</SECTION-INITIALIZATION-POLICY>
                <SECTION-TYPE>VAR</SECTION-TYPE>
              </SW-ADDR-METHOD>
              <SW-ADDR-METHOD>
                <SHORT-NAME>VAR_CLEARED_ASIL_B</SHORT-NAME>
                <MEMORY-ALLOCATION-KEYWORD-POLICY>ADDR-METHOD-SHORT-NAME-AND-ALIGNMENT</MEMORY-ALLOCATION-KEYWORD-POLICY>
                <OPTIONS>
                  <OPTION>safetyAsilB</OPTION>
                </OPTIONS>
                <SECTION-INITIALIZATION-POLICY>CLEARED</SECTION-INITIALIZATION-POLICY>
                <SECTION-TYPE>VAR</SECTION-TYPE>
              </SW-ADDR-METHOD>
              <SW-ADDR-METHOD>
                <SHORT-NAME>VAR_CLEARED_ASIL_C</SHORT-NAME>
                <MEMORY-ALLOCATION-KEYWORD-POLICY>ADDR-METHOD-SHORT-NAME-AND-ALIGNMENT</MEMORY-ALLOCATION-KEYWORD-POLICY>
                <OPTIONS>
                  <OPTION>safetyAsilC</OPTION>
                </OPTIONS>
                <SECTION-INITIALIZATION-POLICY>CLEARED</SECTION-INITIALIZATION-POLICY>
                <SECTION-TYPE>VAR</SECTION-TYPE>
              </SW-ADDR-METHOD>
              <SW-ADDR-METHOD>
                <SHORT-NAME>VAR_CLEARED_ASIL_D</SHORT-NAME>
                <MEMORY-ALLOCATION-KEYWORD-POLICY>ADDR-METHOD-SHORT-NAME-AND-ALIGNMENT</MEMORY-ALLOCATION-KEYWORD-POLICY>
                <OPTIONS>
                  <OPTION>safetyAsilD</OPTION>
                </OPTIONS>
                <SECTION-INITIALIZATION-POLICY>CLEARED</SECTION-INITIALIZATION-POLICY>
                <SECTION-TYPE>VAR</SECTION-TYPE>
              </SW-ADDR-METHOD>
              <SW-ADDR-METHOD>
                <SHORT-NAME>VAR_CLEARED_LOCAL</SHORT-NAME>
                <MEMORY-ALLOCATION-KEYWORD-POLICY>ADDR-METHOD-SHORT-NAME-AND-ALIGNMENT</MEMORY-ALLOCATION-KEYWORD-POLICY>
                <OPTIONS>
                  <OPTION>coreLocal</OPTION>
                </OPTIONS>
                <SECTION-INITIALIZATION-POLICY>CLEARED</SECTION-INITIALIZATION-POLICY>
                <SECTION-TYPE>VAR</SECTION-TYPE>
              </SW-ADDR-METHOD>
              <SW-ADDR-METHOD>
                <SHORT-NAME>VAR_CLEARED_ASIL_A_LOCAL</SHORT-NAME>
                <MEMORY-ALLOCATION-KEYWORD-POLICY>ADDR-METHOD-SHORT-NAME-AND-ALIGNMENT</MEMORY-ALLOCATION-KEYWORD-POLICY>
                <OPTIONS>
                  <OPTION>safetyAsilA</OPTION>
                  <OPTION>coreLocal</OPTION>
                </OPTIONS>
                <SECTION-INITIALIZATION-POLICY>CLEARED</SECTION-INITIALIZATION-POLICY>
                <SECTION-TYPE>VAR</SECTION-TYPE>
              </SW-ADDR-METHOD>
              <SW-ADDR-METHOD>
                <SHORT-NAME>VAR_CLEARED_ASIL_B_LOCAL</SHORT-NAME>
                <MEMORY-ALLOCATION-KEYWORD-POLICY>ADDR-METHOD-SHORT-NAME-AND-ALIGNMENT</MEMORY-ALLOCATION-KEYWORD-POLICY>
                <OPTIONS>
                  <OPTION>safetyAsilB</OPTION>
                  <OPTION>coreLocal</OPTION>
                </OPTIONS>
                <SECTION-INITIALIZATION-POLICY>CLEARED</SECTION-INITIALIZATION-POLICY>
                <SECTION-TYPE>VAR</SECTION-TYPE>
              </SW-ADDR-METHOD>
              <SW-ADDR-METHOD>
                <SHORT-NAME>VAR_CLEARED_ASIL_C_LOCAL</SHORT-NAME>
                <MEMORY-ALLOCATION-KEYWORD-POLICY>ADDR-METHOD-SHORT-NAME-AND-ALIGNMENT</MEMORY-ALLOCATION-KEYWORD-POLICY>
                <OPTIONS>
                  <OPTION>safetyAsilC</OPTION>
                  <OPTION>coreLocal</OPTION>
                </OPTIONS>
                <SECTION-INITIALIZATION-POLICY>CLEARED</SECTION-INITIALIZATION-POLICY>
                <SECTION-TYPE>VAR</SECTION-TYPE>
              </SW-ADDR-METHOD>
              <SW-ADDR-METHOD>
                <SHORT-NAME>VAR_CLEARED_ASIL_D_LOCAL</SHORT-NAME>
                <MEMORY-ALLOCATION-KEYWORD-POLICY>ADDR-METHOD-SHORT-NAME-AND-ALIGNMENT</MEMORY-ALLOCATION-KEYWORD-POLICY>
                <OPTIONS>
                  <OPTION>safetyAsilD</OPTION>
                  <OPTION>coreLocal</OPTION>
                </OPTIONS>
                <SECTION-INITIALIZATION-POLICY>CLEARED</SECTION-INITIALIZATION-POLICY>
                <SECTION-TYPE>VAR</SECTION-TYPE>
              </SW-ADDR-METHOD>
              <SW-ADDR-METHOD>
                <SHORT-NAME>VAR_POWER_ON_INIT</SHORT-NAME>
                <MEMORY-ALLOCATION-KEYWORD-POLICY>ADDR-METHOD-SHORT-NAME-AND-ALIGNMENT</MEMORY-ALLOCATION-KEYWORD-POLICY>
                <SECTION-INITIALIZATION-POLICY>POWER-ON-INIT</SECTION-INITIALIZATION-POLICY>
                <SECTION-TYPE>VAR</SECTION-TYPE>
              </SW-ADDR-METHOD>
              <SW-ADDR-METHOD>
                <SHORT-NAME>VAR_POWER_ON_INIT_ASIL_A</SHORT-NAME>
                <MEMORY-ALLOCATION-KEYWORD-POLICY>ADDR-METHOD-SHORT-NAME-AND-ALIGNMENT</MEMORY-ALLOCATION-KEYWORD-POLICY>
                <OPTIONS>
                  <OPTION>safetyAsilA</OPTION>
                </OPTIONS>
                <SECTION-INITIALIZATION-POLICY>POWER-ON-INIT</SECTION-INITIALIZATION-POLICY>
                <SECTION-TYPE>VAR</SECTION-TYPE>
              </SW-ADDR-METHOD>
              <SW-ADDR-METHOD>
                <SHORT-NAME>VAR_POWER_ON_INIT_ASIL_B</SHORT-NAME>
                <MEMORY-ALLOCATION-KEYWORD-POLICY>ADDR-METHOD-SHORT-NAME-AND-ALIGNMENT</MEMORY-ALLOCATION-KEYWORD-POLICY>
                <OPTIONS>
                  <OPTION>safetyAsilB</OPTION>
                </OPTIONS>
                <SECTION-INITIALIZATION-POLICY>POWER-ON-INIT</SECTION-INITIALIZATION-POLICY>
                <SECTION-TYPE>VAR</SECTION-TYPE>
              </SW-ADDR-METHOD>
              <SW-ADDR-METHOD>
                <SHORT-NAME>VAR_POWER_ON_INIT_ASIL_C</SHORT-NAME>
                <MEMORY-ALLOCATION-KEYWORD-POLICY>ADDR-METHOD-SHORT-NAME-AND-ALIGNMENT</MEMORY-ALLOCATION-KEYWORD-POLICY>
                <OPTIONS>
                  <OPTION>safetyAsilC</OPTION>
                </OPTIONS>
                <SECTION-INITIALIZATION-POLICY>POWER-ON-INIT</SECTION-INITIALIZATION-POLICY>
                <SECTION-TYPE>VAR</SECTION-TYPE>
              </SW-ADDR-METHOD>
              <SW-ADDR-METHOD>
                <SHORT-NAME>VAR_POWER_ON_INIT_ASIL_D</SHORT-NAME>
                <MEMORY-ALLOCATION-KEYWORD-POLICY>ADDR-METHOD-SHORT-NAME-AND-ALIGNMENT</MEMORY-ALLOCATION-KEYWORD-POLICY>
                <OPTIONS>
                  <OPTION>safetyAsilD</OPTION>
                </OPTIONS>
                <SECTION-INITIALIZATION-POLICY>POWER-ON-INIT</SECTION-INITIALIZATION-POLICY>
                <SECTION-TYPE>VAR</SECTION-TYPE>
              </SW-ADDR-METHOD>
              <SW-ADDR-METHOD>
                <SHORT-NAME>VAR_POWER_ON_CLEARED</SHORT-NAME>
                <MEMORY-ALLOCATION-KEYWORD-POLICY>ADDR-METHOD-SHORT-NAME-AND-ALIGNMENT</MEMORY-ALLOCATION-KEYWORD-POLICY>
                <SECTION-INITIALIZATION-POLICY>POWER-ON-CLEARED</SECTION-INITIALIZATION-POLICY>
                <SECTION-TYPE>VAR</SECTION-TYPE>
              </SW-ADDR-METHOD>
              <SW-ADDR-METHOD>
                <SHORT-NAME>VAR_POWER_ON_CLEARED_ASIL_A</SHORT-NAME>
                <MEMORY-ALLOCATION-KEYWORD-POLICY>ADDR-METHOD-SHORT-NAME-AND-ALIGNMENT</MEMORY-ALLOCATION-KEYWORD-POLICY>
                <OPTIONS>
                  <OPTION>safetyAsilA</OPTION>
                </OPTIONS>
                <SECTION-INITIALIZATION-POLICY>POWER-ON-CLEARED</SECTION-INITIALIZATION-POLICY>
                <SECTION-TYPE>VAR</SECTION-TYPE>
              </SW-ADDR-METHOD>
              <SW-ADDR-METHOD>
                <SHORT-NAME>VAR_POWER_ON_CLEARED_ASIL_B</SHORT-NAME>
                <MEMORY-ALLOCATION-KEYWORD-POLICY>ADDR-METHOD-SHORT-NAME-AND-ALIGNMENT</MEMORY-ALLOCATION-KEYWORD-POLICY>
                <OPTIONS>
                  <OPTION>safetyAsilB</OPTION>
                </OPTIONS>
                <SECTION-INITIALIZATION-POLICY>POWER-ON-CLEARED</SECTION-INITIALIZATION-POLICY>
                <SECTION-TYPE>VAR</SECTION-TYPE>
              </SW-ADDR-METHOD>
              <SW-ADDR-METHOD>
                <SHORT-NAME>VAR_POWER_ON_CLEARED_ASIL_C</SHORT-NAME>
                <MEMORY-ALLOCATION-KEYWORD-POLICY>ADDR-METHOD-SHORT-NAME-AND-ALIGNMENT</MEMORY-ALLOCATION-KEYWORD-POLICY>
                <OPTIONS>
                  <OPTION>safetyAsilC</OPTION>
                </OPTIONS>
                <SECTION-INITIALIZATION-POLICY>POWER-ON-CLEARED</SECTION-INITIALIZATION-POLICY>
                <SECTION-TYPE>VAR</SECTION-TYPE>
              </SW-ADDR-METHOD>
              <SW-ADDR-METHOD>
                <SHORT-NAME>VAR_POWER_ON_CLEARED_ASIL_D</SHORT-NAME>
                <MEMORY-ALLOCATION-KEYWORD-POLICY>ADDR-METHOD-SHORT-NAME-AND-ALIGNMENT</MEMORY-ALLOCATION-KEYWORD-POLICY>
                <OPTIONS>
                  <OPTION>safetyAsilD</OPTION>
                </OPTIONS>
                <SECTION-INITIALIZATION-POLICY>POWER-ON-CLEARED</SECTION-INITIALIZATION-POLICY>
                <SECTION-TYPE>VAR</SECTION-TYPE>
              </SW-ADDR-METHOD>
              <SW-ADDR-METHOD>
                <SHORT-NAME>VAR_FAST</SHORT-NAME>
                <MEMORY-ALLOCATION-KEYWORD-POLICY>ADDR-METHOD-SHORT-NAME-AND-ALIGNMENT</MEMORY-ALLOCATION-KEYWORD-POLICY>
                <SECTION-INITIALIZATION-POLICY>INIT</SECTION-INITIALIZATION-POLICY>
                <SECTION-TYPE>VAR-FAST</SECTION-TYPE>
              </SW-ADDR-METHOD>
              <SW-ADDR-METHOD>
                <SHORT-NAME>VAR_FAST_ASIL_A</SHORT-NAME>
                <MEMORY-ALLOCATION-KEYWORD-POLICY>ADDR-METHOD-SHORT-NAME-AND-ALIGNMENT</MEMORY-ALLOCATION-KEYWORD-POLICY>
                <OPTIONS>
                  <OPTION>safetyAsilA</OPTION>
                </OPTIONS>
                <SECTION-INITIALIZATION-POLICY>INIT</SECTION-INITIALIZATION-POLICY>
                <SECTION-TYPE>VAR-FAST</SECTION-TYPE>
              </SW-ADDR-METHOD>
              <SW-ADDR-METHOD>
                <SHORT-NAME>VAR_FAST_ASIL_B</SHORT-NAME>
                <MEMORY-ALLOCATION-KEYWORD-POLICY>ADDR-METHOD-SHORT-NAME-AND-ALIGNMENT</MEMORY-ALLOCATION-KEYWORD-POLICY>
                <OPTIONS>
                  <OPTION>safetyAsilB</OPTION>
                </OPTIONS>
                <SECTION-INITIALIZATION-POLICY>INIT</SECTION-INITIALIZATION-POLICY>
                <SECTION-TYPE>VAR-FAST</SECTION-TYPE>
              </SW-ADDR-METHOD>
              <SW-ADDR-METHOD>
                <SHORT-NAME>VAR_FAST_ASIL_C</SHORT-NAME>
                <MEMORY-ALLOCATION-KEYWORD-POLICY>ADDR-METHOD-SHORT-NAME-AND-ALIGNMENT</MEMORY-ALLOCATION-KEYWORD-POLICY>
                <OPTIONS>
                  <OPTION>safetyAsilC</OPTION>
                </OPTIONS>
                <SECTION-INITIALIZATION-POLICY>INIT</SECTION-INITIALIZATION-POLICY>
                <SECTION-TYPE>VAR-FAST</SECTION-TYPE>
              </SW-ADDR-METHOD>
              <SW-ADDR-METHOD>
                <SHORT-NAME>VAR_FAST_ASIL_D</SHORT-NAME>
                <MEMORY-ALLOCATION-KEYWORD-POLICY>ADDR-METHOD-SHORT-NAME-AND-ALIGNMENT</MEMORY-ALLOCATION-KEYWORD-POLICY>
                <OPTIONS>
                  <OPTION>safetyAsilD</OPTION>
                </OPTIONS>
                <SECTION-INITIALIZATION-POLICY>INIT</SECTION-INITIALIZATION-POLICY>
                <SECTION-TYPE>VAR-FAST</SECTION-TYPE>
              </SW-ADDR-METHOD>
              <SW-ADDR-METHOD>
                <SHORT-NAME>VAR_FAST_LOCAL</SHORT-NAME>
                <MEMORY-ALLOCATION-KEYWORD-POLICY>ADDR-METHOD-SHORT-NAME-AND-ALIGNMENT</MEMORY-ALLOCATION-KEYWORD-POLICY>
                <OPTIONS>
                  <OPTION>coreLocal</OPTION>
                </OPTIONS>
                <SECTION-INITIALIZATION-POLICY>INIT</SECTION-INITIALIZATION-POLICY>
                <SECTION-TYPE>VAR-FAST</SECTION-TYPE>
              </SW-ADDR-METHOD>
              <SW-ADDR-METHOD>
                <SHORT-NAME>VAR_FAST_ASIL_A_LOCAL</SHORT-NAME>
                <MEMORY-ALLOCATION-KEYWORD-POLICY>ADDR-METHOD-SHORT-NAME-AND-ALIGNMENT</MEMORY-ALLOCATION-KEYWORD-POLICY>
                <OPTIONS>
                  <OPTION>safetyAsilA</OPTION>
                  <OPTION>coreLocal</OPTION>
                </OPTIONS>
                <SECTION-INITIALIZATION-POLICY>INIT</SECTION-INITIALIZATION-POLICY>
                <SECTION-TYPE>VAR-FAST</SECTION-TYPE>
              </SW-ADDR-METHOD>
              <SW-ADDR-METHOD>
                <SHORT-NAME>VAR_FAST_ASIL_B_LOCAL</SHORT-NAME>
                <MEMORY-ALLOCATION-KEYWORD-POLICY>ADDR-METHOD-SHORT-NAME-AND-ALIGNMENT</MEMORY-ALLOCATION-KEYWORD-POLICY>
                <OPTIONS>
                  <OPTION>safetyAsilB</OPTION>
                  <OPTION>coreLocal</OPTION>
                </OPTIONS>
                <SECTION-INITIALIZATION-POLICY>INIT</SECTION-INITIALIZATION-POLICY>
                <SECTION-TYPE>VAR-FAST</SECTION-TYPE>
              </SW-ADDR-METHOD>
              <SW-ADDR-METHOD>
                <SHORT-NAME>VAR_FAST_ASIL_C_LOCAL</SHORT-NAME>
                <MEMORY-ALLOCATION-KEYWORD-POLICY>ADDR-METHOD-SHORT-NAME-AND-ALIGNMENT</MEMORY-ALLOCATION-KEYWORD-POLICY>
                <OPTIONS>
                  <OPTION>safetyAsilC</OPTION>
                  <OPTION>coreLocal</OPTION>
                </OPTIONS>
                <SECTION-INITIALIZATION-POLICY>INIT</SECTION-INITIALIZATION-POLICY>
                <SECTION-TYPE>VAR-FAST</SECTION-TYPE>
              </SW-ADDR-METHOD>
              <SW-ADDR-METHOD>
                <SHORT-NAME>VAR_FAST_ASIL_D_LOCAL</SHORT-NAME>
                <MEMORY-ALLOCATION-KEYWORD-POLICY>ADDR-METHOD-SHORT-NAME-AND-ALIGNMENT</MEMORY-ALLOCATION-KEYWORD-POLICY>
                <OPTIONS>
                  <OPTION>safetyAsilD</OPTION>
                  <OPTION>coreLocal</OPTION>
                </OPTIONS>
                <SECTION-INITIALIZATION-POLICY>INIT</SECTION-INITIALIZATION-POLICY>
                <SECTION-TYPE>VAR-FAST</SECTION-TYPE>
              </SW-ADDR-METHOD>
              <SW-ADDR-METHOD>
                <SHORT-NAME>CONST</SHORT-NAME>
                <MEMORY-ALLOCATION-KEYWORD-POLICY>ADDR-METHOD-SHORT-NAME-AND-ALIGNMENT</MEMORY-ALLOCATION-KEYWORD-POLICY>
                <SECTION-TYPE>CONST</SECTION-TYPE>
              </SW-ADDR-METHOD>
              <SW-ADDR-METHOD>
                <SHORT-NAME>CONST_ASIL_A</SHORT-NAME>
                <MEMORY-ALLOCATION-KEYWORD-POLICY>ADDR-METHOD-SHORT-NAME-AND-ALIGNMENT</MEMORY-ALLOCATION-KEYWORD-POLICY>
                <OPTIONS>
                  <OPTION>safetyAsilA</OPTION>
                </OPTIONS>
                <SECTION-TYPE>CONST</SECTION-TYPE>
              </SW-ADDR-METHOD>
              <SW-ADDR-METHOD>
                <SHORT-NAME>CONST_ASIL_B</SHORT-NAME>
                <MEMORY-ALLOCATION-KEYWORD-POLICY>ADDR-METHOD-SHORT-NAME-AND-ALIGNMENT</MEMORY-ALLOCATION-KEYWORD-POLICY>
                <OPTIONS>
                  <OPTION>safetyAsilB</OPTION>
                </OPTIONS>
                <SECTION-TYPE>CONST</SECTION-TYPE>
              </SW-ADDR-METHOD>
              <SW-ADDR-METHOD>
                <SHORT-NAME>CONST_ASIL_C</SHORT-NAME>
                <MEMORY-ALLOCATION-KEYWORD-POLICY>ADDR-METHOD-SHORT-NAME-AND-ALIGNMENT</MEMORY-ALLOCATION-KEYWORD-POLICY>
                <OPTIONS>
                  <OPTION>safetyAsilC</OPTION>
                </OPTIONS>
                <SECTION-TYPE>CONST</SECTION-TYPE>
              </SW-ADDR-METHOD>
              <SW-ADDR-METHOD>
                <SHORT-NAME>CONST_ASIL_D</SHORT-NAME>
                <MEMORY-ALLOCATION-KEYWORD-POLICY>ADDR-METHOD-SHORT-NAME-AND-ALIGNMENT</MEMORY-ALLOCATION-KEYWORD-POLICY>
                <OPTIONS>
                  <OPTION>safetyAsilD</OPTION>
                </OPTIONS>
                <SECTION-TYPE>CONST</SECTION-TYPE>
              </SW-ADDR-METHOD>
              <SW-ADDR-METHOD>
                <SHORT-NAME>CALIB</SHORT-NAME>
                <MEMORY-ALLOCATION-KEYWORD-POLICY>ADDR-METHOD-SHORT-NAME-AND-ALIGNMENT</MEMORY-ALLOCATION-KEYWORD-POLICY>
                <SECTION-INITIALIZATION-POLICY>INIT</SECTION-INITIALIZATION-POLICY>
                <SECTION-TYPE>CALPRM</SECTION-TYPE>
              </SW-ADDR-METHOD>
              <SW-ADDR-METHOD>
                <SHORT-NAME>CALIB_ASIL_A</SHORT-NAME>
                <MEMORY-ALLOCATION-KEYWORD-POLICY>ADDR-METHOD-SHORT-NAME-AND-ALIGNMENT</MEMORY-ALLOCATION-KEYWORD-POLICY>
                <OPTIONS>
                  <OPTION>safetyAsilA</OPTION>
                </OPTIONS>
                <SECTION-INITIALIZATION-POLICY>INIT</SECTION-INITIALIZATION-POLICY>
                <SECTION-TYPE>CALPRM</SECTION-TYPE>
              </SW-ADDR-METHOD>
              <SW-ADDR-METHOD>
                <SHORT-NAME>CALIB_ASIL_B</SHORT-NAME>
                <MEMORY-ALLOCATION-KEYWORD-POLICY>ADDR-METHOD-SHORT-NAME-AND-ALIGNMENT</MEMORY-ALLOCATION-KEYWORD-POLICY>
                <OPTIONS>
                  <OPTION>safetyAsilB</OPTION>
                </OPTIONS>
                <SECTION-INITIALIZATION-POLICY>INIT</SECTION-INITIALIZATION-POLICY>
                <SECTION-TYPE>CALPRM</SECTION-TYPE>
              </SW-ADDR-METHOD>
              <SW-ADDR-METHOD>
                <SHORT-NAME>CALIB_ASIL_C</SHORT-NAME>
                <MEMORY-ALLOCATION-KEYWORD-POLICY>ADDR-METHOD-SHORT-NAME-AND-ALIGNMENT</MEMORY-ALLOCATION-KEYWORD-POLICY>
                <OPTIONS>
                  <OPTION>safetyAsilC</OPTION>
                </OPTIONS>
                <SECTION-INITIALIZATION-POLICY>INIT</SECTION-INITIALIZATION-POLICY>
                <SECTION-TYPE>CALPRM</SECTION-TYPE>
              </SW-ADDR-METHOD>
              <SW-ADDR-METHOD>
                <SHORT-NAME>CALIB_ASIL_D</SHORT-NAME>
                <MEMORY-ALLOCATION-KEYWORD-POLICY>ADDR-METHOD-SHORT-NAME-AND-ALIGNMENT</MEMORY-ALLOCATION-KEYWORD-POLICY>
                <OPTIONS>
                  <OPTION>safetyAsilD</OPTION>
                </OPTIONS>
                <SECTION-INITIALIZATION-POLICY>INIT</SECTION-INITIALIZATION-POLICY>
                <SECTION-TYPE>CALPRM</SECTION-TYPE>
              </SW-ADDR-METHOD>
              <SW-ADDR-METHOD>
                <SHORT-NAME>CONFIG_DATA</SHORT-NAME>
                <MEMORY-ALLOCATION-KEYWORD-POLICY>ADDR-METHOD-SHORT-NAME-AND-ALIGNMENT</MEMORY-ALLOCATION-KEYWORD-POLICY>
                <SECTION-TYPE>CONFIG-DATA</SECTION-TYPE>
              </SW-ADDR-METHOD>
              <SW-ADDR-METHOD>
                <SHORT-NAME>CONFIG_DATA_ASIL_A</SHORT-NAME>
                <MEMORY-ALLOCATION-KEYWORD-POLICY>ADDR-METHOD-SHORT-NAME-AND-ALIGNMENT</MEMORY-ALLOCATION-KEYWORD-POLICY>
                <OPTIONS>
                  <OPTION>safetyAsilA</OPTION>
                </OPTIONS>
                <SECTION-TYPE>CONFIG-DATA</SECTION-TYPE>
              </SW-ADDR-METHOD>
              <SW-ADDR-METHOD>
                <SHORT-NAME>CONFIG_DATA_ASIL_B</SHORT-NAME>
                <MEMORY-ALLOCATION-KEYWORD-POLICY>ADDR-METHOD-SHORT-NAME-AND-ALIGNMENT</MEMORY-ALLOCATION-KEYWORD-POLICY>
                <OPTIONS>
                  <OPTION>safetyAsilB</OPTION>
                </OPTIONS>
                <SECTION-TYPE>CONFIG-DATA</SECTION-TYPE>
              </SW-ADDR-METHOD>
              <SW-ADDR-METHOD>
                <SHORT-NAME>CONFIG_DATA_ASIL_C</SHORT-NAME>
                <MEMORY-ALLOCATION-KEYWORD-POLICY>ADDR-METHOD-SHORT-NAME-AND-ALIGNMENT</MEMORY-ALLOCATION-KEYWORD-POLICY>
                <OPTIONS>
                  <OPTION>safetyAsilC</OPTION>
                </OPTIONS>
                <SECTION-TYPE>CONFIG-DATA</SECTION-TYPE>
              </SW-ADDR-METHOD>
              <SW-ADDR-METHOD>
                <SHORT-NAME>CONFIG_DATA_ASIL_D</SHORT-NAME>
                <MEMORY-ALLOCATION-KEYWORD-POLICY>ADDR-METHOD-SHORT-NAME-AND-ALIGNMENT</MEMORY-ALLOCATION-KEYWORD-POLICY>
                <OPTIONS>
                  <OPTION>safetyAsilD</OPTION>
                </OPTIONS>
                <SECTION-TYPE>CONFIG-DATA</SECTION-TYPE>
              </SW-ADDR-METHOD>
            </ELEMENTS>
