<?xml version="1.0" encoding="UTF-8"?>
<AUTOSAR xmlns="http://autosar.org/schema/r4.0"
  xmlns:xsi="http://www.w3.org/2001/XMLSchema-instance"
  xsi:schemaLocation="http://autosar.org/schema/r4.0 AUTOSAR_4-0-3_STRICT_COMPACT.xsd">
[!/* do not generate this file if RTE is not used */!]
[!SKIPFILE "as:modconf('DoIP')[1]/DoIPGeneral/DoIPRteUsage != 'true'"!]
  <AR-PACKAGES>
    <AR-PACKAGE>
      <SHORT-NAME>AUTOSAR_DoIP</SHORT-NAME>
      <ELEMENTS/>
      <AR-PACKAGES>
        <AR-PACKAGE>
          <SHORT-NAME>PortInterfaces</SHORT-NAME>
          <ELEMENTS>
[!IF "node:empty(as:modconf('DoIP')[1]/DoIPGeneral/DoIPPowerModeCallback/DoIPPowerMode)"!][!//
            <CLIENT-SERVER-INTERFACE>
              <!-- !LINKSTO DoIP.ASR41.SWS_DoIP_00054,1 -->
              <SHORT-NAME>CallbackGetPowerMode</SHORT-NAME>
              <IS-SERVICE>true</IS-SERVICE>

              <OPERATIONS>
                <CLIENT-SERVER-OPERATION>
                  <SHORT-NAME>GetPowerMode</SHORT-NAME>
                  <ARGUMENTS>
                    <ARGUMENT-DATA-PROTOTYPE>
                      <SHORT-NAME>PowerStateReady</SHORT-NAME>
                      <TYPE-TREF DEST="IMPLEMENTATION-DATA-TYPE">/AUTOSAR_DoIP/ImplementationDataTypes/DoIP_PowerStateType</TYPE-TREF>
                      <DIRECTION>OUT</DIRECTION>
                    </ARGUMENT-DATA-PROTOTYPE>
                  </ARGUMENTS>
                  <POSSIBLE-ERROR-REFS>
                    <POSSIBLE-ERROR-REF DEST="APPLICATION-ERROR">/AUTOSAR_DoIP/PortInterfaces/CallbackGetPowerMode/E_NOT_OK</POSSIBLE-ERROR-REF>
                  </POSSIBLE-ERROR-REFS>
                </CLIENT-SERVER-OPERATION>
              </OPERATIONS>

              <POSSIBLE-ERRORS>
                <APPLICATION-ERROR>
                  <SHORT-NAME>E_NOT_OK</SHORT-NAME>
                  <ERROR-CODE>1</ERROR-CODE>
                </APPLICATION-ERROR>
              </POSSIBLE-ERRORS>
            </CLIENT-SERVER-INTERFACE>
[!ENDIF!][!//
[!LOOP "as:modconf('DoIP')[1]/DoIPConfigSet/*[1]/DoIPRoutingActivation/*"!][!//
[!IF "(node:exists(./DoIPRoutingActivationAuthenticationCallback) and node:empty(./DoIPRoutingActivationAuthenticationCallback/DoIPRoutingActivationAuthenticationFunc)) or (node:exists(./DoIPRoutingActivationConfirmationCallback) and node:empty(./DoIPRoutingActivationConfirmationCallback/DoIPRoutingActivationConfirmationFunc))"!][!//
            <CLIENT-SERVER-INTERFACE>
              <!-- !LINKSTO DoIP.ASR41.SWS_DoIP_00055,1 -->
              <SHORT-NAME>[!"node:name(.)"!]_RoutingActivation</SHORT-NAME>
              <IS-SERVICE>true</IS-SERVICE>
              <OPERATIONS>
[!IF "node:exists(./DoIPRoutingActivationAuthenticationCallback) and node:empty(./DoIPRoutingActivationAuthenticationCallback/DoIPRoutingActivationAuthenticationFunc)"!][!//
                <CLIENT-SERVER-OPERATION>
                  <SHORT-NAME>RoutingActivationAuthentication</SHORT-NAME>
                  <ARGUMENTS>
                    <ARGUMENT-DATA-PROTOTYPE>
                      <SHORT-NAME>Authentified</SHORT-NAME>
                      <TYPE-TREF DEST="IMPLEMENTATION-DATA-TYPE">/AUTOSAR_Platform/ImplementationDataTypes/boolean</TYPE-TREF>
                      <DIRECTION>OUT</DIRECTION>
                    </ARGUMENT-DATA-PROTOTYPE>
[!IF "./DoIPRoutingActivationAuthenticationCallback/DoIPRoutingActivationAuthenticationReqLength > 0"!][!//
                    <ARGUMENT-DATA-PROTOTYPE>
                      <SHORT-NAME>AuthenticationReqData</SHORT-NAME>
                      <TYPE-TREF DEST="IMPLEMENTATION-DATA-TYPE">/AUTOSAR_DoIP/ImplementationDataTypes/AuthenticationReqDataType_[!"node:name(.)"!]</TYPE-TREF>
                      <DIRECTION>IN</DIRECTION>
                    </ARGUMENT-DATA-PROTOTYPE>
[!ENDIF!][!//
[!IF "./DoIPRoutingActivationAuthenticationCallback/DoIPRoutingActivationAuthenticationResLength > 0"!][!//
                    <ARGUMENT-DATA-PROTOTYPE>
                      <SHORT-NAME>AuthenticationResData</SHORT-NAME>
                      <TYPE-TREF DEST="IMPLEMENTATION-DATA-TYPE">/AUTOSAR_DoIP/ImplementationDataTypes/AuthenticationResDataType_[!"node:name(.)"!]</TYPE-TREF>
                      <DIRECTION>OUT</DIRECTION>
                    </ARGUMENT-DATA-PROTOTYPE>
[!ENDIF!][!//
                  </ARGUMENTS>
                  <POSSIBLE-ERROR-REFS>
                    <POSSIBLE-ERROR-REF DEST="APPLICATION-ERROR">/AUTOSAR_DoIP/PortInterfaces/[!"node:name(.)"!]_RoutingActivation/E_NOT_OK</POSSIBLE-ERROR-REF>
                    <POSSIBLE-ERROR-REF DEST="APPLICATION-ERROR">/AUTOSAR_DoIP/PortInterfaces/[!"node:name(.)"!]_RoutingActivation/DOIP_E_PENDING</POSSIBLE-ERROR-REF>
                  </POSSIBLE-ERROR-REFS>
                </CLIENT-SERVER-OPERATION>
[!ENDIF!][!//
[!IF "node:exists(./DoIPRoutingActivationConfirmationCallback) and node:empty(./DoIPRoutingActivationConfirmationCallback/DoIPRoutingActivationConfirmationFunc)"!][!//
                <CLIENT-SERVER-OPERATION>
                  <SHORT-NAME>RoutingActivationConfirmation</SHORT-NAME>
                  <ARGUMENTS>
                    <ARGUMENT-DATA-PROTOTYPE>
                      <SHORT-NAME>Confirmed</SHORT-NAME>
                      <TYPE-TREF DEST="IMPLEMENTATION-DATA-TYPE">/AUTOSAR_Platform/ImplementationDataTypes/boolean</TYPE-TREF>
                      <DIRECTION>OUT</DIRECTION>
                    </ARGUMENT-DATA-PROTOTYPE>
[!IF "./DoIPRoutingActivationConfirmationCallback/DoIPRoutingActivationConfirmationReqLength > 0"!][!//
                    <ARGUMENT-DATA-PROTOTYPE>
                      <SHORT-NAME>ConfirmationReqData</SHORT-NAME>
                      <TYPE-TREF DEST="IMPLEMENTATION-DATA-TYPE">/AUTOSAR_DoIP/ImplementationDataTypes/ConfirmationReqDataType_[!"node:name(.)"!]</TYPE-TREF>
                      <DIRECTION>IN</DIRECTION>
                    </ARGUMENT-DATA-PROTOTYPE>
[!ENDIF!][!//
[!IF "./DoIPRoutingActivationConfirmationCallback/DoIPRoutingActivationConfirmationResLength > 0"!][!//
                    <ARGUMENT-DATA-PROTOTYPE>
                      <SHORT-NAME>ConfirmationResData</SHORT-NAME>
                      <TYPE-TREF DEST="IMPLEMENTATION-DATA-TYPE">/AUTOSAR_DoIP/ImplementationDataTypes/ConfirmationResDataType_[!"node:name(.)"!]</TYPE-TREF>
                      <DIRECTION>OUT</DIRECTION>
                    </ARGUMENT-DATA-PROTOTYPE>
[!ENDIF!][!//
                  </ARGUMENTS>
                  <POSSIBLE-ERROR-REFS>
                    <POSSIBLE-ERROR-REF DEST="APPLICATION-ERROR">/AUTOSAR_DoIP/PortInterfaces/[!"node:name(.)"!]_RoutingActivation/E_NOT_OK</POSSIBLE-ERROR-REF>
                    <POSSIBLE-ERROR-REF DEST="APPLICATION-ERROR">/AUTOSAR_DoIP/PortInterfaces/[!"node:name(.)"!]_RoutingActivation/DOIP_E_PENDING</POSSIBLE-ERROR-REF>
                  </POSSIBLE-ERROR-REFS>
                </CLIENT-SERVER-OPERATION>
[!ENDIF!][!//
              </OPERATIONS>
              <POSSIBLE-ERRORS>
                <APPLICATION-ERROR>
                  <SHORT-NAME>E_NOT_OK</SHORT-NAME>
                  <ERROR-CODE>1</ERROR-CODE>
                </APPLICATION-ERROR>
                <APPLICATION-ERROR>
                  <SHORT-NAME>DOIP_E_PENDING</SHORT-NAME>
                  <ERROR-CODE>16</ERROR-CODE>
                </APPLICATION-ERROR>
              </POSSIBLE-ERRORS>
            </CLIENT-SERVER-INTERFACE>
[!ENDIF!][!//
[!ENDLOOP!][!//
            <CLIENT-SERVER-INTERFACE>
              <!-- !LINKSTO DoIP.EB.SWS_DoIP_00242,1 -->
              <SHORT-NAME>DoIPActivationLineStatus</SHORT-NAME>
              <IS-SERVICE>true</IS-SERVICE>

              <OPERATIONS>
                <CLIENT-SERVER-OPERATION>
                  <SHORT-NAME>ActivationLineSwitchActive</SHORT-NAME>
                  <ARGUMENTS>
                  </ARGUMENTS>
                  <POSSIBLE-ERROR-REFS>
                  </POSSIBLE-ERROR-REFS>
                </CLIENT-SERVER-OPERATION>

                <CLIENT-SERVER-OPERATION>
                  <SHORT-NAME>ActivationLineSwitchInactive</SHORT-NAME>
                  <ARGUMENTS>
                  </ARGUMENTS>
                  <POSSIBLE-ERROR-REFS>
                  </POSSIBLE-ERROR-REFS>
                </CLIENT-SERVER-OPERATION>                
              </OPERATIONS>              

              <POSSIBLE-ERRORS>
              </POSSIBLE-ERRORS>
            </CLIENT-SERVER-INTERFACE>

          </ELEMENTS>
        </AR-PACKAGE>
      </AR-PACKAGES>
    </AR-PACKAGE>
  </AR-PACKAGES>
</AUTOSAR>
