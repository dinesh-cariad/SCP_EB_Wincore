<?xml version="1.0" encoding="UTF-8"?>
<AUTOSAR xmlns="http://autosar.org/schema/r4.0"
         xmlns:xsi="http://www.w3.org/2001/XMLSchema-instance"
         xsi:schemaLocation="http://autosar.org/schema/r4.0 AUTOSAR_4-0-3_STRICT_COMPACT.xsd">
[!/* do not generate this file if RTE is not used */!][!//
[!SKIPFILE "SecOCGeneral/SecOCRteUsage = 'false'"!][!//
  <AR-PACKAGES>
    <AR-PACKAGE>
      <SHORT-NAME>AUTOSAR_SecOC</SHORT-NAME>
      <AR-PACKAGES>
        <AR-PACKAGE>
          <SHORT-NAME>SwComponentTypes</SHORT-NAME>
          <ELEMENTS>
            <SERVICE-SW-COMPONENT-TYPE>
              <SHORT-NAME>SecOC</SHORT-NAME>
              <PORTS>
[!IF "node:value(SecOCGeneral/SecOCQueryFreshnessValue) = 'RTE'"!][!//
[!IF "count(SecOCTxPduProcessing/*) > 0"!][!//
                <!-- !LINKSTO SWS_SecOC_Tx_91001,4, SecOC.Dsn.interface.Tx.TxFreshnessManagement, 4, SecOC.Dsn.interface.Tx.TxFreshnessManagement_2, 2 -->
                <R-PORT-PROTOTYPE>
                  <SHORT-NAME>PS_TxFreshnessManagement</SHORT-NAME>
                  <REQUIRED-INTERFACE-TREF DEST="CLIENT-SERVER-INTERFACE">/AUTOSAR_SecOC/PortInterfaces/TxFreshnessManagement</REQUIRED-INTERFACE-TREF>
                </R-PORT-PROTOTYPE>
[!ENDIF!][!//
[!IF "count(SecOCRxPduProcessing/*) > 0"!][!//
                <!-- !LINKSTO SWS_SecOC_Rx_91001,4, SecOC.Dsn.interface.Rx.RxFreshnessManagement, 4, SecOC.Dsn.interface.Rx.RxFreshnessManagement_2, 2 -->
                <R-PORT-PROTOTYPE>
                  <SHORT-NAME>PS_RxFreshnessManagement</SHORT-NAME>
                  <REQUIRED-INTERFACE-TREF DEST="CLIENT-SERVER-INTERFACE">/AUTOSAR_SecOC/PortInterfaces/RxFreshnessManagement</REQUIRED-INTERFACE-TREF>
                </R-PORT-PROTOTYPE>
[!ENDIF!][!//
[!ENDIF!][!//
[!IF "node:value(SecOCGeneral/SecOCPropagateVerificationStatus) != 'NONE'"!][!//
                <!-- !LINKSTO SecOC.Dsn.interface.Rx.VerificationStatusExistence,3 -->
                <P-PORT-PROTOTYPE>
                  <SHORT-NAME>PS_VerificationStatus</SHORT-NAME>
                  <PROVIDED-INTERFACE-TREF DEST="SENDER-RECEIVER-INTERFACE">/AUTOSAR_SecOC/PortInterfaces/VerificationStatus</PROVIDED-INTERFACE-TREF>
                </P-PORT-PROTOTYPE>
[!ENDIF!][!//
[!IF "count(SecOCTxPduProcessing/*[node:value(SecOCMacGenerateStatusPropagationMode) != 'NONE']) > 0"!][!//
                <!-- !LINKSTO SecOC.Dsn.interface.Tx.MacGenerateStatusExistence,2 -->
                <P-PORT-PROTOTYPE>
                  <SHORT-NAME>PS_MacGenerateStatus</SHORT-NAME>
                  <PROVIDED-INTERFACE-TREF DEST="SENDER-RECEIVER-INTERFACE">/AUTOSAR_SecOC/PortInterfaces/MacGenerateStatus</PROVIDED-INTERFACE-TREF>
                </P-PORT-PROTOTYPE>
[!ENDIF!][!//
[!IF "count(SecOCRxPduProcessing/*) > 0"!][!//
                <!-- !LINKSTO SecOC.Dsn.interface.Rx.VerifyStatusConfiguration,1 -->
                <P-PORT-PROTOTYPE>
                  <SHORT-NAME>PS_VerifyStatusConfiguration</SHORT-NAME>
                  <PROVIDED-INTERFACE-TREF DEST="CLIENT-SERVER-INTERFACE">/AUTOSAR_SecOC/PortInterfaces/VerifyStatusConfiguration</PROVIDED-INTERFACE-TREF>
                </P-PORT-PROTOTYPE>
[!ENDIF!][!//
              </PORTS>
              <INTERNAL-BEHAVIORS>
                <SWC-INTERNAL-BEHAVIOR>
                  <SHORT-NAME>SecOCInternalBehavior</SHORT-NAME>
                  <EVENTS>                    
[!IF "count(SecOCRxPduProcessing/*) > 0"!][!//
                    <OPERATION-INVOKED-EVENT>
                      <SHORT-NAME>EV_VerifyStatusOverride_[!"name(.)"!]</SHORT-NAME>
                      <START-ON-EVENT-REF DEST="RUNNABLE-ENTITY">/AUTOSAR_SecOC/SwComponentTypes/SecOC/SecOCInternalBehavior/RE_VerifyStatusOverride</START-ON-EVENT-REF>
                      <OPERATION-IREF>
                        <CONTEXT-P-PORT-REF DEST="P-PORT-PROTOTYPE">/AUTOSAR_SecOC/SwComponentTypes/SecOC/PS_VerifyStatusConfiguration</CONTEXT-P-PORT-REF>
                        <TARGET-PROVIDED-OPERATION-REF DEST="CLIENT-SERVER-OPERATION">/AUTOSAR_SecOC/PortInterfaces/VerifyStatusConfiguration/VerifyStatusOverride</TARGET-PROVIDED-OPERATION-REF>
                      </OPERATION-IREF>
                    </OPERATION-INVOKED-EVENT>
[!ENDIF!][!//
                  </EVENTS>
                  <HANDLE-TERMINATION-AND-RESTART>NO-SUPPORT</HANDLE-TERMINATION-AND-RESTART>
                  <RUNNABLES>
 [!IF "count(SecOCRxPduProcessing/*) > 0"!][!//
                    <RUNNABLE-ENTITY>
                      <SHORT-NAME>RE_VerifyStatusOverride</SHORT-NAME>
                      <MINIMUM-START-INTERVAL>0</MINIMUM-START-INTERVAL>
                      <ARGUMENTS>
                        <RUNNABLE-ENTITY-ARGUMENT>
                          <SYMBOL>freshnessValueId</SYMBOL>
                        </RUNNABLE-ENTITY-ARGUMENT>
                        <RUNNABLE-ENTITY-ARGUMENT>
                          <SYMBOL>overrideStatus</SYMBOL>
                        </RUNNABLE-ENTITY-ARGUMENT>
                        <RUNNABLE-ENTITY-ARGUMENT>
                          <SYMBOL>numberOfMessagesToOverride</SYMBOL>
                        </RUNNABLE-ENTITY-ARGUMENT>
                      </ARGUMENTS>
                      <CAN-BE-INVOKED-CONCURRENTLY>false</CAN-BE-INVOKED-CONCURRENTLY>
                      <SYMBOL>SecOC_VerifyStatusOverride</SYMBOL>
                    </RUNNABLE-ENTITY>
[!ENDIF!][!//
                    <RUNNABLE-ENTITY>
                      <SHORT-NAME>RE_MainFunctionRx</SHORT-NAME>
                      <MINIMUM-START-INTERVAL>0</MINIMUM-START-INTERVAL>
                      <CAN-BE-INVOKED-CONCURRENTLY>false</CAN-BE-INVOKED-CONCURRENTLY>
[!IF "node:value(SecOCGeneral/SecOCPropagateVerificationStatus) != 'NONE'"!][!//
                      <DATA-SEND-POINTS>
                        <VARIABLE-ACCESS>
                          <SHORT-NAME>DSP_VerificationStatus</SHORT-NAME>
                          <ACCESSED-VARIABLE>
                            <AUTOSAR-VARIABLE-IREF>
                              <PORT-PROTOTYPE-REF DEST="P-PORT-PROTOTYPE">/AUTOSAR_SecOC/SwComponentTypes/SecOC/PS_VerificationStatus</PORT-PROTOTYPE-REF>
                              <TARGET-DATA-PROTOTYPE-REF DEST="VARIABLE-DATA-PROTOTYPE">/AUTOSAR_SecOC/PortInterfaces/VerificationStatus/verificationStatus</TARGET-DATA-PROTOTYPE-REF>
                            </AUTOSAR-VARIABLE-IREF>
                          </ACCESSED-VARIABLE>
                        </VARIABLE-ACCESS>
                      </DATA-SEND-POINTS>
[!ENDIF!][!//
[!IF "node:value(SecOCGeneral/SecOCQueryFreshnessValue) = 'RTE'"!][!//
                      <SERVER-CALL-POINTS>
[!IF "count(SecOCRxPduProcessing/*[SecOCUseAuthDataFreshness = 'false']) > 0"!][!//  
                        <SYNCHRONOUS-SERVER-CALL-POINT>
                          <SHORT-NAME>SSCP_GetRxFreshness</SHORT-NAME>
                          <OPERATION-IREF>
                            <CONTEXT-R-PORT-REF DEST="R-PORT-PROTOTYPE">/AUTOSAR_SecOC/SwComponentTypes/SecOC/PS_RxFreshnessManagement</CONTEXT-R-PORT-REF>
                            <TARGET-REQUIRED-OPERATION-REF DEST="CLIENT-SERVER-OPERATION">/AUTOSAR_SecOC/PortInterfaces/RxFreshnessManagement/GetRxFreshness</TARGET-REQUIRED-OPERATION-REF>
                          </OPERATION-IREF>
                          <TIMEOUT>0</TIMEOUT>
                        </SYNCHRONOUS-SERVER-CALL-POINT>
[!ENDIF!][!//
[!IF "count(SecOCRxPduProcessing/*[SecOCUseAuthDataFreshness = 'true']) > 0"!][!//
                        <SYNCHRONOUS-SERVER-CALL-POINT>
                          <SHORT-NAME>SSCP_GetRxFreshnessAuthData</SHORT-NAME>
                          <OPERATION-IREF>
                            <CONTEXT-R-PORT-REF DEST="R-PORT-PROTOTYPE">/AUTOSAR_SecOC/SwComponentTypes/SecOC/PS_RxFreshnessManagement</CONTEXT-R-PORT-REF>
                            <TARGET-REQUIRED-OPERATION-REF DEST="CLIENT-SERVER-OPERATION">/AUTOSAR_SecOC/PortInterfaces/RxFreshnessManagement/GetRxFreshnessAuthData</TARGET-REQUIRED-OPERATION-REF>
                          </OPERATION-IREF>
                          <TIMEOUT>0</TIMEOUT>
                        </SYNCHRONOUS-SERVER-CALL-POINT>
[!ENDIF!][!//
                      </SERVER-CALL-POINTS>
[!ENDIF!][!//
                      <SYMBOL>SecOC_MainFunctionRx</SYMBOL>
                    </RUNNABLE-ENTITY>
                    <RUNNABLE-ENTITY>
                      <SHORT-NAME>RE_MainFunctionTx</SHORT-NAME>
                      <MINIMUM-START-INTERVAL>0</MINIMUM-START-INTERVAL>
                      <CAN-BE-INVOKED-CONCURRENTLY>false</CAN-BE-INVOKED-CONCURRENTLY>
[!IF "count(SecOCTxPduProcessing/*[node:value(SecOCMacGenerateStatusPropagationMode) != 'NONE']) > 0"!][!//
                      <DATA-SEND-POINTS>
                        <VARIABLE-ACCESS>
                          <SHORT-NAME>DSP_MacGenerateStatus</SHORT-NAME>
                          <ACCESSED-VARIABLE>
                            <AUTOSAR-VARIABLE-IREF>
                              <PORT-PROTOTYPE-REF DEST="P-PORT-PROTOTYPE">/AUTOSAR_SecOC/SwComponentTypes/SecOC/PS_MacGenerateStatus</PORT-PROTOTYPE-REF>
                              <TARGET-DATA-PROTOTYPE-REF DEST="VARIABLE-DATA-PROTOTYPE">/AUTOSAR_SecOC/PortInterfaces/MacGenerateStatus/macGenerateStatus</TARGET-DATA-PROTOTYPE-REF>
                            </AUTOSAR-VARIABLE-IREF>
                          </ACCESSED-VARIABLE>
                        </VARIABLE-ACCESS>
                      </DATA-SEND-POINTS>
[!ENDIF!][!//
[!IF "node:value(SecOCGeneral/SecOCQueryFreshnessValue) = 'RTE'"!][!//
                      <SERVER-CALL-POINTS>
[!IF "count(SecOCTxPduProcessing/*[SecOCProvideTxTruncatedFreshnessValue = 'false']) > 0"!][!//   
                        <SYNCHRONOUS-SERVER-CALL-POINT>
                          <SHORT-NAME>SSCP_GetTxFreshness</SHORT-NAME>
                          <OPERATION-IREF>
                            <CONTEXT-R-PORT-REF DEST="R-PORT-PROTOTYPE">/AUTOSAR_SecOC/SwComponentTypes/SecOC/PS_TxFreshnessManagement</CONTEXT-R-PORT-REF>
                            <TARGET-REQUIRED-OPERATION-REF DEST="CLIENT-SERVER-OPERATION">/AUTOSAR_SecOC/PortInterfaces/TxFreshnessManagement/GetTxFreshness</TARGET-REQUIRED-OPERATION-REF>
                          </OPERATION-IREF>
                          <TIMEOUT>0</TIMEOUT>
                        </SYNCHRONOUS-SERVER-CALL-POINT>
[!ENDIF!][!//
[!IF "count(SecOCTxPduProcessing/*[SecOCProvideTxTruncatedFreshnessValue = 'true']) > 0"!][!//
                        <SYNCHRONOUS-SERVER-CALL-POINT>
                          <SHORT-NAME>SSCP_GetTxFreshnessTruncData</SHORT-NAME>
                          <OPERATION-IREF>
                            <CONTEXT-R-PORT-REF DEST="R-PORT-PROTOTYPE">/AUTOSAR_SecOC/SwComponentTypes/SecOC/PS_TxFreshnessManagement</CONTEXT-R-PORT-REF>
                            <TARGET-REQUIRED-OPERATION-REF DEST="CLIENT-SERVER-OPERATION">/AUTOSAR_SecOC/PortInterfaces/TxFreshnessManagement/GetTxFreshnessTruncData</TARGET-REQUIRED-OPERATION-REF>
                          </OPERATION-IREF>
                          <TIMEOUT>0</TIMEOUT>
                        </SYNCHRONOUS-SERVER-CALL-POINT>
[!ENDIF!][!//
[!IF "count(SecOCTxPduProcessing/*) > 0"!][!//
                        <SYNCHRONOUS-SERVER-CALL-POINT>
                          <SHORT-NAME>SSCP_SPduTxConfirmation</SHORT-NAME>
                          <OPERATION-IREF>
                            <CONTEXT-R-PORT-REF DEST="R-PORT-PROTOTYPE">/AUTOSAR_SecOC/SwComponentTypes/SecOC/PS_TxFreshnessManagement</CONTEXT-R-PORT-REF>
                            <TARGET-REQUIRED-OPERATION-REF DEST="CLIENT-SERVER-OPERATION">/AUTOSAR_SecOC/PortInterfaces/TxFreshnessManagement/SPduTxConfirmation</TARGET-REQUIRED-OPERATION-REF>
                          </OPERATION-IREF>
                          <TIMEOUT>0</TIMEOUT>
                        </SYNCHRONOUS-SERVER-CALL-POINT>
[!ENDIF!][!//
                      </SERVER-CALL-POINTS>
[!ENDIF!][!//
                      <SYMBOL>SecOC_MainFunctionTx</SYMBOL>
                    </RUNNABLE-ENTITY>
                  </RUNNABLES>
                  <SUPPORTS-MULTIPLE-INSTANTIATION>false</SUPPORTS-MULTIPLE-INSTANTIATION>
                </SWC-INTERNAL-BEHAVIOR>
              </INTERNAL-BEHAVIORS>
            </SERVICE-SW-COMPONENT-TYPE>
          </ELEMENTS>
        </AR-PACKAGE>
      </AR-PACKAGES>
    </AR-PACKAGE>
    <AR-PACKAGE>
      <SHORT-NAME>EB_SecOC</SHORT-NAME>
      <AR-PACKAGES>
        <AR-PACKAGE>
          <SHORT-NAME>SwcImplementations</SHORT-NAME>
          <ELEMENTS>
            <SWC-IMPLEMENTATION>
              <SHORT-NAME>SecOCImpl</SHORT-NAME>
              <CODE-DESCRIPTORS>
                <CODE>
                  <SHORT-NAME>SecOCCode</SHORT-NAME>
                  <ARTIFACT-DESCRIPTORS>
                    <AUTOSAR-ENGINEERING-OBJECT>
                      <SHORT-LABEL>EngObject</SHORT-LABEL>
                      <CATEGORY>SWSRC</CATEGORY>
                    </AUTOSAR-ENGINEERING-OBJECT>
                  </ARTIFACT-DESCRIPTORS>
                </CODE>
              </CODE-DESCRIPTORS>
              <PROGRAMMING-LANGUAGE>C</PROGRAMMING-LANGUAGE>
              <RESOURCE-CONSUMPTION>
                <SHORT-NAME>Resources</SHORT-NAME>
                <MEMORY-SECTIONS>
                  <MEMORY-SECTION>
                    <SHORT-NAME>CODE</SHORT-NAME>
                    <SW-ADDRMETHOD-REF DEST="SW-ADDR-METHOD">/AUTOSAR_MemMap/SwAddrMethods/CODE</SW-ADDRMETHOD-REF>
                  </MEMORY-SECTION>
                </MEMORY-SECTIONS>
              </RESOURCE-CONSUMPTION>
              <SW-VERSION>2.7.4</SW-VERSION>
              <VENDOR-ID>1</VENDOR-ID>
              <BEHAVIOR-REF DEST="SWC-INTERNAL-BEHAVIOR">/AUTOSAR_SecOC/SwComponentTypes/SecOC/SecOCInternalBehavior</BEHAVIOR-REF>
            </SWC-IMPLEMENTATION>
          </ELEMENTS>
        </AR-PACKAGE>
      </AR-PACKAGES>
    </AR-PACKAGE>
  </AR-PACKAGES>
</AUTOSAR>
