<?xml version="1.0" encoding="UTF-8"?>
<AUTOSAR xmlns="http://autosar.org/schema/r4.0"
         xmlns:xsi="http://www.w3.org/2001/XMLSchema-instance"
         xsi:schemaLocation="http://autosar.org/schema/r4.0 AUTOSAR_4-0-3_STRICT_COMPACT.xsd">
[!/* do not generate this file if RTE is not used */!][!//
[!IF "SecOCGeneral/SecOCRteUsage = 'false'"!][!//
  [!SKIPFILE!][!//
[!ELSE!][!//
  <AR-PACKAGES>
    <AR-PACKAGE>
      <SHORT-NAME>AUTOSAR_SecOC</SHORT-NAME>
      <ELEMENTS/>
      <AR-PACKAGES>
        <AR-PACKAGE>
          <SHORT-NAME>DataConstrs</SHORT-NAME>
          <ELEMENTS>
            <!-- !LINKSTO SWS_SecOC_RxTx_00162,1 -->
            <DATA-CONSTR>
              <SHORT-NAME>CONSTR_SecOC_StateType</SHORT-NAME>
              <DATA-CONSTR-RULES>
                <DATA-CONSTR-RULE>
                  <INTERNAL-CONSTRS>
                    <LOWER-LIMIT INTERVAL-TYPE="CLOSED">0</LOWER-LIMIT>
                    <UPPER-LIMIT INTERVAL-TYPE="CLOSED">1</UPPER-LIMIT>
                  </INTERNAL-CONSTRS>
                </DATA-CONSTR-RULE>
              </DATA-CONSTR-RULES>
            </DATA-CONSTR>
[!IF "node:value(SecOCGeneral/SecOCPropagateVerificationStatus) != 'NONE'"!][!//
            <!-- !LINKSTO SecOC.Dsn.interface.Rx.SecOC_VerificationResultType,3 -->
            <DATA-CONSTR>
              <SHORT-NAME>CONSTR_SecOC_VerificationResultType</SHORT-NAME>
              <DATA-CONSTR-RULES>
                <DATA-CONSTR-RULE>
                  <INTERNAL-CONSTRS>
                    <LOWER-LIMIT INTERVAL-TYPE="CLOSED">0</LOWER-LIMIT>
                    <UPPER-LIMIT INTERVAL-TYPE="CLOSED">8</UPPER-LIMIT>
                  </INTERNAL-CONSTRS>
                </DATA-CONSTR-RULE>
              </DATA-CONSTR-RULES>
            </DATA-CONSTR>
[!ENDIF!][!//
          </ELEMENTS>
        </AR-PACKAGE>
        <AR-PACKAGE>
          <SHORT-NAME>CompuMethods</SHORT-NAME>
          <ELEMENTS>
            <!-- !LINKSTO SWS_SecOC_RxTx_00162,1 -->
            <COMPU-METHOD>
              <SHORT-NAME>CM_SecOC_StateType</SHORT-NAME>
              <CATEGORY>TEXTTABLE</CATEGORY>
              <COMPU-INTERNAL-TO-PHYS>
                <COMPU-SCALES>
                  <COMPU-SCALE>
                    <LOWER-LIMIT INTERVAL-TYPE="CLOSED">0</LOWER-LIMIT>
                    <UPPER-LIMIT INTERVAL-TYPE="CLOSED">0</UPPER-LIMIT>
                    <COMPU-CONST>
                      <VT>SECOC_UNINIT</VT>
                    </COMPU-CONST>
                  </COMPU-SCALE>
                  <COMPU-SCALE>
                    <LOWER-LIMIT INTERVAL-TYPE="CLOSED">1</LOWER-LIMIT>
                    <UPPER-LIMIT INTERVAL-TYPE="CLOSED">1</UPPER-LIMIT>
                    <COMPU-CONST>
                      <VT>SECOC_INIT</VT>
                    </COMPU-CONST>
                  </COMPU-SCALE>
                </COMPU-SCALES>
              </COMPU-INTERNAL-TO-PHYS>
            </COMPU-METHOD>
[!IF "node:value(SecOCGeneral/SecOCPropagateVerificationStatus) != 'NONE'"!][!//
            <!-- !LINKSTO SecOC.Dsn.interface.Rx.SecOC_VerificationResultType,3 -->
            <COMPU-METHOD>
              <SHORT-NAME>CM_SecOC_VerificationResultType</SHORT-NAME>
              <CATEGORY>TEXTTABLE</CATEGORY>
              <COMPU-INTERNAL-TO-PHYS>
                <!-- !LINKSTO SecOC.Dsn.interface.Rx.SECOC_VERIFICATIONSUCCESS,1 -->
                <COMPU-SCALES>
                  <COMPU-SCALE>
                    <LOWER-LIMIT INTERVAL-TYPE="CLOSED">0</LOWER-LIMIT>
                    <UPPER-LIMIT INTERVAL-TYPE="CLOSED">0</UPPER-LIMIT>
                    <COMPU-CONST>
                      <VT>SECOC_VERIFICATIONSUCCESS</VT>
                    </COMPU-CONST>
                  </COMPU-SCALE>
                  <!-- !LINKSTO SecOC.Dsn.interface.Rx.SECOC_VERIFICATIONFAILURE,1 -->
                  <COMPU-SCALE>
                    <LOWER-LIMIT INTERVAL-TYPE="CLOSED">1</LOWER-LIMIT>
                    <UPPER-LIMIT INTERVAL-TYPE="CLOSED">1</UPPER-LIMIT>
                    <COMPU-CONST>
                      <VT>SECOC_VERIFICATIONFAILURE</VT>
                    </COMPU-CONST>
                  </COMPU-SCALE>
                  <!-- !LINKSTO SecOC.Dsn.interface.Rx.SECOC_FRESHNESSFAILURE,1 -->
                  <COMPU-SCALE>
                    <LOWER-LIMIT INTERVAL-TYPE="CLOSED">2</LOWER-LIMIT>
                    <UPPER-LIMIT INTERVAL-TYPE="CLOSED">2</UPPER-LIMIT>
                    <COMPU-CONST>
                      <VT>SECOC_FRESHNESSFAILURE</VT>
                    </COMPU-CONST>
                  </COMPU-SCALE>
                  <!-- !LINKSTO SecOC.Dsn.interface.Rx.SECOC_NO_VERIFICATION,1 -->
                  <COMPU-SCALE>
                    <LOWER-LIMIT INTERVAL-TYPE="CLOSED">4</LOWER-LIMIT>
                    <UPPER-LIMIT INTERVAL-TYPE="CLOSED">4</UPPER-LIMIT>
                    <COMPU-CONST>
                      <VT>SECOC_NO_VERIFICATION</VT>
                    </COMPU-CONST>
                  </COMPU-SCALE>
[!IF "node:value(SecOCGeneral/SecOCPropagateVerificationStatus) = 'EB_CUSTOM'"!][!//
                  <!-- !LINKSTO SecOC.Dsn.interface.Rx.SECOC_MACSERVICEFAILURE,1 -->
                  <COMPU-SCALE>
                    <LOWER-LIMIT INTERVAL-TYPE="CLOSED">8</LOWER-LIMIT>
                    <UPPER-LIMIT INTERVAL-TYPE="CLOSED">8</UPPER-LIMIT>
                    <COMPU-CONST>
                      <VT>SECOC_MACSERVICEFAILURE</VT>
                    </COMPU-CONST>
                  </COMPU-SCALE>
[!ENDIF!][!//
                </COMPU-SCALES>
              </COMPU-INTERNAL-TO-PHYS>
            </COMPU-METHOD>
[!ENDIF!][!//
          </ELEMENTS>
        </AR-PACKAGE>
        <AR-PACKAGE>
          <SHORT-NAME>ImplementationDataTypes</SHORT-NAME>
          <ELEMENTS>
            <!-- !LINKSTO SWS_SecOC_RxTx_00162,1 -->
            <IMPLEMENTATION-DATA-TYPE>
              <SHORT-NAME>SecOC_StateType</SHORT-NAME>
              <CATEGORY>TYPE_REFERENCE</CATEGORY>
              <SW-DATA-DEF-PROPS>
                <SW-DATA-DEF-PROPS-VARIANTS>
                  <SW-DATA-DEF-PROPS-CONDITIONAL>
                    <COMPU-METHOD-REF DEST="COMPU-METHOD">/AUTOSAR_SecOC/CompuMethods/CM_SecOC_StateType</COMPU-METHOD-REF>
                    <DATA-CONSTR-REF DEST="DATA-CONSTR">/AUTOSAR_SecOC/DataConstrs/CONSTR_SecOC_StateType</DATA-CONSTR-REF>
                    <!-- !LINKSTO SecOC_EB_RxTx_xxx01,1 -->
                    <IMPLEMENTATION-DATA-TYPE-REF DEST="IMPLEMENTATION-DATA-TYPE">/AUTOSAR_Platform/ImplementationDataTypes/uint32</IMPLEMENTATION-DATA-TYPE-REF>
                  </SW-DATA-DEF-PROPS-CONDITIONAL>
                </SW-DATA-DEF-PROPS-VARIANTS>
              </SW-DATA-DEF-PROPS>
            </IMPLEMENTATION-DATA-TYPE>
[!IF "node:value(SecOCGeneral/SecOCPropagateVerificationStatus) != 'NONE'"!][!//
            <!-- !LINKSTO SecOC.Dsn.interface.Rx.SecOC_VerificationResultType,3 -->
            <IMPLEMENTATION-DATA-TYPE>
              <SHORT-NAME>SecOC_VerificationResultType</SHORT-NAME>
              <CATEGORY>TYPE_REFERENCE</CATEGORY>
              <SW-DATA-DEF-PROPS>
                <SW-DATA-DEF-PROPS-VARIANTS>
                  <SW-DATA-DEF-PROPS-CONDITIONAL>
                    <COMPU-METHOD-REF DEST="COMPU-METHOD">/AUTOSAR_SecOC/CompuMethods/CM_SecOC_VerificationResultType</COMPU-METHOD-REF>
                    <DATA-CONSTR-REF DEST="DATA-CONSTR">/AUTOSAR_SecOC/DataConstrs/CONSTR_SecOC_VerificationResultType</DATA-CONSTR-REF>
                    <!-- !LINKSTO SecOC_EB_RxTx_xxx01,1 -->
                    <IMPLEMENTATION-DATA-TYPE-REF DEST="IMPLEMENTATION-DATA-TYPE">/AUTOSAR_Platform/ImplementationDataTypes/uint8</IMPLEMENTATION-DATA-TYPE-REF>
                  </SW-DATA-DEF-PROPS-CONDITIONAL>
                </SW-DATA-DEF-PROPS-VARIANTS>
              </SW-DATA-DEF-PROPS>
            </IMPLEMENTATION-DATA-TYPE>
            <!-- !LINKSTO SWS_SecOC_Rx_00160,4 -->
            <IMPLEMENTATION-DATA-TYPE>
              <SHORT-NAME>SecOC_VerificationStatusType</SHORT-NAME>
              <CATEGORY>STRUCTURE</CATEGORY>
              <SUB-ELEMENTS>
                <IMPLEMENTATION-DATA-TYPE-ELEMENT>
                  <SHORT-NAME>freshnessValueID</SHORT-NAME>
                  <CATEGORY>TYPE_REFERENCE</CATEGORY>
                  <SW-DATA-DEF-PROPS>
                    <SW-DATA-DEF-PROPS-VARIANTS>
                      <SW-DATA-DEF-PROPS-CONDITIONAL>
                        <IMPLEMENTATION-DATA-TYPE-REF DEST="IMPLEMENTATION-DATA-TYPE">/AUTOSAR_Platform/ImplementationDataTypes/uint16</IMPLEMENTATION-DATA-TYPE-REF>
                      </SW-DATA-DEF-PROPS-CONDITIONAL>
                    </SW-DATA-DEF-PROPS-VARIANTS>
                  </SW-DATA-DEF-PROPS>
                </IMPLEMENTATION-DATA-TYPE-ELEMENT>
                <IMPLEMENTATION-DATA-TYPE-ELEMENT>
                  <SHORT-NAME>verificationStatus</SHORT-NAME>
                  <CATEGORY>TYPE_REFERENCE</CATEGORY>
                  <SW-DATA-DEF-PROPS>
                    <SW-DATA-DEF-PROPS-VARIANTS>
                      <SW-DATA-DEF-PROPS-CONDITIONAL>
                        <IMPLEMENTATION-DATA-TYPE-REF DEST="IMPLEMENTATION-DATA-TYPE">/AUTOSAR_SecOC/ImplementationDataTypes/SecOC_VerificationResultType</IMPLEMENTATION-DATA-TYPE-REF>
                      </SW-DATA-DEF-PROPS-CONDITIONAL>
                    </SW-DATA-DEF-PROPS-VARIANTS>
                  </SW-DATA-DEF-PROPS>
                </IMPLEMENTATION-DATA-TYPE-ELEMENT>
                <IMPLEMENTATION-DATA-TYPE-ELEMENT>
                  <SHORT-NAME>secOCDataId</SHORT-NAME>
                  <CATEGORY>TYPE_REFERENCE</CATEGORY>
                  <SW-DATA-DEF-PROPS>
                    <SW-DATA-DEF-PROPS-VARIANTS>
                      <SW-DATA-DEF-PROPS-CONDITIONAL>
[!IF "node:value(SecOCGeneral/SecOCDataIdLength) = 'UINT8'"!][!//
                        <IMPLEMENTATION-DATA-TYPE-REF DEST="IMPLEMENTATION-DATA-TYPE">/AUTOSAR_Platform/ImplementationDataTypes/uint8</IMPLEMENTATION-DATA-TYPE-REF>
[!ELSEIF "node:value(SecOCGeneral/SecOCDataIdLength) = 'UINT16'"!][!//
                        <IMPLEMENTATION-DATA-TYPE-REF DEST="IMPLEMENTATION-DATA-TYPE">/AUTOSAR_Platform/ImplementationDataTypes/uint16</IMPLEMENTATION-DATA-TYPE-REF>
[!ELSE!][!//
                        <IMPLEMENTATION-DATA-TYPE-REF DEST="IMPLEMENTATION-DATA-TYPE">/AUTOSAR_Platform/ImplementationDataTypes/uint32</IMPLEMENTATION-DATA-TYPE-REF>
[!ENDIF!][!//
                      </SW-DATA-DEF-PROPS-CONDITIONAL>
                    </SW-DATA-DEF-PROPS-VARIANTS>
                  </SW-DATA-DEF-PROPS>
                </IMPLEMENTATION-DATA-TYPE-ELEMENT>
[!IF "node:value(SecOCGeneral/SecOCPropagateVerificationStatus) = 'EB_CUSTOM'"!][!//
                <IMPLEMENTATION-DATA-TYPE-ELEMENT>
                  <SHORT-NAME>verificationReturn</SHORT-NAME>
                  <CATEGORY>TYPE_REFERENCE</CATEGORY>
                  <SW-DATA-DEF-PROPS>
                    <SW-DATA-DEF-PROPS-VARIANTS>
                      <SW-DATA-DEF-PROPS-CONDITIONAL>
                        <IMPLEMENTATION-DATA-TYPE-REF DEST="IMPLEMENTATION-DATA-TYPE">/AUTOSAR_Std/ImplementationDataTypes/Std_ReturnType</IMPLEMENTATION-DATA-TYPE-REF>
                      </SW-DATA-DEF-PROPS-CONDITIONAL>
                    </SW-DATA-DEF-PROPS-VARIANTS>
                  </SW-DATA-DEF-PROPS>
                </IMPLEMENTATION-DATA-TYPE-ELEMENT>
[!ENDIF!][!//
              </SUB-ELEMENTS>
            </IMPLEMENTATION-DATA-TYPE>
[!ENDIF!][!//
[!IF "count(SecOCTxPduProcessing/*[node:value(SecOCMacGenerateStatusPropagationMode) != 'NONE']) > 0"!][!//
            <!-- !LINKSTO SecOC_EB_Tx_xxx14,2 -->
            <IMPLEMENTATION-DATA-TYPE>
              <SHORT-NAME>SecOC_MacGenerateStatusType</SHORT-NAME>
              <CATEGORY>STRUCTURE</CATEGORY>
              <SUB-ELEMENTS>
                <IMPLEMENTATION-DATA-TYPE-ELEMENT>
                  <SHORT-NAME>freshnessValueID</SHORT-NAME>
                  <CATEGORY>TYPE_REFERENCE</CATEGORY>
                  <SW-DATA-DEF-PROPS>
                    <SW-DATA-DEF-PROPS-VARIANTS>
                      <SW-DATA-DEF-PROPS-CONDITIONAL>
                        <IMPLEMENTATION-DATA-TYPE-REF DEST="IMPLEMENTATION-DATA-TYPE">/AUTOSAR_Platform/ImplementationDataTypes/uint16</IMPLEMENTATION-DATA-TYPE-REF>
                      </SW-DATA-DEF-PROPS-CONDITIONAL>
                    </SW-DATA-DEF-PROPS-VARIANTS>
                  </SW-DATA-DEF-PROPS>
                </IMPLEMENTATION-DATA-TYPE-ELEMENT>
                <IMPLEMENTATION-DATA-TYPE-ELEMENT>
                  <SHORT-NAME>macGenerateStatus</SHORT-NAME>
                  <CATEGORY>TYPE_REFERENCE</CATEGORY>
                  <SW-DATA-DEF-PROPS>
                    <SW-DATA-DEF-PROPS-VARIANTS>
                      <SW-DATA-DEF-PROPS-CONDITIONAL>
                        <IMPLEMENTATION-DATA-TYPE-REF DEST="IMPLEMENTATION-DATA-TYPE">/AUTOSAR_Std/ImplementationDataTypes/Std_ReturnType</IMPLEMENTATION-DATA-TYPE-REF>
                      </SW-DATA-DEF-PROPS-CONDITIONAL>
                    </SW-DATA-DEF-PROPS-VARIANTS>
                  </SW-DATA-DEF-PROPS>
                </IMPLEMENTATION-DATA-TYPE-ELEMENT>
                <IMPLEMENTATION-DATA-TYPE-ELEMENT>
                  <SHORT-NAME>secOCDataId</SHORT-NAME>
                  <CATEGORY>TYPE_REFERENCE</CATEGORY>
                  <SW-DATA-DEF-PROPS>
                    <SW-DATA-DEF-PROPS-VARIANTS>
                      <SW-DATA-DEF-PROPS-CONDITIONAL>
[!IF "node:value(SecOCGeneral/SecOCDataIdLength) = 'UINT8'"!][!//
                        <IMPLEMENTATION-DATA-TYPE-REF DEST="IMPLEMENTATION-DATA-TYPE">/AUTOSAR_Platform/ImplementationDataTypes/uint8</IMPLEMENTATION-DATA-TYPE-REF>
[!ELSEIF "node:value(SecOCGeneral/SecOCDataIdLength) = 'UINT16'"!][!//
                        <IMPLEMENTATION-DATA-TYPE-REF DEST="IMPLEMENTATION-DATA-TYPE">/AUTOSAR_Platform/ImplementationDataTypes/uint16</IMPLEMENTATION-DATA-TYPE-REF>
[!ELSE!][!//
                        <IMPLEMENTATION-DATA-TYPE-REF DEST="IMPLEMENTATION-DATA-TYPE">/AUTOSAR_Platform/ImplementationDataTypes/uint32</IMPLEMENTATION-DATA-TYPE-REF>
[!ENDIF!][!//
                      </SW-DATA-DEF-PROPS-CONDITIONAL>
                    </SW-DATA-DEF-PROPS-VARIANTS>
                  </SW-DATA-DEF-PROPS>
                </IMPLEMENTATION-DATA-TYPE-ELEMENT>
              </SUB-ELEMENTS>
            </IMPLEMENTATION-DATA-TYPE>
[!ENDIF!][!//
[!IF "node:value(SecOCGeneral/SecOCQueryFreshnessValue) = 'RTE'"!][!//
            <!-- !LINKSTO SWS_SecOC_91012,1 -->
            <IMPLEMENTATION-DATA-TYPE>
              <SHORT-NAME>SecOC_FreshnessArrayType</SHORT-NAME>
              <CATEGORY>ARRAY</CATEGORY>
              <SW-DATA-DEF-PROPS>
                <SW-DATA-DEF-PROPS-VARIANTS>
                  <SW-DATA-DEF-PROPS-CONDITIONAL>
                    <SW-CALIBRATION-ACCESS>READ-ONLY</SW-CALIBRATION-ACCESS>
                  </SW-DATA-DEF-PROPS-CONDITIONAL>
                </SW-DATA-DEF-PROPS-VARIANTS>
              </SW-DATA-DEF-PROPS>
              <SUB-ELEMENTS>

                <IMPLEMENTATION-DATA-TYPE-ELEMENT>
                  <SHORT-NAME>freshnessValueTypeElement</SHORT-NAME>
                  <CATEGORY>TYPE_REFERENCE</CATEGORY>
                  <ARRAY-SIZE>8</ARRAY-SIZE>
                  <ARRAY-SIZE-SEMANTICS>FIXED-SIZE</ARRAY-SIZE-SEMANTICS>
                  <SW-DATA-DEF-PROPS>
                    <SW-DATA-DEF-PROPS-VARIANTS>
                      <SW-DATA-DEF-PROPS-CONDITIONAL>
                        <IMPLEMENTATION-DATA-TYPE-REF DEST="IMPLEMENTATION-DATA-TYPE">/AUTOSAR_Platform/ImplementationDataTypes/uint8</IMPLEMENTATION-DATA-TYPE-REF>
                      </SW-DATA-DEF-PROPS-CONDITIONAL>
                    </SW-DATA-DEF-PROPS-VARIANTS>
                  </SW-DATA-DEF-PROPS>
                </IMPLEMENTATION-DATA-TYPE-ELEMENT>
              </SUB-ELEMENTS>
            </IMPLEMENTATION-DATA-TYPE>
[!ENDIF!][!//
          </ELEMENTS>
        </AR-PACKAGE>
        <AR-PACKAGE>
          <SHORT-NAME>PortInterfaces</SHORT-NAME>
          <ELEMENTS>
[!IF "count(SecOCRxPduProcessing/*) > 0"!][!//
            <!-- !LINKSTO SWS_SecOC_Rx_00142,4, SecOC.Dsn.interface.Rx.VerifyStatusConfiguration,1 -->
            <CLIENT-SERVER-INTERFACE>
              <SHORT-NAME>VerifyStatusConfiguration</SHORT-NAME>
              <IS-SERVICE>true</IS-SERVICE>
              <OPERATIONS>
                <CLIENT-SERVER-OPERATION>
                  <SHORT-NAME>VerifyStatusOverride</SHORT-NAME>
                  <ARGUMENTS>
                    <ARGUMENT-DATA-PROTOTYPE>
                      <SHORT-NAME>freshnessValueId</SHORT-NAME>
                      <TYPE-TREF DEST="IMPLEMENTATION-DATA-TYPE">/AUTOSAR_Platform/ImplementationDataTypes/uint16</TYPE-TREF>
                      <DIRECTION>IN</DIRECTION>
                    </ARGUMENT-DATA-PROTOTYPE>
                    <ARGUMENT-DATA-PROTOTYPE>
                      <SHORT-NAME>overrideStatus</SHORT-NAME>
                      <TYPE-TREF DEST="IMPLEMENTATION-DATA-TYPE">/AUTOSAR_Platform/ImplementationDataTypes/uint8</TYPE-TREF>
                      <DIRECTION>IN</DIRECTION>
                    </ARGUMENT-DATA-PROTOTYPE>
                    <ARGUMENT-DATA-PROTOTYPE>
                      <SHORT-NAME>numberOfMessagesToOverride</SHORT-NAME>
                      <TYPE-TREF DEST="IMPLEMENTATION-DATA-TYPE">/AUTOSAR_Platform/ImplementationDataTypes/uint8</TYPE-TREF>
                      <DIRECTION>IN</DIRECTION>
                    </ARGUMENT-DATA-PROTOTYPE>
                  </ARGUMENTS>
                  <POSSIBLE-ERROR-REFS>
                    <POSSIBLE-ERROR-REF DEST="APPLICATION-ERROR">/AUTOSAR_SecOC/PortInterfaces/VerifyStatusConfiguration/E_OK</POSSIBLE-ERROR-REF>
                    <POSSIBLE-ERROR-REF DEST="APPLICATION-ERROR">/AUTOSAR_SecOC/PortInterfaces/VerifyStatusConfiguration/E_NOT_OK</POSSIBLE-ERROR-REF>
                  </POSSIBLE-ERROR-REFS>
                </CLIENT-SERVER-OPERATION>
              </OPERATIONS>
              <POSSIBLE-ERRORS>
                <APPLICATION-ERROR>
                  <SHORT-NAME>E_OK</SHORT-NAME>
                  <ERROR-CODE>0</ERROR-CODE>
                </APPLICATION-ERROR>
                <APPLICATION-ERROR>
                  <SHORT-NAME>E_NOT_OK</SHORT-NAME>
                  <ERROR-CODE>1</ERROR-CODE>
                </APPLICATION-ERROR>
              </POSSIBLE-ERRORS>
            </CLIENT-SERVER-INTERFACE>
[!ENDIF!][!//
[!IF "node:value(SecOCGeneral/SecOCQueryFreshnessValue) = 'RTE'"!][!//
[!IF "count(SecOCTxPduProcessing/*) > 0"!][!//
            <!-- !LINKSTO SWS_SecOC_Tx_xx031,1 -->
            <CLIENT-SERVER-INTERFACE>
              <SHORT-NAME>TxFreshnessManagement</SHORT-NAME>
              <IS-SERVICE>true</IS-SERVICE>
              <OPERATIONS>
[!IF "count(SecOCTxPduProcessing/*[SecOCProvideTxTruncatedFreshnessValue = 'false']) > 0"!][!//
                <CLIENT-SERVER-OPERATION>
                  <!-- !LINKSTO SWS_SecOC_Tx_xx033,3, SecOC.Dsn.interface.Tx.TxFreshnessManagement, 4 -->
                  <SHORT-NAME>GetTxFreshness</SHORT-NAME>
                  <ARGUMENTS>
                    <ARGUMENT-DATA-PROTOTYPE>
                      <SHORT-NAME>freshnessValueId</SHORT-NAME>
                      <TYPE-TREF DEST="IMPLEMENTATION-DATA-TYPE">/AUTOSAR_Platform/ImplementationDataTypes/uint16</TYPE-TREF>
                      <DIRECTION>IN</DIRECTION>
                    </ARGUMENT-DATA-PROTOTYPE>
                    <ARGUMENT-DATA-PROTOTYPE>
                      <SHORT-NAME>freshnessValue</SHORT-NAME>
                      <TYPE-TREF DEST="IMPLEMENTATION-DATA-TYPE">/AUTOSAR_SecOC/ImplementationDataTypes/SecOC_FreshnessArrayType</TYPE-TREF>
                      <DIRECTION>OUT</DIRECTION>
                    </ARGUMENT-DATA-PROTOTYPE>
                    <ARGUMENT-DATA-PROTOTYPE>
                      <SHORT-NAME>freshnessValueLength</SHORT-NAME>
                      <TYPE-TREF DEST="IMPLEMENTATION-DATA-TYPE">/AUTOSAR_Platform/ImplementationDataTypes/uint32</TYPE-TREF>
                      <DIRECTION>INOUT</DIRECTION>
                    </ARGUMENT-DATA-PROTOTYPE>
                  </ARGUMENTS>
                  <POSSIBLE-ERROR-REFS>
                    <POSSIBLE-ERROR-REF DEST="APPLICATION-ERROR">/AUTOSAR_SecOC/PortInterfaces/TxFreshnessManagement/E_OK</POSSIBLE-ERROR-REF>
                    <POSSIBLE-ERROR-REF DEST="APPLICATION-ERROR">/AUTOSAR_SecOC/PortInterfaces/TxFreshnessManagement/E_NOT_OK</POSSIBLE-ERROR-REF>
                    <POSSIBLE-ERROR-REF DEST="APPLICATION-ERROR">/AUTOSAR_SecOC/PortInterfaces/TxFreshnessManagement/E_BUSY</POSSIBLE-ERROR-REF>
                  </POSSIBLE-ERROR-REFS>
                </CLIENT-SERVER-OPERATION>
[!ENDIF!][!//
[!IF "count(SecOCTxPduProcessing/*[SecOCProvideTxTruncatedFreshnessValue = 'true']) > 0"!][!//
                <CLIENT-SERVER-OPERATION>
                  <!-- !LINKSTO SWS_SecOC_Tx_xx033_2,1, SecOC.Dsn.interface.Tx.TxFreshnessManagement_2, 2 -->
                  <SHORT-NAME>GetTxFreshnessTruncData</SHORT-NAME>
                  <ARGUMENTS>
                    <ARGUMENT-DATA-PROTOTYPE>
                      <SHORT-NAME>freshnessValueId</SHORT-NAME>
                      <TYPE-TREF DEST="IMPLEMENTATION-DATA-TYPE">/AUTOSAR_Platform/ImplementationDataTypes/uint16</TYPE-TREF>
                      <DIRECTION>IN</DIRECTION>
                    </ARGUMENT-DATA-PROTOTYPE>
                    <ARGUMENT-DATA-PROTOTYPE>
                      <SHORT-NAME>freshnessValue</SHORT-NAME>
                      <TYPE-TREF DEST="IMPLEMENTATION-DATA-TYPE">/AUTOSAR_SecOC/ImplementationDataTypes/SecOC_FreshnessArrayType</TYPE-TREF>
                      <DIRECTION>OUT</DIRECTION>
                    </ARGUMENT-DATA-PROTOTYPE>
                    <ARGUMENT-DATA-PROTOTYPE>
                      <SHORT-NAME>freshnessValueLength</SHORT-NAME>
                      <TYPE-TREF DEST="IMPLEMENTATION-DATA-TYPE">/AUTOSAR_Platform/ImplementationDataTypes/uint32</TYPE-TREF>
                      <DIRECTION>INOUT</DIRECTION>
                    </ARGUMENT-DATA-PROTOTYPE>
                    <ARGUMENT-DATA-PROTOTYPE>
                      <SHORT-NAME>truncatedFreshnessValue</SHORT-NAME>
                      <TYPE-TREF DEST="IMPLEMENTATION-DATA-TYPE">/AUTOSAR_SecOC/ImplementationDataTypes/SecOC_FreshnessArrayType</TYPE-TREF>
                      <DIRECTION>OUT</DIRECTION>
                    </ARGUMENT-DATA-PROTOTYPE>
                    <ARGUMENT-DATA-PROTOTYPE>
                      <SHORT-NAME>truncatedFreshnessValueLength</SHORT-NAME>
                      <TYPE-TREF DEST="IMPLEMENTATION-DATA-TYPE">/AUTOSAR_Platform/ImplementationDataTypes/uint32</TYPE-TREF>
                      <DIRECTION>INOUT</DIRECTION>
                    </ARGUMENT-DATA-PROTOTYPE>
                  </ARGUMENTS>
                  <POSSIBLE-ERROR-REFS>
                    <POSSIBLE-ERROR-REF DEST="APPLICATION-ERROR">/AUTOSAR_SecOC/PortInterfaces/TxFreshnessManagement/E_OK</POSSIBLE-ERROR-REF>
                    <POSSIBLE-ERROR-REF DEST="APPLICATION-ERROR">/AUTOSAR_SecOC/PortInterfaces/TxFreshnessManagement/E_NOT_OK</POSSIBLE-ERROR-REF>
                    <POSSIBLE-ERROR-REF DEST="APPLICATION-ERROR">/AUTOSAR_SecOC/PortInterfaces/TxFreshnessManagement/E_BUSY</POSSIBLE-ERROR-REF>
                  </POSSIBLE-ERROR-REFS>
                </CLIENT-SERVER-OPERATION>
[!ENDIF!][!//
                <CLIENT-SERVER-OPERATION>
                  <!-- !LINKSTO SWS_SecOC_Tx_xx034,1, SecOC.Dsn.interface.Tx.TxFreshnessManagement, 4, SecOC.Dsn.interface.Tx.TxFreshnessManagement_2, 2 -->
                  <SHORT-NAME>SPduTxConfirmation</SHORT-NAME>
                  <ARGUMENTS>
                    <ARGUMENT-DATA-PROTOTYPE>
                      <SHORT-NAME>freshnessValueId</SHORT-NAME>
                      <TYPE-TREF DEST="IMPLEMENTATION-DATA-TYPE">/AUTOSAR_Platform/ImplementationDataTypes/uint16</TYPE-TREF>
                      <DIRECTION>IN</DIRECTION>
                    </ARGUMENT-DATA-PROTOTYPE>
                  </ARGUMENTS>
                  <POSSIBLE-ERROR-REFS>
                    <POSSIBLE-ERROR-REF DEST="APPLICATION-ERROR">/AUTOSAR_SecOC/PortInterfaces/TxFreshnessManagement/E_OK</POSSIBLE-ERROR-REF>
                  </POSSIBLE-ERROR-REFS>
                </CLIENT-SERVER-OPERATION>
              </OPERATIONS>
              <POSSIBLE-ERRORS>
                <APPLICATION-ERROR>
                  <SHORT-NAME>E_OK</SHORT-NAME>
                  <ERROR-CODE>0</ERROR-CODE>
                </APPLICATION-ERROR>
                <APPLICATION-ERROR>
                  <SHORT-NAME>E_NOT_OK</SHORT-NAME>
                  <ERROR-CODE>1</ERROR-CODE>
                </APPLICATION-ERROR>
                <APPLICATION-ERROR>
                  <SHORT-NAME>E_BUSY</SHORT-NAME>
                  <ERROR-CODE>2</ERROR-CODE>
                </APPLICATION-ERROR>
              </POSSIBLE-ERRORS>
            </CLIENT-SERVER-INTERFACE>
[!ENDIF!][!//

[!IF "count(SecOCRxPduProcessing/*) > 0"!][!//
            <!-- !LINKSTO SWS_SecOC_Rx_xx031,1 -->
            <CLIENT-SERVER-INTERFACE>
              <SHORT-NAME>RxFreshnessManagement</SHORT-NAME>
              <IS-SERVICE>true</IS-SERVICE>
              <OPERATIONS>
[!IF "count(SecOCRxPduProcessing/*[SecOCUseAuthDataFreshness = 'false']) > 0"!][!//
                <CLIENT-SERVER-OPERATION>
                  <!-- !LINKSTO SWS_SecOC_Rx_xx035,3, SecOC.Dsn.interface.Rx.RxFreshnessManagement, 4 -->
                  <SHORT-NAME>GetRxFreshness</SHORT-NAME>
                  <ARGUMENTS>
                    <ARGUMENT-DATA-PROTOTYPE>
                      <SHORT-NAME>freshnessValueId</SHORT-NAME>
                      <TYPE-TREF DEST="IMPLEMENTATION-DATA-TYPE">/AUTOSAR_Platform/ImplementationDataTypes/uint16</TYPE-TREF>
                      <DIRECTION>IN</DIRECTION>
                    </ARGUMENT-DATA-PROTOTYPE>
                    <ARGUMENT-DATA-PROTOTYPE>
                      <SHORT-NAME>truncatedFreshnessValue</SHORT-NAME>
                      <TYPE-TREF DEST="IMPLEMENTATION-DATA-TYPE">/AUTOSAR_SecOC/ImplementationDataTypes/SecOC_FreshnessArrayType</TYPE-TREF>
                      <DIRECTION>IN</DIRECTION>
                    </ARGUMENT-DATA-PROTOTYPE>
                    <ARGUMENT-DATA-PROTOTYPE>
                      <SHORT-NAME>truncatedFreshnessLength</SHORT-NAME>
                      <TYPE-TREF DEST="IMPLEMENTATION-DATA-TYPE">/AUTOSAR_Platform/ImplementationDataTypes/uint32</TYPE-TREF>
                      <DIRECTION>IN</DIRECTION>
                    </ARGUMENT-DATA-PROTOTYPE>
                    <ARGUMENT-DATA-PROTOTYPE>
                      <SHORT-NAME>authVerifyAttempts</SHORT-NAME>
                      <TYPE-TREF DEST="IMPLEMENTATION-DATA-TYPE">/AUTOSAR_Platform/ImplementationDataTypes/uint16</TYPE-TREF>
                      <DIRECTION>IN</DIRECTION>
                    </ARGUMENT-DATA-PROTOTYPE>
                    <ARGUMENT-DATA-PROTOTYPE>
                      <SHORT-NAME>freshnessValue</SHORT-NAME>
                      <TYPE-TREF DEST="IMPLEMENTATION-DATA-TYPE">/AUTOSAR_SecOC/ImplementationDataTypes/SecOC_FreshnessArrayType</TYPE-TREF>
                      <DIRECTION>OUT</DIRECTION>
                    </ARGUMENT-DATA-PROTOTYPE>
                    <ARGUMENT-DATA-PROTOTYPE>
                      <SHORT-NAME>freshnessValueLength</SHORT-NAME>
                      <TYPE-TREF DEST="IMPLEMENTATION-DATA-TYPE">/AUTOSAR_Platform/ImplementationDataTypes/uint32</TYPE-TREF>
                      <DIRECTION>INOUT</DIRECTION>
                    </ARGUMENT-DATA-PROTOTYPE>
                  </ARGUMENTS>
                  <POSSIBLE-ERROR-REFS>
                    <POSSIBLE-ERROR-REF DEST="APPLICATION-ERROR">/AUTOSAR_SecOC/PortInterfaces/RxFreshnessManagement/E_OK</POSSIBLE-ERROR-REF>
                    <POSSIBLE-ERROR-REF DEST="APPLICATION-ERROR">/AUTOSAR_SecOC/PortInterfaces/RxFreshnessManagement/E_NOT_OK</POSSIBLE-ERROR-REF>
                    <POSSIBLE-ERROR-REF DEST="APPLICATION-ERROR">/AUTOSAR_SecOC/PortInterfaces/RxFreshnessManagement/E_BUSY</POSSIBLE-ERROR-REF>
                  </POSSIBLE-ERROR-REFS>
                </CLIENT-SERVER-OPERATION>
[!ENDIF!][!//
[!IF "count(SecOCRxPduProcessing/*[SecOCUseAuthDataFreshness = 'true']) > 0"!][!//
                <CLIENT-SERVER-OPERATION>
                  <!-- !LINKSTO SWS_SecOC_Rx_xx035_2,1, SecOC.Dsn.interface.Rx.RxFreshnessManagement_2, 2 -->
                  <SHORT-NAME>GetRxFreshnessAuthData</SHORT-NAME>
                  <ARGUMENTS>
                    <ARGUMENT-DATA-PROTOTYPE>
                      <SHORT-NAME>freshnessValueId</SHORT-NAME>
                      <TYPE-TREF DEST="IMPLEMENTATION-DATA-TYPE">/AUTOSAR_Platform/ImplementationDataTypes/uint16</TYPE-TREF>
                      <DIRECTION>IN</DIRECTION>
                    </ARGUMENT-DATA-PROTOTYPE>
                    <ARGUMENT-DATA-PROTOTYPE>
                      <SHORT-NAME>truncatedFreshnessValue</SHORT-NAME>
                      <TYPE-TREF DEST="IMPLEMENTATION-DATA-TYPE">/AUTOSAR_SecOC/ImplementationDataTypes/SecOC_FreshnessArrayType</TYPE-TREF>
                      <DIRECTION>IN</DIRECTION>
                    </ARGUMENT-DATA-PROTOTYPE>
                    <ARGUMENT-DATA-PROTOTYPE>
                      <SHORT-NAME>truncatedFreshnessLength</SHORT-NAME>
                      <TYPE-TREF DEST="IMPLEMENTATION-DATA-TYPE">/AUTOSAR_Platform/ImplementationDataTypes/uint32</TYPE-TREF>
                      <DIRECTION>IN</DIRECTION>
                    </ARGUMENT-DATA-PROTOTYPE>
                    <ARGUMENT-DATA-PROTOTYPE>
                      <SHORT-NAME>authenticDataFreshnessValue</SHORT-NAME>
                      <TYPE-TREF DEST="IMPLEMENTATION-DATA-TYPE">/AUTOSAR_SecOC/ImplementationDataTypes/SecOC_FreshnessArrayType</TYPE-TREF>
                      <DIRECTION>IN</DIRECTION>
                    </ARGUMENT-DATA-PROTOTYPE>
                    <ARGUMENT-DATA-PROTOTYPE>
                      <SHORT-NAME>authenticDataFreshnessValueLength</SHORT-NAME>
                      <TYPE-TREF DEST="IMPLEMENTATION-DATA-TYPE">/AUTOSAR_Platform/ImplementationDataTypes/uint16</TYPE-TREF>
                      <DIRECTION>IN</DIRECTION>
                    </ARGUMENT-DATA-PROTOTYPE>
                    <ARGUMENT-DATA-PROTOTYPE>
                      <SHORT-NAME>authVerifyAttempts</SHORT-NAME>
                      <TYPE-TREF DEST="IMPLEMENTATION-DATA-TYPE">/AUTOSAR_Platform/ImplementationDataTypes/uint16</TYPE-TREF>
                      <DIRECTION>IN</DIRECTION>
                    </ARGUMENT-DATA-PROTOTYPE>
                    <ARGUMENT-DATA-PROTOTYPE>
                      <SHORT-NAME>freshnessValue</SHORT-NAME>
                      <TYPE-TREF DEST="IMPLEMENTATION-DATA-TYPE">/AUTOSAR_SecOC/ImplementationDataTypes/SecOC_FreshnessArrayType</TYPE-TREF>
                      <DIRECTION>OUT</DIRECTION>
                    </ARGUMENT-DATA-PROTOTYPE>
                    <ARGUMENT-DATA-PROTOTYPE>
                      <SHORT-NAME>freshnessValueLength</SHORT-NAME>
                      <TYPE-TREF DEST="IMPLEMENTATION-DATA-TYPE">/AUTOSAR_Platform/ImplementationDataTypes/uint32</TYPE-TREF>
                      <DIRECTION>INOUT</DIRECTION>
                    </ARGUMENT-DATA-PROTOTYPE>
                  </ARGUMENTS>
                  <POSSIBLE-ERROR-REFS>
                    <POSSIBLE-ERROR-REF DEST="APPLICATION-ERROR">/AUTOSAR_SecOC/PortInterfaces/RxFreshnessManagement/E_OK</POSSIBLE-ERROR-REF>
                    <POSSIBLE-ERROR-REF DEST="APPLICATION-ERROR">/AUTOSAR_SecOC/PortInterfaces/RxFreshnessManagement/E_NOT_OK</POSSIBLE-ERROR-REF>
                    <POSSIBLE-ERROR-REF DEST="APPLICATION-ERROR">/AUTOSAR_SecOC/PortInterfaces/RxFreshnessManagement/E_BUSY</POSSIBLE-ERROR-REF>
                  </POSSIBLE-ERROR-REFS>
                </CLIENT-SERVER-OPERATION>
[!ENDIF!][!//
              </OPERATIONS>
              <POSSIBLE-ERRORS>
                <APPLICATION-ERROR>
                  <SHORT-NAME>E_OK</SHORT-NAME>
                  <ERROR-CODE>0</ERROR-CODE>
                </APPLICATION-ERROR>
                <APPLICATION-ERROR>
                  <SHORT-NAME>E_NOT_OK</SHORT-NAME>
                  <ERROR-CODE>1</ERROR-CODE>
                </APPLICATION-ERROR>
                <APPLICATION-ERROR>
                  <SHORT-NAME>E_BUSY</SHORT-NAME>
                  <ERROR-CODE>2</ERROR-CODE>
                </APPLICATION-ERROR>
              </POSSIBLE-ERRORS>
            </CLIENT-SERVER-INTERFACE>
[!ENDIF!][!//
[!ENDIF!][!//
            <!-- !LINKSTO SWS_SecOC_Rx_00141,1, SecOC.Dsn.interface.Rx.VerificationStatusExistence,3 -->
[!IF "node:value(SecOCGeneral/SecOCPropagateVerificationStatus) != 'NONE'"!][!//
            <SENDER-RECEIVER-INTERFACE>
              <SHORT-NAME>VerificationStatus</SHORT-NAME>
              <IS-SERVICE>true</IS-SERVICE>
              <DATA-ELEMENTS>
                <VARIABLE-DATA-PROTOTYPE>
                  <SHORT-NAME>verificationStatus</SHORT-NAME>
                  <TYPE-TREF DEST="IMPLEMENTATION-DATA-TYPE">/AUTOSAR_SecOC/ImplementationDataTypes/SecOC_VerificationStatusType</TYPE-TREF>
                </VARIABLE-DATA-PROTOTYPE>
              </DATA-ELEMENTS>
            </SENDER-RECEIVER-INTERFACE>
[!ENDIF!][!//
            <!-- !LINKSTO SecOC_EB_Tx_xxx15,1, SecOC.Dsn.interface.Tx.MacGenerateStatusExistence,2 -->
[!IF "count(SecOCTxPduProcessing/*[node:value(SecOCMacGenerateStatusPropagationMode) != 'NONE']) > 0"!][!//
            <SENDER-RECEIVER-INTERFACE>
              <SHORT-NAME>MacGenerateStatus</SHORT-NAME>
              <IS-SERVICE>true</IS-SERVICE>
              <DATA-ELEMENTS>
                <VARIABLE-DATA-PROTOTYPE>
                  <SHORT-NAME>macGenerateStatus</SHORT-NAME>
                  <TYPE-TREF DEST="IMPLEMENTATION-DATA-TYPE">/AUTOSAR_SecOC/ImplementationDataTypes/SecOC_MacGenerateStatusType</TYPE-TREF>
                </VARIABLE-DATA-PROTOTYPE>
              </DATA-ELEMENTS>
            </SENDER-RECEIVER-INTERFACE>
[!ENDIF!][!//
          </ELEMENTS>
        </AR-PACKAGE>
      </AR-PACKAGES>
    </AR-PACKAGE>
  </AR-PACKAGES>
</AUTOSAR>
[!ENDIF!][!//
