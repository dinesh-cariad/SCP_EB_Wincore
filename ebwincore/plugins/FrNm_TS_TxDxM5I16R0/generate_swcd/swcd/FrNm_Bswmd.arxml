<?xml version="1.0" encoding="ISO-8859-1"?>
[!IF "not(node:exists(as:modconf('FrNm')[1]/FrNmChannelConfig/*[1]))"!][!//
[!ERROR "Configuration not exist!"!][!//
[!ENDIF!][!//
[!AUTOSPACING!][!//
<AUTOSAR xmlns="http://autosar.org/schema/r4.0"
  xmlns:xsi="http://www.w3.org/2001/XMLSchema-instance"
  xsi:schemaLocation="http://autosar.org/schema/r4.0 AUTOSAR_4-2-1_STRICT_COMPACT.xsd">
  <AR-PACKAGES>
    <AR-PACKAGE>
      <SHORT-NAME>AUTOSAR_FrNm</SHORT-NAME>
      <AR-PACKAGES>
        <AR-PACKAGE>
          <SHORT-NAME>BswModuleDescriptions</SHORT-NAME>
          <ELEMENTS>
            <BSW-MODULE-DESCRIPTION>
              <SHORT-NAME>FrNm</SHORT-NAME>
              <MODULE-ID>32</MODULE-ID>
              <PROVIDED-ENTRYS>
                [!LOOP "node:order(FrNmChannelConfig/*/FrNmChannel/*, 'node:value(node:ref(FrNmChannelIdentifiers/FrNmChannelHandle)/FrIfClstIdx)')"!]
                <BSW-MODULE-ENTRY-REF-CONDITIONAL>
                  <BSW-MODULE-ENTRY-REF DEST="BSW-MODULE-ENTRY">/AUTOSAR_FrNm/BswModuleEntrys/FrNm_MainFunction_[!"num:i(as:ref(FrNmChannelIdentifiers/FrNmChannelHandle)/FrIfClstIdx)"!]</BSW-MODULE-ENTRY-REF>
                </BSW-MODULE-ENTRY-REF-CONDITIONAL>
                [!ENDLOOP!]

[!IF "as:modconf('FrNm')[1]/FrNmGeneral/FrNmMultiCoreSupport = 'true'"!]

                <BSW-MODULE-ENTRY-REF-CONDITIONAL>
                  <BSW-MODULE-ENTRY-REF DEST="BSW-MODULE-ENTRY">/AUTOSAR_FrNm/BswModuleEntrys/FrNm_Dummy_RxIndication</BSW-MODULE-ENTRY-REF>
                </BSW-MODULE-ENTRY-REF-CONDITIONAL>

[!IF "as:modconf('FrNm')[1]/FrNmGlobalConfig/FrNmGlobalFeatures/FrNmPassiveModeEnabled='false'"!]
                <BSW-MODULE-ENTRY-REF-CONDITIONAL>
                  <BSW-MODULE-ENTRY-REF DEST="BSW-MODULE-ENTRY">/AUTOSAR_FrNm/BswModuleEntrys/FrNm_NetworkRequest</BSW-MODULE-ENTRY-REF>
                </BSW-MODULE-ENTRY-REF-CONDITIONAL>
[!ENDIF!]

[!IF "as:modconf('FrNm')[1]/FrNmGlobalConfig/FrNmGlobalFeatures/FrNmPassiveModeEnabled='false'"!]
                <BSW-MODULE-ENTRY-REF-CONDITIONAL>
                  <BSW-MODULE-ENTRY-REF DEST="BSW-MODULE-ENTRY">/AUTOSAR_FrNm/BswModuleEntrys/FrNm_NetworkGwEraRequest</BSW-MODULE-ENTRY-REF>
                </BSW-MODULE-ENTRY-REF-CONDITIONAL>
[!ENDIF!]

[!IF "as:modconf('FrNm')[1]/FrNmGlobalConfig/FrNmGlobalFeatures/FrNmPassiveModeEnabled='false'"!]
                <BSW-MODULE-ENTRY-REF-CONDITIONAL>
                  <BSW-MODULE-ENTRY-REF DEST="BSW-MODULE-ENTRY">/AUTOSAR_FrNm/BswModuleEntrys/FrNm_NetworkRelease</BSW-MODULE-ENTRY-REF>
                </BSW-MODULE-ENTRY-REF-CONDITIONAL>
[!ENDIF!]

[!IF "as:modconf('FrNm')[1]/FrNmGlobalConfig/FrNmGlobalFeatures/FrNmBusSynchronizationEnabled='true'"!]
                <BSW-MODULE-ENTRY-REF-CONDITIONAL>
                  <BSW-MODULE-ENTRY-REF DEST="BSW-MODULE-ENTRY">/AUTOSAR_FrNm/BswModuleEntrys/FrNm_RequestBusSynchronization</BSW-MODULE-ENTRY-REF>
                </BSW-MODULE-ENTRY-REF-CONDITIONAL>
[!ENDIF!]

                <BSW-MODULE-ENTRY-REF-CONDITIONAL>
                  <BSW-MODULE-ENTRY-REF DEST="BSW-MODULE-ENTRY">/AUTOSAR_FrNm/BswModuleEntrys/FrNm_PassiveStartUp</BSW-MODULE-ENTRY-REF>
                </BSW-MODULE-ENTRY-REF-CONDITIONAL>

[!ENDIF!]
              </PROVIDED-ENTRYS>

[!IF "as:modconf('FrNm')[1]/FrNmGeneral/FrNmMultiCoreSupport = 'true'"!]
              <PROVIDED-CLIENT-SERVER-ENTRYS>
[!LOOP "as:modconf('FrNm')[1]/FrNmChannelConfig/*/FrNmChannel/*"!]
                <BSW-MODULE-CLIENT-SERVER-ENTRY>
                  <SHORT-NAME>ProvidedCSEntry_FrNm_PassiveStartUp_[!"node:name(.)"!]</SHORT-NAME>
                  <ENCAPSULATED-ENTRY-REF DEST="BSW-MODULE-ENTRY">/AUTOSAR_FrNm/BswModuleEntrys/FrNm_PassiveStartUp</ENCAPSULATED-ENTRY-REF>
                  <IS-SYNCHRONOUS>false</IS-SYNCHRONOUS>
                </BSW-MODULE-CLIENT-SERVER-ENTRY>

[!IF "as:modconf('FrNm')[1]/FrNmGlobalConfig/FrNmGlobalFeatures/FrNmPassiveModeEnabled='false'"!]
                <BSW-MODULE-CLIENT-SERVER-ENTRY>
                  <SHORT-NAME>ProvidedCSEntry_FrNm_NetworkRequest_[!"node:name(.)"!]</SHORT-NAME>
                  <ENCAPSULATED-ENTRY-REF DEST="BSW-MODULE-ENTRY">/AUTOSAR_FrNm/BswModuleEntrys/FrNm_NetworkRequest</ENCAPSULATED-ENTRY-REF>
                  <IS-SYNCHRONOUS>false</IS-SYNCHRONOUS>
                </BSW-MODULE-CLIENT-SERVER-ENTRY>
[!ENDIF!]

[!IF "as:modconf('FrNm')[1]/FrNmGlobalConfig/FrNmGlobalFeatures/FrNmPassiveModeEnabled='false'"!]
                <BSW-MODULE-CLIENT-SERVER-ENTRY>
                  <SHORT-NAME>ProvidedCSEntry_FrNm_NetworkGwEraRequest_[!"node:name(.)"!]</SHORT-NAME>
                  <ENCAPSULATED-ENTRY-REF DEST="BSW-MODULE-ENTRY">/AUTOSAR_FrNm/BswModuleEntrys/FrNm_NetworkGwEraRequest</ENCAPSULATED-ENTRY-REF>
                  <IS-SYNCHRONOUS>false</IS-SYNCHRONOUS>
                </BSW-MODULE-CLIENT-SERVER-ENTRY>
[!ENDIF!]

[!IF "as:modconf('FrNm')[1]/FrNmGlobalConfig/FrNmGlobalFeatures/FrNmPassiveModeEnabled='false'"!]
                <BSW-MODULE-CLIENT-SERVER-ENTRY>
                  <SHORT-NAME>ProvidedCSEntry_FrNm_NetworkRelease_[!"node:name(.)"!]</SHORT-NAME>
                  <ENCAPSULATED-ENTRY-REF DEST="BSW-MODULE-ENTRY">/AUTOSAR_FrNm/BswModuleEntrys/FrNm_NetworkRelease</ENCAPSULATED-ENTRY-REF>
                  <IS-SYNCHRONOUS>false</IS-SYNCHRONOUS>
                </BSW-MODULE-CLIENT-SERVER-ENTRY>
[!ENDIF!]

[!IF "as:modconf('FrNm')[1]/FrNmGlobalConfig/FrNmGlobalFeatures/FrNmBusSynchronizationEnabled='true'"!]
                <BSW-MODULE-CLIENT-SERVER-ENTRY>
                  <SHORT-NAME>ProvidedCSEntry_FrNm_RequestBusSynchronization_[!"node:name(.)"!]</SHORT-NAME>
                  <ENCAPSULATED-ENTRY-REF DEST="BSW-MODULE-ENTRY">/AUTOSAR_FrNm/BswModuleEntrys/FrNm_RequestBusSynchronization</ENCAPSULATED-ENTRY-REF>
                  <IS-SYNCHRONOUS>false</IS-SYNCHRONOUS>
                </BSW-MODULE-CLIENT-SERVER-ENTRY>
[!ENDIF!]
[!ENDLOOP!]
              </PROVIDED-CLIENT-SERVER-ENTRYS>
[!ENDIF!]
[!IF "as:modconf('FrNm')[1]/FrNmGeneral/FrNmMultiCoreSupport = 'true'"!]
              <REQUIRED-CLIENT-SERVER-ENTRYS>
[!LOOP "as:modconf('FrNm')[1]/FrNmChannelConfig/*/FrNmChannel/*"!]              
                <BSW-MODULE-CLIENT-SERVER-ENTRY>
                  <SHORT-NAME>RequiredCSEntry_Nm_NetworkStartIndication_[!"node:name(.)"!]</SHORT-NAME>
                  <ENCAPSULATED-ENTRY-REF DEST="BSW-MODULE-ENTRY">/AUTOSAR_FrNm/BswModuleEntrys/FrNm_MainFunction_[!"num:i(as:ref(FrNmChannelIdentifiers/FrNmChannelHandle)/FrIfClstIdx)"!]</ENCAPSULATED-ENTRY-REF>
                  <IS-SYNCHRONOUS>false</IS-SYNCHRONOUS>
                </BSW-MODULE-CLIENT-SERVER-ENTRY>

                <BSW-MODULE-CLIENT-SERVER-ENTRY>
                  <SHORT-NAME>RequiredCSEntry_Nm_NetworkMode_[!"node:name(.)"!]</SHORT-NAME>
                  <ENCAPSULATED-ENTRY-REF DEST="BSW-MODULE-ENTRY">/AUTOSAR_FrNm/BswModuleEntrys/FrNm_MainFunction_[!"num:i(as:ref(FrNmChannelIdentifiers/FrNmChannelHandle)/FrIfClstIdx)"!]</ENCAPSULATED-ENTRY-REF>
                  <IS-SYNCHRONOUS>false</IS-SYNCHRONOUS>
                </BSW-MODULE-CLIENT-SERVER-ENTRY>

                <BSW-MODULE-CLIENT-SERVER-ENTRY>
                  <SHORT-NAME>RequiredCSEntry_Nm_BusSleepMode_[!"node:name(.)"!]</SHORT-NAME>
                  <ENCAPSULATED-ENTRY-REF DEST="BSW-MODULE-ENTRY">/AUTOSAR_FrNm/BswModuleEntrys/FrNm_MainFunction_[!"num:i(as:ref(FrNmChannelIdentifiers/FrNmChannelHandle)/FrIfClstIdx)"!]</ENCAPSULATED-ENTRY-REF>
                  <IS-SYNCHRONOUS>false</IS-SYNCHRONOUS>
                </BSW-MODULE-CLIENT-SERVER-ENTRY>

[!IF "as:modconf('FrNm')[1]/FrNmGlobalConfig/FrNmGlobalFeatures/FrNmRemoteSleepIndicationEnabled = 'true'"!]
                <BSW-MODULE-CLIENT-SERVER-ENTRY>
                  <SHORT-NAME>RequiredCSEntry_Nm_RemoteSleepIndication_[!"node:name(.)"!]</SHORT-NAME>
                  <ENCAPSULATED-ENTRY-REF DEST="BSW-MODULE-ENTRY">/AUTOSAR_FrNm/BswModuleEntrys/FrNm_MainFunction_[!"num:i(as:ref(FrNmChannelIdentifiers/FrNmChannelHandle)/FrIfClstIdx)"!]</ENCAPSULATED-ENTRY-REF>
                  <IS-SYNCHRONOUS>false</IS-SYNCHRONOUS>
                </BSW-MODULE-CLIENT-SERVER-ENTRY>
[!ENDIF!]

[!IF "as:modconf('FrNm')[1]/FrNmGlobalConfig/FrNmGlobalFeatures/FrNmRemoteSleepIndicationEnabled = 'true'"!]
                <BSW-MODULE-CLIENT-SERVER-ENTRY>
                  <SHORT-NAME>RequiredCSEntry_Nm_RemoteSleepCancellation_[!"node:name(.)"!]</SHORT-NAME>
                  <ENCAPSULATED-ENTRY-REF DEST="BSW-MODULE-ENTRY">/AUTOSAR_FrNm/BswModuleEntrys/FrNm_MainFunction_[!"num:i(as:ref(FrNmChannelIdentifiers/FrNmChannelHandle)/FrIfClstIdx)"!]</ENCAPSULATED-ENTRY-REF>
                  <IS-SYNCHRONOUS>false</IS-SYNCHRONOUS>
                </BSW-MODULE-CLIENT-SERVER-ENTRY>
[!ENDIF!]

[!IF "as:modconf('FrNm')[1]/FrNmGlobalConfig/FrNmGlobalFeatures/FrNmCoordinatorSyncSupport = 'true'"!]
                <BSW-MODULE-CLIENT-SERVER-ENTRY>
                  <SHORT-NAME>RequiredCSEntry_Nm_CoordReadyToSleepIndication_[!"node:name(.)"!]</SHORT-NAME>
                  <ENCAPSULATED-ENTRY-REF DEST="BSW-MODULE-ENTRY">/AUTOSAR_FrNm/BswModuleEntrys/FrNm_Dummy_RxIndication</ENCAPSULATED-ENTRY-REF>
                  <IS-SYNCHRONOUS>false</IS-SYNCHRONOUS>
                </BSW-MODULE-CLIENT-SERVER-ENTRY>
[!ENDIF!]

[!IF "FrNmChannelIdentifiers/FrNmSynchronizationPointEnabled='true'"!]
                <BSW-MODULE-CLIENT-SERVER-ENTRY>
                  <SHORT-NAME>RequiredCSEntry_Nm_SynchronizationPoint_[!"node:name(.)"!]</SHORT-NAME>
                  <ENCAPSULATED-ENTRY-REF DEST="BSW-MODULE-ENTRY">/AUTOSAR_FrNm/BswModuleEntrys/FrNm_MainFunction_[!"num:i(as:ref(FrNmChannelIdentifiers/FrNmChannelHandle)/FrIfClstIdx)"!]</ENCAPSULATED-ENTRY-REF>
                  <IS-SYNCHRONOUS>false</IS-SYNCHRONOUS>
                </BSW-MODULE-CLIENT-SERVER-ENTRY>
[!ENDIF!]

[!IF "as:modconf('FrNm')[1]/FrNmGlobalConfig/FrNmGlobalFeatures/FrNmPduRxIndicationEnabled = 'true'"!]
                <BSW-MODULE-CLIENT-SERVER-ENTRY>
                  <SHORT-NAME>RequiredCSEntry_Nm_PduRxIndication_[!"node:name(.)"!]</SHORT-NAME>
                  <ENCAPSULATED-ENTRY-REF DEST="BSW-MODULE-ENTRY">/AUTOSAR_FrNm/BswModuleEntrys/FrNm_MainFunction_[!"num:i(as:ref(FrNmChannelIdentifiers/FrNmChannelHandle)/FrIfClstIdx)"!]</ENCAPSULATED-ENTRY-REF>
                  <IS-SYNCHRONOUS>false</IS-SYNCHRONOUS>
                </BSW-MODULE-CLIENT-SERVER-ENTRY>
[!ENDIF!]

[!IF "as:modconf('FrNm')[1]/FrNmGlobalConfig/FrNmGlobalFeatures/FrNmStateChangeIndicationEnabled = 'true'"!]
                <BSW-MODULE-CLIENT-SERVER-ENTRY>
                  <SHORT-NAME>RequiredCSEntry_Nm_StateChangeNotification_[!"node:name(.)"!]</SHORT-NAME>
                  <ENCAPSULATED-ENTRY-REF DEST="BSW-MODULE-ENTRY">/AUTOSAR_FrNm/BswModuleEntrys/FrNm_MainFunction_[!"num:i(as:ref(FrNmChannelIdentifiers/FrNmChannelHandle)/FrIfClstIdx)"!]</ENCAPSULATED-ENTRY-REF>
                  <IS-SYNCHRONOUS>false</IS-SYNCHRONOUS>
                </BSW-MODULE-CLIENT-SERVER-ENTRY>
[!ENDIF!]

                <BSW-MODULE-CLIENT-SERVER-ENTRY>
                  <SHORT-NAME>RequiredCSEntry_Nm_TxTimeoutException_[!"node:name(.)"!]</SHORT-NAME>
                  <ENCAPSULATED-ENTRY-REF DEST="BSW-MODULE-ENTRY">/AUTOSAR_FrNm/BswModuleEntrys/FrNm_MainFunction_[!"num:i(as:ref(FrNmChannelIdentifiers/FrNmChannelHandle)/FrIfClstIdx)"!]</ENCAPSULATED-ENTRY-REF>
                  <IS-SYNCHRONOUS>false</IS-SYNCHRONOUS>
                </BSW-MODULE-CLIENT-SERVER-ENTRY>

[!IF "FrNmChannelIdentifiers/FrNmCarWakeUpRxEnabled='true'"!]
                <BSW-MODULE-CLIENT-SERVER-ENTRY>
                  <SHORT-NAME>RequiredCSEntry_Nm_CarWakeUpIndication_[!"node:name(.)"!]</SHORT-NAME>
                  <ENCAPSULATED-ENTRY-REF DEST="BSW-MODULE-ENTRY">/AUTOSAR_FrNm/BswModuleEntrys/FrNm_Dummy_RxIndication</ENCAPSULATED-ENTRY-REF>
                  <IS-SYNCHRONOUS>false</IS-SYNCHRONOUS>
                </BSW-MODULE-CLIENT-SERVER-ENTRY>
[!ENDIF!]
[!ENDLOOP!]
              </REQUIRED-CLIENT-SERVER-ENTRYS>
[!ENDIF!]

              <INTERNAL-BEHAVIORS>
                <BSW-INTERNAL-BEHAVIOR>
                  <SHORT-NAME>InternalBehavior_0</SHORT-NAME>
                  <EXCLUSIVE-AREAS>
                    <EXCLUSIVE-AREA>
                      <SHORT-NAME>SCHM_FRNM_EXCLUSIVE_AREA_0</SHORT-NAME>
                    </EXCLUSIVE-AREA>
                  </EXCLUSIVE-AREAS>
[!IF "as:modconf('FrNm')[1]/FrNmGeneral/FrNmMultiCoreSupport = 'true'"!]
                  <INTERNAL-TRIGGERING-POINTS>
[!LOOP "as:modconf('FrNm')[1]/FrNmChannelConfig/*/FrNmChannel/*"!]
[!IF "(as:modconf('FrNm')[1]/FrNmGlobalConfig/FrNmGlobalFeatures/FrNmCoordinatorSyncSupport = 'true') or
      (FrNmChannelIdentifiers/FrNmCarWakeUpRxEnabled='true')"!]
                    <BSW-INTERNAL-TRIGGERING-POINT>
                      <SHORT-NAME>TriggeringPoint_RxIndication_[!"node:name(.)"!]</SHORT-NAME>
                    </BSW-INTERNAL-TRIGGERING-POINT>
[!ENDIF!]
[!ENDLOOP!]
                  </INTERNAL-TRIGGERING-POINTS>
[!ENDIF!]
                  <ENTITYS>
[!LOOP "node:order(FrNmChannelConfig/*/FrNmChannel/*, 'node:value(node:ref(FrNmChannelIdentifiers/FrNmChannelHandle)/FrIfClstIdx)')"!]
                    <BSW-SCHEDULABLE-ENTITY>
                      <SHORT-NAME>FrNm_MainFunction_[!"num:i(as:ref(FrNmChannelIdentifiers/FrNmChannelHandle)/FrIfClstIdx)"!]</SHORT-NAME>
                      <CAN-ENTER-EXCLUSIVE-AREA-REFS>
                        <CAN-ENTER-EXCLUSIVE-AREA-REF DEST="EXCLUSIVE-AREA">/AUTOSAR_FrNm/BswModuleDescriptions/FrNm/InternalBehavior_0/SCHM_FRNM_EXCLUSIVE_AREA_0</CAN-ENTER-EXCLUSIVE-AREA-REF>
                      </CAN-ENTER-EXCLUSIVE-AREA-REFS>
                      <MINIMUM-START-INTERVAL>0.0</MINIMUM-START-INTERVAL>
[!IF "as:modconf('FrNm')[1]/FrNmGeneral/FrNmMultiCoreSupport = 'true'"!]
                      <CALL-POINTS>
                        <BSW-ASYNCHRONOUS-SERVER-CALL-POINT>
                          <SHORT-NAME>AsynchCallPoint_Nm_NetworkStartIndication_[!"node:name(.)"!]</SHORT-NAME>
                          <CALLED-ENTRY-REF DEST="BSW-MODULE-CLIENT-SERVER-ENTRY">/AUTOSAR_FrNm/BswModuleDescriptions/FrNm/RequiredCSEntry_Nm_NetworkStartIndication_[!"node:name(.)"!]</CALLED-ENTRY-REF>
                        </BSW-ASYNCHRONOUS-SERVER-CALL-POINT>
                        <BSW-ASYNCHRONOUS-SERVER-CALL-POINT>
                          <SHORT-NAME>AsynchCallPoint_Nm_NetworkMode_[!"node:name(.)"!]</SHORT-NAME>
                          <CALLED-ENTRY-REF DEST="BSW-MODULE-CLIENT-SERVER-ENTRY">/AUTOSAR_FrNm/BswModuleDescriptions/FrNm/RequiredCSEntry_Nm_NetworkMode_[!"node:name(.)"!]</CALLED-ENTRY-REF>
                        </BSW-ASYNCHRONOUS-SERVER-CALL-POINT>
                        <BSW-ASYNCHRONOUS-SERVER-CALL-POINT>
                          <SHORT-NAME>AsynchCallPoint_Nm_BusSleepMode_[!"node:name(.)"!]</SHORT-NAME>
                          <CALLED-ENTRY-REF DEST="BSW-MODULE-CLIENT-SERVER-ENTRY">/AUTOSAR_FrNm/BswModuleDescriptions/FrNm/RequiredCSEntry_Nm_BusSleepMode_[!"node:name(.)"!]</CALLED-ENTRY-REF>
                        </BSW-ASYNCHRONOUS-SERVER-CALL-POINT>
[!IF "as:modconf('FrNm')[1]/FrNmGlobalConfig/FrNmGlobalFeatures/FrNmRemoteSleepIndicationEnabled = 'true'"!]
                        <BSW-ASYNCHRONOUS-SERVER-CALL-POINT>
                          <SHORT-NAME>AsynchCallPoint_Nm_RemoteSleepIndication_[!"node:name(.)"!]</SHORT-NAME>
                          <CALLED-ENTRY-REF DEST="BSW-MODULE-CLIENT-SERVER-ENTRY">/AUTOSAR_FrNm/BswModuleDescriptions/FrNm/RequiredCSEntry_Nm_RemoteSleepIndication_[!"node:name(.)"!]</CALLED-ENTRY-REF>
                        </BSW-ASYNCHRONOUS-SERVER-CALL-POINT>
[!ENDIF!]
[!IF "as:modconf('FrNm')[1]/FrNmGlobalConfig/FrNmGlobalFeatures/FrNmRemoteSleepIndicationEnabled = 'true'"!]
                        <BSW-ASYNCHRONOUS-SERVER-CALL-POINT>
                          <SHORT-NAME>AsynchCallPoint_Nm_RemoteSleepCancellation_[!"node:name(.)"!]</SHORT-NAME>
                          <CALLED-ENTRY-REF DEST="BSW-MODULE-CLIENT-SERVER-ENTRY">/AUTOSAR_FrNm/BswModuleDescriptions/FrNm/RequiredCSEntry_Nm_RemoteSleepCancellation_[!"node:name(.)"!]</CALLED-ENTRY-REF>
                        </BSW-ASYNCHRONOUS-SERVER-CALL-POINT>
[!ENDIF!]
[!IF "FrNmChannelIdentifiers/FrNmSynchronizationPointEnabled='true'"!]
                        <BSW-ASYNCHRONOUS-SERVER-CALL-POINT>
                          <SHORT-NAME>AsynchCallPoint_Nm_SynchronizationPoint_[!"node:name(.)"!]</SHORT-NAME>
                          <CALLED-ENTRY-REF DEST="BSW-MODULE-CLIENT-SERVER-ENTRY">/AUTOSAR_FrNm/BswModuleDescriptions/FrNm/RequiredCSEntry_Nm_SynchronizationPoint_[!"node:name(.)"!]</CALLED-ENTRY-REF>
                        </BSW-ASYNCHRONOUS-SERVER-CALL-POINT>
[!ENDIF!]
[!IF "as:modconf('FrNm')[1]/FrNmGlobalConfig/FrNmGlobalFeatures/FrNmPduRxIndicationEnabled = 'true'"!]
                        <BSW-ASYNCHRONOUS-SERVER-CALL-POINT>
                          <SHORT-NAME>AsynchCallPoint_Nm_PduRxIndication_[!"node:name(.)"!]</SHORT-NAME>
                          <CALLED-ENTRY-REF DEST="BSW-MODULE-CLIENT-SERVER-ENTRY">/AUTOSAR_FrNm/BswModuleDescriptions/FrNm/RequiredCSEntry_Nm_PduRxIndication_[!"node:name(.)"!]</CALLED-ENTRY-REF>
                        </BSW-ASYNCHRONOUS-SERVER-CALL-POINT>
[!ENDIF!]
[!IF "as:modconf('FrNm')[1]/FrNmGlobalConfig/FrNmGlobalFeatures/FrNmStateChangeIndicationEnabled = 'true'"!]
                        <BSW-ASYNCHRONOUS-SERVER-CALL-POINT>
                          <SHORT-NAME>AsynchCallPoint_Nm_StateChangeNotification_[!"node:name(.)"!]</SHORT-NAME>
                          <CALLED-ENTRY-REF DEST="BSW-MODULE-CLIENT-SERVER-ENTRY">/AUTOSAR_FrNm/BswModuleDescriptions/FrNm/RequiredCSEntry_Nm_StateChangeNotification_[!"node:name(.)"!]</CALLED-ENTRY-REF>
                        </BSW-ASYNCHRONOUS-SERVER-CALL-POINT>
[!ENDIF!]
                        <BSW-ASYNCHRONOUS-SERVER-CALL-POINT>
                          <SHORT-NAME>AsynchCallPoint_Nm_TxTimeoutException_[!"node:name(.)"!]</SHORT-NAME>
                          <CALLED-ENTRY-REF DEST="BSW-MODULE-CLIENT-SERVER-ENTRY">/AUTOSAR_FrNm/BswModuleDescriptions/FrNm/RequiredCSEntry_Nm_TxTimeoutException_[!"node:name(.)"!]</CALLED-ENTRY-REF>
                        </BSW-ASYNCHRONOUS-SERVER-CALL-POINT>

                        </CALL-POINTS>
[!ENDIF!]
                      <IMPLEMENTED-ENTRY-REF DEST="BSW-MODULE-ENTRY">/AUTOSAR_FrNm/BswModuleEntrys/FrNm_MainFunction_[!"num:i(as:ref(FrNmChannelIdentifiers/FrNmChannelHandle)/FrIfClstIdx)"!]</IMPLEMENTED-ENTRY-REF>
                    </BSW-SCHEDULABLE-ENTITY>
[!ENDLOOP!]

[!IF "as:modconf('FrNm')[1]/FrNmGeneral/FrNmMultiCoreSupport = 'true'"!]
[!LOOP "as:modconf('FrNm')[1]/FrNmChannelConfig/*/FrNmChannel/*"!]
[!IF "(as:modconf('FrNm')[1]/FrNmGlobalConfig/FrNmGlobalFeatures/FrNmCoordinatorSyncSupport = 'true') or
      (FrNmChannelIdentifiers/FrNmCarWakeUpRxEnabled='true')"!]
                    <!-- dummy context for RxIndication used -->
                    <BSW-SCHEDULABLE-ENTITY>
                      <SHORT-NAME>Entity_Nm_RxInidcation_[!"node:name(.)"!]</SHORT-NAME>
                      <MINIMUM-START-INTERVAL>0.0</MINIMUM-START-INTERVAL>
                      <CALL-POINTS>
[!IF "as:modconf('FrNm')[1]/FrNmGlobalConfig/FrNmGlobalFeatures/FrNmCoordinatorSyncSupport = 'true'"!]
                        <BSW-ASYNCHRONOUS-SERVER-CALL-POINT>
                          <SHORT-NAME>AsynchCallPoint_Nm_CoordReadyToSleepIndication_[!"node:name(.)"!]</SHORT-NAME>
                          <CALLED-ENTRY-REF DEST="BSW-MODULE-CLIENT-SERVER-ENTRY">/AUTOSAR_FrNm/BswModuleDescriptions/FrNm/RequiredCSEntry_Nm_CoordReadyToSleepIndication_[!"node:name(.)"!]</CALLED-ENTRY-REF>
                        </BSW-ASYNCHRONOUS-SERVER-CALL-POINT>
[!ENDIF!]
[!IF "FrNmChannelIdentifiers/FrNmCarWakeUpRxEnabled='true'"!]
                        <BSW-ASYNCHRONOUS-SERVER-CALL-POINT>
                          <SHORT-NAME>AsynchCallPoint_Nm_CarWakeUpIndication_[!"node:name(.)"!]</SHORT-NAME>
                          <CALLED-ENTRY-REF DEST="BSW-MODULE-CLIENT-SERVER-ENTRY">/AUTOSAR_FrNm/BswModuleDescriptions/FrNm/RequiredCSEntry_Nm_CarWakeUpIndication_[!"node:name(.)"!]</CALLED-ENTRY-REF>
                        </BSW-ASYNCHRONOUS-SERVER-CALL-POINT>
[!ENDIF!]
                      </CALL-POINTS>
                      <IMPLEMENTED-ENTRY-REF DEST="BSW-MODULE-ENTRY">/AUTOSAR_FrNm/BswModuleEntrys/FrNm_Dummy_RxIndication</IMPLEMENTED-ENTRY-REF>
                    </BSW-SCHEDULABLE-ENTITY>
[!ENDIF!]
[!ENDLOOP!]
[!ENDIF!]
[!IF "as:modconf('FrNm')[1]/FrNmGeneral/FrNmMultiCoreSupport = 'true'"!]
[!LOOP "as:modconf('FrNm')[1]/FrNmChannelConfig/*/FrNmChannel/*"!]
                    <BSW-CALLED-ENTITY>
                      <SHORT-NAME>FrNm_PassiveStartUp_CalledEntity_[!"node:name(.)"!]</SHORT-NAME>
                      <MINIMUM-START-INTERVAL>0.0</MINIMUM-START-INTERVAL>
                      <IMPLEMENTED-ENTRY-REF DEST="BSW-MODULE-ENTRY">/AUTOSAR_FrNm/BswModuleEntrys/FrNm_PassiveStartUp</IMPLEMENTED-ENTRY-REF>
                    </BSW-CALLED-ENTITY>

[!IF "as:modconf('FrNm')[1]/FrNmGlobalConfig/FrNmGlobalFeatures/FrNmPassiveModeEnabled='false'"!]
                    <BSW-CALLED-ENTITY>
                      <SHORT-NAME>FrNm_NetworkRequest_CalledEntity_[!"node:name(.)"!]</SHORT-NAME>
                      <MINIMUM-START-INTERVAL>0.0</MINIMUM-START-INTERVAL>
                      <IMPLEMENTED-ENTRY-REF DEST="BSW-MODULE-ENTRY">/AUTOSAR_FrNm/BswModuleEntrys/FrNm_NetworkRequest</IMPLEMENTED-ENTRY-REF>
                    </BSW-CALLED-ENTITY>
[!ENDIF!]

[!IF "as:modconf('FrNm')[1]/FrNmGlobalConfig/FrNmGlobalFeatures/FrNmPassiveModeEnabled='false'"!]
                    <BSW-CALLED-ENTITY>
                      <SHORT-NAME>FrNm_NetworkGwEraRequest_CalledEntity_[!"node:name(.)"!]</SHORT-NAME>
                      <MINIMUM-START-INTERVAL>0.0</MINIMUM-START-INTERVAL>
                      <IMPLEMENTED-ENTRY-REF DEST="BSW-MODULE-ENTRY">/AUTOSAR_FrNm/BswModuleEntrys/FrNm_NetworkGwEraRequest</IMPLEMENTED-ENTRY-REF>
                    </BSW-CALLED-ENTITY>
[!ENDIF!]

[!IF "as:modconf('FrNm')[1]/FrNmGlobalConfig/FrNmGlobalFeatures/FrNmPassiveModeEnabled='false'"!]
                    <BSW-CALLED-ENTITY>
                      <SHORT-NAME>FrNm_NetworkRelease_CalledEntity_[!"node:name(.)"!]</SHORT-NAME>
                      <MINIMUM-START-INTERVAL>0.0</MINIMUM-START-INTERVAL>
                      <IMPLEMENTED-ENTRY-REF DEST="BSW-MODULE-ENTRY">/AUTOSAR_FrNm/BswModuleEntrys/FrNm_NetworkRelease</IMPLEMENTED-ENTRY-REF>
                    </BSW-CALLED-ENTITY>
[!ENDIF!]

[!IF "as:modconf('FrNm')[1]/FrNmGlobalConfig/FrNmGlobalFeatures/FrNmBusSynchronizationEnabled='true'"!]
                    <BSW-CALLED-ENTITY>
                      <SHORT-NAME>FrNm_RequestBusSynchronization_CalledEntity_[!"node:name(.)"!]</SHORT-NAME>
                      <MINIMUM-START-INTERVAL>0.0</MINIMUM-START-INTERVAL>
                      <IMPLEMENTED-ENTRY-REF DEST="BSW-MODULE-ENTRY">/AUTOSAR_FrNm/BswModuleEntrys/FrNm_RequestBusSynchronization</IMPLEMENTED-ENTRY-REF>
                    </BSW-CALLED-ENTITY>
[!ENDIF!]
[!ENDLOOP!]
[!ENDIF!]

                  </ENTITYS>
                  <EVENTS>
[!LOOP "node:order(FrNmChannelConfig/*/FrNmChannel/*, 'node:value(node:ref(FrNmChannelIdentifiers/FrNmChannelHandle)/FrIfClstIdx)')"!]
                    <BSW-TIMING-EVENT>
                      <SHORT-NAME>TimingEvent_MainFunction_[!"num:i(as:ref(FrNmChannelIdentifiers/FrNmChannelHandle)/FrIfClstIdx)"!]</SHORT-NAME>
                      <STARTS-ON-EVENT-REF DEST="BSW-SCHEDULABLE-ENTITY">/AUTOSAR_FrNm/BswModuleDescriptions/FrNm/InternalBehavior_0/FrNm_MainFunction_[!"num:i(as:ref(FrNmChannelIdentifiers/FrNmChannelHandle)/FrIfClstIdx)"!]</STARTS-ON-EVENT-REF>
                      <PERIOD>[!"FrNmChannelTiming/FrNmMainFunctionPeriod"!]</PERIOD>
                    </BSW-TIMING-EVENT>
[!ENDLOOP!]
[!IF "as:modconf('FrNm')[1]/FrNmGeneral/FrNmMultiCoreSupport = 'true'"!]
[!LOOP "as:modconf('FrNm')[1]/FrNmChannelConfig/*/FrNmChannel/*"!]
[!IF "(as:modconf('FrNm')[1]/FrNmGlobalConfig/FrNmGlobalFeatures/FrNmCoordinatorSyncSupport = 'true') or
      (FrNmChannelIdentifiers/FrNmCarWakeUpRxEnabled='true')"!]
                    <BSW-INTERNAL-TRIGGER-OCCURRED-EVENT>
                      <SHORT-NAME>IntTrigggering_RxIndication_Event_[!"node:name(.)"!]</SHORT-NAME>
                      <STARTS-ON-EVENT-REF DEST="BSW-SCHEDULABLE-ENTITY">/AUTOSAR_FrNm/BswModuleDescriptions/FrNm/InternalBehavior_0/Entity_Nm_RxInidcation_[!"node:name(.)"!]</STARTS-ON-EVENT-REF>
                      <EVENT-SOURCE-REF DEST="BSW-INTERNAL-TRIGGERING-POINT">/AUTOSAR_FrNm/BswModuleDescriptions/FrNm/InternalBehavior_0/TriggeringPoint_RxIndication_[!"node:name(.)"!]</EVENT-SOURCE-REF>
                    </BSW-INTERNAL-TRIGGER-OCCURRED-EVENT>
[!ENDIF!]
                    <BSW-OPERATION-INVOKED-EVENT>
                      <SHORT-NAME>OpInokedEv_FrNm_PassiveStartUp_[!"node:name(.)"!]</SHORT-NAME>
                      <STARTS-ON-EVENT-REF DEST="BSW-CALLED-ENTITY">/AUTOSAR_FrNm/BswModuleDescriptions/FrNm/InternalBehavior_0/FrNm_PassiveStartUp_CalledEntity_[!"node:name(.)"!]</STARTS-ON-EVENT-REF>
                      <ENTRY-REF DEST="BSW-MODULE-CLIENT-SERVER-ENTRY">/AUTOSAR_FrNm/BswModuleDescriptions/FrNm/ProvidedCSEntry_FrNm_PassiveStartUp_[!"node:name(.)"!]</ENTRY-REF>
                    </BSW-OPERATION-INVOKED-EVENT>

[!IF "as:modconf('FrNm')[1]/FrNmGlobalConfig/FrNmGlobalFeatures/FrNmPassiveModeEnabled='false'"!]
                    <BSW-OPERATION-INVOKED-EVENT>
                      <SHORT-NAME>OpInokedEv_FrNm_NetworkRequest_[!"node:name(.)"!]</SHORT-NAME>
                      <STARTS-ON-EVENT-REF DEST="BSW-CALLED-ENTITY">/AUTOSAR_FrNm/BswModuleDescriptions/FrNm/InternalBehavior_0/FrNm_NetworkRequest_CalledEntity_[!"node:name(.)"!]</STARTS-ON-EVENT-REF>
                      <ENTRY-REF DEST="BSW-MODULE-CLIENT-SERVER-ENTRY">/AUTOSAR_FrNm/BswModuleDescriptions/FrNm/ProvidedCSEntry_FrNm_NetworkRequest_[!"node:name(.)"!]</ENTRY-REF>
                    </BSW-OPERATION-INVOKED-EVENT>
[!ENDIF!]

[!IF "as:modconf('FrNm')[1]/FrNmGlobalConfig/FrNmGlobalFeatures/FrNmPassiveModeEnabled='false'"!]
                    <BSW-OPERATION-INVOKED-EVENT>
                      <SHORT-NAME>OpInokedEv_FrNm_NetworkGwEraRequest_[!"node:name(.)"!]</SHORT-NAME>
                      <STARTS-ON-EVENT-REF DEST="BSW-CALLED-ENTITY">/AUTOSAR_FrNm/BswModuleDescriptions/FrNm/InternalBehavior_0/FrNm_NetworkGwEraRequest_CalledEntity_[!"node:name(.)"!]</STARTS-ON-EVENT-REF>
                      <ENTRY-REF DEST="BSW-MODULE-CLIENT-SERVER-ENTRY">/AUTOSAR_FrNm/BswModuleDescriptions/FrNm/ProvidedCSEntry_FrNm_NetworkGwEraRequest_[!"node:name(.)"!]</ENTRY-REF>
                    </BSW-OPERATION-INVOKED-EVENT>
[!ENDIF!]

[!IF "as:modconf('FrNm')[1]/FrNmGlobalConfig/FrNmGlobalFeatures/FrNmPassiveModeEnabled='false'"!]
                    <BSW-OPERATION-INVOKED-EVENT>
                      <SHORT-NAME>OpInokedEv_FrNm_NetworkRelease_[!"node:name(.)"!]</SHORT-NAME>
                      <STARTS-ON-EVENT-REF DEST="BSW-CALLED-ENTITY">/AUTOSAR_FrNm/BswModuleDescriptions/FrNm/InternalBehavior_0/FrNm_NetworkRelease_CalledEntity_[!"node:name(.)"!]</STARTS-ON-EVENT-REF>
                      <ENTRY-REF DEST="BSW-MODULE-CLIENT-SERVER-ENTRY">/AUTOSAR_FrNm/BswModuleDescriptions/FrNm/ProvidedCSEntry_FrNm_NetworkRelease_[!"node:name(.)"!]</ENTRY-REF>
                    </BSW-OPERATION-INVOKED-EVENT>
[!ENDIF!]

[!IF "as:modconf('FrNm')[1]/FrNmGlobalConfig/FrNmGlobalFeatures/FrNmBusSynchronizationEnabled='true'"!]
                    <BSW-OPERATION-INVOKED-EVENT>
                      <SHORT-NAME>OpInokedEv_FrNm_RequestBusSynchronization_[!"node:name(.)"!]</SHORT-NAME>
                      <STARTS-ON-EVENT-REF DEST="BSW-CALLED-ENTITY">/AUTOSAR_FrNm/BswModuleDescriptions/FrNm/InternalBehavior_0/FrNm_RequestBusSynchronization_CalledEntity_[!"node:name(.)"!]</STARTS-ON-EVENT-REF>
                      <ENTRY-REF DEST="BSW-MODULE-CLIENT-SERVER-ENTRY">/AUTOSAR_FrNm/BswModuleDescriptions/FrNm/ProvidedCSEntry_FrNm_RequestBusSynchronization_[!"node:name(.)"!]</ENTRY-REF>
                    </BSW-OPERATION-INVOKED-EVENT>
[!ENDIF!]
[!ENDLOOP!]
[!ENDIF!]
                  </EVENTS>
                </BSW-INTERNAL-BEHAVIOR>
              </INTERNAL-BEHAVIORS>
            </BSW-MODULE-DESCRIPTION>
          </ELEMENTS>
        </AR-PACKAGE>
        <AR-PACKAGE>
          <SHORT-NAME>BswModuleEntrys</SHORT-NAME>
          <ELEMENTS>
            [!LOOP "node:order(FrNmChannelConfig/*/FrNmChannel/*, 'node:value(node:ref(FrNmChannelIdentifiers/FrNmChannelHandle)/FrIfClstIdx)')"!]
            <BSW-MODULE-ENTRY>
              <SHORT-NAME>FrNm_MainFunction_[!"num:i(as:ref(FrNmChannelIdentifiers/FrNmChannelHandle)/FrIfClstIdx)"!]</SHORT-NAME>
              <SERVICE-ID>[!"num:i(as:ref(FrNmChannelIdentifiers/FrNmChannelHandle)/FrIfClstIdx + 240)"!]</SERVICE-ID>
              <IS-REENTRANT>false</IS-REENTRANT>
              <IS-SYNCHRONOUS>true</IS-SYNCHRONOUS>
              <CALL-TYPE>SCHEDULED</CALL-TYPE>
              <EXECUTION-CONTEXT>TASK</EXECUTION-CONTEXT>
              <SW-SERVICE-IMPL-POLICY>STANDARD</SW-SERVICE-IMPL-POLICY>
            </BSW-MODULE-ENTRY>
            [!ENDLOOP!]

[!IF "as:modconf('FrNm')[1]/FrNmGeneral/FrNmMultiCoreSupport = 'true'"!]

            <BSW-MODULE-ENTRY>
              <SHORT-NAME>FrNm_Dummy_RxIndication</SHORT-NAME>
              <ADMIN-DATA>
                <SDGS>
                  <SDG GID="EB:DnT">
                    <SD GID="FunctionGroup">Extern</SD>
                    <SD GID="EnableTracing">true</SD>
                  </SDG>
                 </SDGS>
              </ADMIN-DATA>
              <SERVICE-ID>255</SERVICE-ID>
              <IS-REENTRANT>true</IS-REENTRANT>
              <IS-SYNCHRONOUS>false</IS-SYNCHRONOUS>
              <CALL-TYPE>SCHEDULED</CALL-TYPE>
              <EXECUTION-CONTEXT>TASK</EXECUTION-CONTEXT>
              <SW-SERVICE-IMPL-POLICY>STANDARD</SW-SERVICE-IMPL-POLICY>
              <ARGUMENTS>
              </ARGUMENTS>
            </BSW-MODULE-ENTRY>

            <BSW-MODULE-ENTRY>
              <SHORT-NAME>FrNm_PassiveStartUp</SHORT-NAME>
              <ADMIN-DATA>
                <SDGS>
                  <SDG GID="EB:DnT">
                    <SD GID="FunctionGroup">Extern</SD>
                    <SD GID="EnableTracing">true</SD>
                  </SDG>
                 </SDGS>
              </ADMIN-DATA>
              <SERVICE-ID>1</SERVICE-ID>
              <IS-REENTRANT>false</IS-REENTRANT>
              <IS-SYNCHRONOUS>false</IS-SYNCHRONOUS>
              <CALL-TYPE>REGULAR</CALL-TYPE>
              <EXECUTION-CONTEXT>TASK</EXECUTION-CONTEXT>
              <SW-SERVICE-IMPL-POLICY>STANDARD</SW-SERVICE-IMPL-POLICY>
              <RETURN-TYPE>
                <SHORT-NAME>RetVal</SHORT-NAME>
                <DIRECTION>OUT</DIRECTION>
                <SW-DATA-DEF-PROPS>
                  <SW-DATA-DEF-PROPS-VARIANTS>
                    <SW-DATA-DEF-PROPS-CONDITIONAL>
                      <IMPLEMENTATION-DATA-TYPE-REF DEST="IMPLEMENTATION-DATA-TYPE">/AUTOSAR_Std/ImplementationDataTypes/Std_ReturnType</IMPLEMENTATION-DATA-TYPE-REF>
                    </SW-DATA-DEF-PROPS-CONDITIONAL>
                  </SW-DATA-DEF-PROPS-VARIANTS>
                </SW-DATA-DEF-PROPS>
              </RETURN-TYPE>
              <ARGUMENTS>
                <SW-SERVICE-ARG>
                  <SHORT-NAME>nmNetworkHandle</SHORT-NAME>
                  <DIRECTION>IN</DIRECTION>
                  <SW-DATA-DEF-PROPS>
                    <SW-DATA-DEF-PROPS-VARIANTS>
                      <SW-DATA-DEF-PROPS-CONDITIONAL>
                        <IMPLEMENTATION-DATA-TYPE-REF DEST="IMPLEMENTATION-DATA-TYPE">/AUTOSAR_Platform/ImplementationDataTypes/uint8</IMPLEMENTATION-DATA-TYPE-REF>
                      </SW-DATA-DEF-PROPS-CONDITIONAL>
                    </SW-DATA-DEF-PROPS-VARIANTS>
                  </SW-DATA-DEF-PROPS>
                </SW-SERVICE-ARG>
              </ARGUMENTS>
            </BSW-MODULE-ENTRY>

[!IF "as:modconf('FrNm')[1]/FrNmGlobalConfig/FrNmGlobalFeatures/FrNmPassiveModeEnabled='false'"!]
            <BSW-MODULE-ENTRY>
              <SHORT-NAME>FrNm_NetworkRequest</SHORT-NAME>
              <ADMIN-DATA>
                <SDGS>
                  <SDG GID="EB:DnT">
                    <SD GID="FunctionGroup">Extern</SD>
                    <SD GID="EnableTracing">true</SD>
                  </SDG>
                 </SDGS>
              </ADMIN-DATA>
              <SERVICE-ID>2</SERVICE-ID>
              <IS-REENTRANT>false</IS-REENTRANT>
              <IS-SYNCHRONOUS>false</IS-SYNCHRONOUS>
              <CALL-TYPE>REGULAR</CALL-TYPE>
              <EXECUTION-CONTEXT>TASK</EXECUTION-CONTEXT>
              <SW-SERVICE-IMPL-POLICY>STANDARD</SW-SERVICE-IMPL-POLICY>
              <RETURN-TYPE>
                <SHORT-NAME>RetVal</SHORT-NAME>
                <DIRECTION>OUT</DIRECTION>
                <SW-DATA-DEF-PROPS>
                  <SW-DATA-DEF-PROPS-VARIANTS>
                    <SW-DATA-DEF-PROPS-CONDITIONAL>
                      <IMPLEMENTATION-DATA-TYPE-REF DEST="IMPLEMENTATION-DATA-TYPE">/AUTOSAR_Std/ImplementationDataTypes/Std_ReturnType</IMPLEMENTATION-DATA-TYPE-REF>
                    </SW-DATA-DEF-PROPS-CONDITIONAL>
                  </SW-DATA-DEF-PROPS-VARIANTS>
                </SW-DATA-DEF-PROPS>
              </RETURN-TYPE>
              <ARGUMENTS>
                <SW-SERVICE-ARG>
                  <SHORT-NAME>nmNetworkHandle</SHORT-NAME>
                  <DIRECTION>IN</DIRECTION>
                  <SW-DATA-DEF-PROPS>
                    <SW-DATA-DEF-PROPS-VARIANTS>
                      <SW-DATA-DEF-PROPS-CONDITIONAL>
                        <IMPLEMENTATION-DATA-TYPE-REF DEST="IMPLEMENTATION-DATA-TYPE">/AUTOSAR_Platform/ImplementationDataTypes/uint8</IMPLEMENTATION-DATA-TYPE-REF>
                      </SW-DATA-DEF-PROPS-CONDITIONAL>
                    </SW-DATA-DEF-PROPS-VARIANTS>
                  </SW-DATA-DEF-PROPS>
                </SW-SERVICE-ARG>
              </ARGUMENTS>
            </BSW-MODULE-ENTRY>
[!ENDIF!]

[!IF "as:modconf('FrNm')[1]/FrNmGlobalConfig/FrNmGlobalFeatures/FrNmPassiveModeEnabled='false'"!]
            <BSW-MODULE-ENTRY>
              <SHORT-NAME>FrNm_NetworkGwEraRequest</SHORT-NAME>
              <ADMIN-DATA>
                <SDGS>
                  <SDG GID="EB:DnT">
                    <SD GID="FunctionGroup">Extern</SD>
                    <SD GID="EnableTracing">true</SD>
                  </SDG>
                 </SDGS>
              </ADMIN-DATA>
              <SERVICE-ID>254</SERVICE-ID>
              <IS-REENTRANT>false</IS-REENTRANT>
              <IS-SYNCHRONOUS>false</IS-SYNCHRONOUS>
              <CALL-TYPE>REGULAR</CALL-TYPE>
              <EXECUTION-CONTEXT>TASK</EXECUTION-CONTEXT>
              <SW-SERVICE-IMPL-POLICY>STANDARD</SW-SERVICE-IMPL-POLICY>
              <RETURN-TYPE>
                <SHORT-NAME>RetVal</SHORT-NAME>
                <DIRECTION>OUT</DIRECTION>
                <SW-DATA-DEF-PROPS>
                  <SW-DATA-DEF-PROPS-VARIANTS>
                    <SW-DATA-DEF-PROPS-CONDITIONAL>
                      <IMPLEMENTATION-DATA-TYPE-REF DEST="IMPLEMENTATION-DATA-TYPE">/AUTOSAR_Std/ImplementationDataTypes/Std_ReturnType</IMPLEMENTATION-DATA-TYPE-REF>
                    </SW-DATA-DEF-PROPS-CONDITIONAL>
                  </SW-DATA-DEF-PROPS-VARIANTS>
                </SW-DATA-DEF-PROPS>
              </RETURN-TYPE>
              <ARGUMENTS>
                <SW-SERVICE-ARG>
                  <SHORT-NAME>nmNetworkHandle</SHORT-NAME>
                  <DIRECTION>IN</DIRECTION>
                  <SW-DATA-DEF-PROPS>
                    <SW-DATA-DEF-PROPS-VARIANTS>
                      <SW-DATA-DEF-PROPS-CONDITIONAL>
                        <IMPLEMENTATION-DATA-TYPE-REF DEST="IMPLEMENTATION-DATA-TYPE">/AUTOSAR_Platform/ImplementationDataTypes/uint8</IMPLEMENTATION-DATA-TYPE-REF>
                      </SW-DATA-DEF-PROPS-CONDITIONAL>
                    </SW-DATA-DEF-PROPS-VARIANTS>
                  </SW-DATA-DEF-PROPS>
                </SW-SERVICE-ARG>
              </ARGUMENTS>
            </BSW-MODULE-ENTRY>
[!ENDIF!]

[!IF "as:modconf('FrNm')[1]/FrNmGlobalConfig/FrNmGlobalFeatures/FrNmPassiveModeEnabled='false'"!]
            <BSW-MODULE-ENTRY>
              <SHORT-NAME>FrNm_NetworkRelease</SHORT-NAME>
              <ADMIN-DATA>
                <SDGS>
                  <SDG GID="EB:DnT">
                    <SD GID="FunctionGroup">Extern</SD>
                    <SD GID="EnableTracing">true</SD>
                  </SDG>
                 </SDGS>
              </ADMIN-DATA>
              <SERVICE-ID>3</SERVICE-ID>
              <IS-REENTRANT>false</IS-REENTRANT>
              <IS-SYNCHRONOUS>false</IS-SYNCHRONOUS>
              <CALL-TYPE>REGULAR</CALL-TYPE>
              <EXECUTION-CONTEXT>TASK</EXECUTION-CONTEXT>
              <SW-SERVICE-IMPL-POLICY>STANDARD</SW-SERVICE-IMPL-POLICY>
              <RETURN-TYPE>
                <SHORT-NAME>RetVal</SHORT-NAME>
                <DIRECTION>OUT</DIRECTION>
                <SW-DATA-DEF-PROPS>
                  <SW-DATA-DEF-PROPS-VARIANTS>
                    <SW-DATA-DEF-PROPS-CONDITIONAL>
                      <IMPLEMENTATION-DATA-TYPE-REF DEST="IMPLEMENTATION-DATA-TYPE">/AUTOSAR_Std/ImplementationDataTypes/Std_ReturnType</IMPLEMENTATION-DATA-TYPE-REF>
                    </SW-DATA-DEF-PROPS-CONDITIONAL>
                  </SW-DATA-DEF-PROPS-VARIANTS>
                </SW-DATA-DEF-PROPS>
              </RETURN-TYPE>
              <ARGUMENTS>
                <SW-SERVICE-ARG>
                  <SHORT-NAME>nmNetworkHandle</SHORT-NAME>
                  <DIRECTION>IN</DIRECTION>
                  <SW-DATA-DEF-PROPS>
                    <SW-DATA-DEF-PROPS-VARIANTS>
                      <SW-DATA-DEF-PROPS-CONDITIONAL>
                        <IMPLEMENTATION-DATA-TYPE-REF DEST="IMPLEMENTATION-DATA-TYPE">/AUTOSAR_Platform/ImplementationDataTypes/uint8</IMPLEMENTATION-DATA-TYPE-REF>
                      </SW-DATA-DEF-PROPS-CONDITIONAL>
                    </SW-DATA-DEF-PROPS-VARIANTS>
                  </SW-DATA-DEF-PROPS>
                </SW-SERVICE-ARG>
              </ARGUMENTS>
            </BSW-MODULE-ENTRY>
[!ENDIF!]

[!IF "as:modconf('FrNm')[1]/FrNmGlobalConfig/FrNmGlobalFeatures/FrNmBusSynchronizationEnabled='true'"!]
            <BSW-MODULE-ENTRY>
              <SHORT-NAME>FrNm_RequestBusSynchronization</SHORT-NAME>
              <ADMIN-DATA>
                <SDGS>
                  <SDG GID="EB:DnT">
                    <SD GID="FunctionGroup">Extern</SD>
                    <SD GID="EnableTracing">true</SD>
                  </SDG>
                 </SDGS>
              </ADMIN-DATA>
              <SERVICE-ID>192</SERVICE-ID>
              <IS-REENTRANT>false</IS-REENTRANT>
              <IS-SYNCHRONOUS>false</IS-SYNCHRONOUS>
              <CALL-TYPE>REGULAR</CALL-TYPE>
              <EXECUTION-CONTEXT>TASK</EXECUTION-CONTEXT>
              <SW-SERVICE-IMPL-POLICY>STANDARD</SW-SERVICE-IMPL-POLICY>
              <RETURN-TYPE>
                <SHORT-NAME>RetVal</SHORT-NAME>
                <DIRECTION>OUT</DIRECTION>
                <SW-DATA-DEF-PROPS>
                  <SW-DATA-DEF-PROPS-VARIANTS>
                    <SW-DATA-DEF-PROPS-CONDITIONAL>
                      <IMPLEMENTATION-DATA-TYPE-REF DEST="IMPLEMENTATION-DATA-TYPE">/AUTOSAR_Std/ImplementationDataTypes/Std_ReturnType</IMPLEMENTATION-DATA-TYPE-REF>
                    </SW-DATA-DEF-PROPS-CONDITIONAL>
                  </SW-DATA-DEF-PROPS-VARIANTS>
                </SW-DATA-DEF-PROPS>
              </RETURN-TYPE>
              <ARGUMENTS>
                <SW-SERVICE-ARG>
                  <SHORT-NAME>nmNetworkHandle</SHORT-NAME>
                  <DIRECTION>IN</DIRECTION>
                  <SW-DATA-DEF-PROPS>
                    <SW-DATA-DEF-PROPS-VARIANTS>
                      <SW-DATA-DEF-PROPS-CONDITIONAL>
                        <IMPLEMENTATION-DATA-TYPE-REF DEST="IMPLEMENTATION-DATA-TYPE">/AUTOSAR_Platform/ImplementationDataTypes/uint8</IMPLEMENTATION-DATA-TYPE-REF>
                      </SW-DATA-DEF-PROPS-CONDITIONAL>
                    </SW-DATA-DEF-PROPS-VARIANTS>
                  </SW-DATA-DEF-PROPS>
                </SW-SERVICE-ARG>
              </ARGUMENTS>
            </BSW-MODULE-ENTRY>
[!ENDIF!]
[!ENDIF!]

          </ELEMENTS>
        </AR-PACKAGE>
      </AR-PACKAGES>
    </AR-PACKAGE>

    <AR-PACKAGE>
      <SHORT-NAME>EB_FrNm</SHORT-NAME>
      <AR-PACKAGES>
        <AR-PACKAGE>
          <SHORT-NAME>Implementations</SHORT-NAME>
          <ELEMENTS>
            <BSW-IMPLEMENTATION>
              <SHORT-NAME>BswImplementation_0</SHORT-NAME>
              <CODE-DESCRIPTORS>
                <CODE>
                  <SHORT-NAME>Files</SHORT-NAME>
                  <ARTIFACT-DESCRIPTORS>
                    <AUTOSAR-ENGINEERING-OBJECT>
                      <SHORT-LABEL>Autosar::include::FrNm.h</SHORT-LABEL>
                      <CATEGORY>SWHDR</CATEGORY>
                    </AUTOSAR-ENGINEERING-OBJECT>
                    <AUTOSAR-ENGINEERING-OBJECT>
                      <SHORT-LABEL>Autosar::include::FrNm_Api.h</SHORT-LABEL>
                      <CATEGORY>SWHDR</CATEGORY>
                    </AUTOSAR-ENGINEERING-OBJECT>
                    <AUTOSAR-ENGINEERING-OBJECT>
                      <SHORT-LABEL>Autosar::include::FrNm_Cbk.h</SHORT-LABEL>
                      <CATEGORY>SWHDR</CATEGORY>
                    </AUTOSAR-ENGINEERING-OBJECT>
                    <AUTOSAR-ENGINEERING-OBJECT>
                      <SHORT-LABEL>Autosar::include::FrNm_Hsm.h</SHORT-LABEL>
                      <CATEGORY>SWHDR</CATEGORY>
                    </AUTOSAR-ENGINEERING-OBJECT>
                    <AUTOSAR-ENGINEERING-OBJECT>
                      <SHORT-LABEL>Autosar::include::FrNm_HsmCfg.h</SHORT-LABEL>
                      <CATEGORY>SWHDR</CATEGORY>
                    </AUTOSAR-ENGINEERING-OBJECT>
                    <AUTOSAR-ENGINEERING-OBJECT>
                      <SHORT-LABEL>Autosar::include::FrNm_HsmFrNm.h</SHORT-LABEL>
                      <CATEGORY>SWHDR</CATEGORY>
                    </AUTOSAR-ENGINEERING-OBJECT>
                    <AUTOSAR-ENGINEERING-OBJECT>
                      <SHORT-LABEL>Autosar::include::FrNm_HsmFrNmInt.h</SHORT-LABEL>
                      <CATEGORY>SWHDR</CATEGORY>
                    </AUTOSAR-ENGINEERING-OBJECT>
                    <AUTOSAR-ENGINEERING-OBJECT>
                      <SHORT-LABEL>Autosar::include::FrNm_Int.h</SHORT-LABEL>
                      <CATEGORY>SWHDR</CATEGORY>
                    </AUTOSAR-ENGINEERING-OBJECT>
                    <AUTOSAR-ENGINEERING-OBJECT>
                      <SHORT-LABEL>Autosar::include::FrNm_Lcfg_Static.h</SHORT-LABEL>
                      <CATEGORY>SWHDR</CATEGORY>
                    </AUTOSAR-ENGINEERING-OBJECT>
                    <AUTOSAR-ENGINEERING-OBJECT>
                      <SHORT-LABEL>Autosar::include::FrNm_Trace.h</SHORT-LABEL>
                      <CATEGORY>SWHDR</CATEGORY>
                    </AUTOSAR-ENGINEERING-OBJECT>
                    <AUTOSAR-ENGINEERING-OBJECT>
                      <SHORT-LABEL>Autosar::include::FrNm_Trace_Internal.h</SHORT-LABEL>
                      <CATEGORY>SWHDR</CATEGORY>
                    </AUTOSAR-ENGINEERING-OBJECT>
                    <AUTOSAR-ENGINEERING-OBJECT>
                      <SHORT-LABEL>Autosar::include::FrNm_Version.h</SHORT-LABEL>
                      <CATEGORY>SWHDR</CATEGORY>
                    </AUTOSAR-ENGINEERING-OBJECT>
                    <AUTOSAR-ENGINEERING-OBJECT>
                      <SHORT-LABEL>Autosar::src::FrNm.c</SHORT-LABEL>
                      <CATEGORY>SWSRC</CATEGORY>
                    </AUTOSAR-ENGINEERING-OBJECT>
                    <AUTOSAR-ENGINEERING-OBJECT>
                      <SHORT-LABEL>Autosar::src::FrNm_Hsm.c</SHORT-LABEL>
                      <CATEGORY>SWSRC</CATEGORY>
                    </AUTOSAR-ENGINEERING-OBJECT>
                    <AUTOSAR-ENGINEERING-OBJECT>
                      <SHORT-LABEL>Autosar::src::FrNm_HsmFrNmData.c</SHORT-LABEL>
                      <CATEGORY>SWSRC</CATEGORY>
                    </AUTOSAR-ENGINEERING-OBJECT>
                    <AUTOSAR-ENGINEERING-OBJECT>
                      <SHORT-LABEL>Autosar::src::FrNm_HsmFrNmFnct.c</SHORT-LABEL>
                      <CATEGORY>SWSRC</CATEGORY>
                    </AUTOSAR-ENGINEERING-OBJECT>
                    <AUTOSAR-ENGINEERING-OBJECT>
                      <SHORT-LABEL>make::FrNm_defs.mak</SHORT-LABEL>
                      <CATEGORY>SWMAKE</CATEGORY>
                    </AUTOSAR-ENGINEERING-OBJECT>
                    <AUTOSAR-ENGINEERING-OBJECT>
                      <SHORT-LABEL>make::FrNm_rules.mak</SHORT-LABEL>
                      <CATEGORY>SWMAKE</CATEGORY>
                    </AUTOSAR-ENGINEERING-OBJECT>
                  </ARTIFACT-DESCRIPTORS>
                </CODE>
              </CODE-DESCRIPTORS>
              <PROGRAMMING-LANGUAGE>C</PROGRAMMING-LANGUAGE>
              <RESOURCE-CONSUMPTION>
                <SHORT-NAME>ResourceConsumption</SHORT-NAME>
                <MEMORY-SECTIONS>
                  <MEMORY-SECTION>
                    <SHORT-NAME>CODE</SHORT-NAME>
                    <SW-ADDRMETHOD-REF DEST="SW-ADDR-METHOD">/AUTOSAR_MemMap/SwAddrMethods/CODE</SW-ADDRMETHOD-REF>
                  </MEMORY-SECTION>
                  <MEMORY-SECTION>
                    <SHORT-NAME>CONFIG_DATA_UNSPECIFIED</SHORT-NAME>
                    <ALIGNMENT>UNSPECIFIED</ALIGNMENT>
                    <SW-ADDRMETHOD-REF DEST="SW-ADDR-METHOD">/AUTOSAR_MemMap/SwAddrMethods/CONFIG_DATA</SW-ADDRMETHOD-REF>
                  </MEMORY-SECTION>
                  <MEMORY-SECTION>
                    <SHORT-NAME>CONFIG_DATA_8</SHORT-NAME>
                    <ALIGNMENT>UNSPECIFIED</ALIGNMENT>
                    <SW-ADDRMETHOD-REF DEST="SW-ADDR-METHOD">/AUTOSAR_MemMap/SwAddrMethods/CONFIG_DATA</SW-ADDRMETHOD-REF>
                  </MEMORY-SECTION>
                  <MEMORY-SECTION>
                    <SHORT-NAME>VAR_INIT_BOOLEAN</SHORT-NAME>
                    <ALIGNMENT>UNSPECIFIED</ALIGNMENT>
                    <SW-ADDRMETHOD-REF DEST="SW-ADDR-METHOD">/AUTOSAR_MemMap/SwAddrMethods/VAR</SW-ADDRMETHOD-REF>
                  </MEMORY-SECTION>
                  <MEMORY-SECTION>
                    <SHORT-NAME>VAR_INIT_8</SHORT-NAME>
                    <ALIGNMENT>8</ALIGNMENT>
                    <SW-ADDRMETHOD-REF DEST="SW-ADDR-METHOD">/AUTOSAR_MemMap/SwAddrMethods/VAR</SW-ADDRMETHOD-REF>
                  </MEMORY-SECTION>
                  <MEMORY-SECTION>
                    <SHORT-NAME>CONST_8</SHORT-NAME>
                    <ALIGNMENT>8</ALIGNMENT>
                    <SW-ADDRMETHOD-REF DEST="SW-ADDR-METHOD">/AUTOSAR_MemMap/SwAddrMethods/CONST</SW-ADDRMETHOD-REF>
                  </MEMORY-SECTION>
                  <MEMORY-SECTION>
                    <SHORT-NAME>CONST_32</SHORT-NAME>
                    <ALIGNMENT>32</ALIGNMENT>
                    <SW-ADDRMETHOD-REF DEST="SW-ADDR-METHOD">/AUTOSAR_MemMap/SwAddrMethods/CONST</SW-ADDRMETHOD-REF>
                  </MEMORY-SECTION>
                  <MEMORY-SECTION>
                    <SHORT-NAME>CONST_UNSPECIFIED</SHORT-NAME>
                    <ALIGNMENT>UNSPECIFIED</ALIGNMENT>
                    <SW-ADDRMETHOD-REF DEST="SW-ADDR-METHOD">/AUTOSAR_MemMap/SwAddrMethods/CONST</SW-ADDRMETHOD-REF>
                  </MEMORY-SECTION>
                  <MEMORY-SECTION>
                    <SHORT-NAME>VAR_CLEARED_8</SHORT-NAME>
                    <ALIGNMENT>8</ALIGNMENT>
                    <SW-ADDRMETHOD-REF DEST="SW-ADDR-METHOD">/AUTOSAR_MemMap/SwAddrMethods/VAR_CLEARED</SW-ADDRMETHOD-REF>
                  </MEMORY-SECTION>
                  <MEMORY-SECTION>
                    <SHORT-NAME>VAR_CLEARED_UNSPECIFIED</SHORT-NAME>
                    <ALIGNMENT>UNSPECIFIED</ALIGNMENT>
                    <SW-ADDRMETHOD-REF DEST="SW-ADDR-METHOD">/AUTOSAR_MemMap/SwAddrMethods/VAR_CLEARED</SW-ADDRMETHOD-REF>
                  </MEMORY-SECTION>
                </MEMORY-SECTIONS>
              </RESOURCE-CONSUMPTION>
              <SW-VERSION>5.16.7</SW-VERSION>
              <VENDOR-ID>1</VENDOR-ID>
              <AR-RELEASE-VERSION>4.0.3</AR-RELEASE-VERSION>
              <BEHAVIOR-REF DEST="BSW-INTERNAL-BEHAVIOR">/AUTOSAR_FrNm/BswModuleDescriptions/FrNm/InternalBehavior_0</BEHAVIOR-REF>
              <VENDOR-SPECIFIC-MODULE-DEF-REFS>
                <VENDOR-SPECIFIC-MODULE-DEF-REF DEST="ECUC-MODULE-DEF">/TS_TxDxM5I16R0/FrNm</VENDOR-SPECIFIC-MODULE-DEF-REF>
              </VENDOR-SPECIFIC-MODULE-DEF-REFS>
            </BSW-IMPLEMENTATION>
          </ELEMENTS>
        </AR-PACKAGE>
      </AR-PACKAGES>
    </AR-PACKAGE>
  </AR-PACKAGES>
</AUTOSAR>
