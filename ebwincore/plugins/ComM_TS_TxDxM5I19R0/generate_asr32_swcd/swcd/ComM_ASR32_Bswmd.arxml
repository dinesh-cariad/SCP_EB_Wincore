<?xml version="1.0" encoding="ISO-8859-1"?>
[!AUTOSPACING!][!//
<AUTOSAR xmlns="http://autosar.org/3.2.2"
  xmlns:xsi="http://www.w3.org/2001/XMLSchema-instance"
  xsi:schemaLocation="http://autosar.org/3.2.2 AUTOSAR_STRICT_COMPACT.xsd">
[!IF "not(node:exists(as:modconf('ComM')[1]/ComMConfigSet/*[1]))"!][!//
[!ERROR "Configuration not exist!"!][!//
[!ENDIF!][!//
[!IF "ComMGeneral/ComMServiceAPI/ComMDefaultASRServiceAPI = 'AUTOSAR_32'"!][!//
[!VAR "bswModuleEntryPackageName" = "'SwServices'"!][!//
[!ELSE!][!//
[!VAR "bswModuleEntryPackageName" = "'BswModuleEntrys'"!][!//
[!ENDIF!][!//
  <TOP-LEVEL-PACKAGES>
    <AR-PACKAGE>
      <SHORT-NAME>AUTOSAR_ComM</SHORT-NAME>
      <SUB-PACKAGES>
        <AR-PACKAGE>
          <SHORT-NAME>BswModuleDescriptions</SHORT-NAME>
          <ELEMENTS>
            <BSW-MODULE-DESCRIPTION>
              <SHORT-NAME>ComM</SHORT-NAME>
              <MODULE-ID>12</MODULE-ID>
              <PROVIDED-ENTRY-REFS>
[!LOOP "ComMConfigSet/*[1]/ComMChannel/*"!]
                <PROVIDED-ENTRY-REF DEST="BSW-MODULE-ENTRY">/AUTOSAR_ComM/[!"$bswModuleEntryPackageName"!]/ComM_MainFunction_[!"ComMChannelId"!]</PROVIDED-ENTRY-REF>
[!ENDLOOP!]
              </PROVIDED-ENTRY-REFS>
            </BSW-MODULE-DESCRIPTION>
          </ELEMENTS>
        </AR-PACKAGE>
        <AR-PACKAGE>
          <SHORT-NAME>InternalBehaviors</SHORT-NAME>
          <ELEMENTS>
            <BSW-BEHAVIOR>
              <SHORT-NAME>InternalBehavior_0</SHORT-NAME>
              <ENTITYS>
[!LOOP "ComMConfigSet/*[1]/ComMChannel/*"!]
                <BSW-SCHEDULABLE-ENTITY>
                  <SHORT-NAME>ComM_MainFunction_[!"ComMChannelId"!]</SHORT-NAME>
                  <CAN-ENTER-EXCLUSIVE-AREA-REFS>
                    <CAN-ENTER-EXCLUSIVE-AREA-REF DEST="EXCLUSIVE-AREA">/AUTOSAR_ComM/InternalBehaviors/InternalBehavior_0/SCHM_COMM_EXCLUSIVE_AREA_0</CAN-ENTER-EXCLUSIVE-AREA-REF>
                  </CAN-ENTER-EXCLUSIVE-AREA-REFS>
                  <IMPLEMENTED-ENTRY-REF DEST="BSW-MODULE-ENTRY">/AUTOSAR_ComM/[!"$bswModuleEntryPackageName"!]/ComM_MainFunction_[!"ComMChannelId"!]</IMPLEMENTED-ENTRY-REF>
                </BSW-SCHEDULABLE-ENTITY>
[!ENDLOOP!]
              </ENTITYS>
              <EVENTS>
[!LOOP "ComMConfigSet/*[1]/ComMChannel/*"!]
                <BSW-CYCLIC-EVENT>
                  <SHORT-NAME>TimingEvent_MainFunction_[!"ComMChannelId"!]</SHORT-NAME>
                  <STARTS-ON-EVENT-REF DEST="BSW-SCHEDULABLE-ENTITY">/AUTOSAR_ComM/InternalBehaviors/InternalBehavior_0/ComM_MainFunction_[!"ComMChannelId"!]</STARTS-ON-EVENT-REF>
                  <CYCLE-TIME>[!"ComMMainFunctionPeriod"!]</CYCLE-TIME>
                </BSW-CYCLIC-EVENT>
[!ENDLOOP!]
              </EVENTS>
              <EXCLUSIVE-AREAS>
                <EXCLUSIVE-AREA>
                  <SHORT-NAME>SCHM_COMM_EXCLUSIVE_AREA_0</SHORT-NAME>
                </EXCLUSIVE-AREA>
              </EXCLUSIVE-AREAS>
              <MODULE-REF DEST="BSW-MODULE-DESCRIPTION">/AUTOSAR_ComM/BswModuleDescriptions/ComM</MODULE-REF>
            </BSW-BEHAVIOR>
          </ELEMENTS>
        </AR-PACKAGE>
        <AR-PACKAGE>
          <SHORT-NAME>[!"$bswModuleEntryPackageName"!]</SHORT-NAME>
          <ELEMENTS>
[!LOOP "ComMConfigSet/*[1]/ComMChannel/*"!]
            <BSW-MODULE-ENTRY>
              <SHORT-NAME>ComM_MainFunction_[!"ComMChannelId"!]</SHORT-NAME>
              <SW-SERVICE-PROPS>
                <SW-IMPL-POLICY>STANDARD</SW-IMPL-POLICY>
              </SW-SERVICE-PROPS>
              <CALL-TYPE>SCHEDULED</CALL-TYPE>
              <EXECUTION-CONTEXT>TASK</EXECUTION-CONTEXT>
              <IS-SYNCHRONOUS>true</IS-SYNCHRONOUS>
              <SERVICE-ID>96</SERVICE-ID>
            </BSW-MODULE-ENTRY>
[!ENDLOOP!]
          </ELEMENTS>
        </AR-PACKAGE>
      </SUB-PACKAGES>
    </AR-PACKAGE>
    <AR-PACKAGE>
      <SHORT-NAME>EB_ComM</SHORT-NAME>
      <SUB-PACKAGES>
        <AR-PACKAGE>
          <SHORT-NAME>Implementations</SHORT-NAME>
          <ELEMENTS>
            <BSW-IMPLEMENTATION>
              <SHORT-NAME>BswImplementation_0</SHORT-NAME>
              <CODE-DESCRIPTORS>
                <CODE>
                  <SHORT-NAME>ComMHeaderFiles</SHORT-NAME>
                  <TYPE>SRC</TYPE>
                  <XFILES>
                                        <XFILE>
                      <SHORT-NAME>Autosar_include_ComM_h</SHORT-NAME>
                      <URL>Autosar/include/ComM.h</URL>
                    </XFILE>
                    <XFILE>
                      <SHORT-NAME>Autosar_include_ComM_BSW_h</SHORT-NAME>
                      <URL>Autosar/include/ComM_BSW.h</URL>
                    </XFILE>
                    <XFILE>
                      <SHORT-NAME>Autosar_include_ComM_BSW_Cfg_h</SHORT-NAME>
                      <URL>Autosar/include/ComM_BSW_Cfg.h</URL>
                    </XFILE>
                    <XFILE>
                      <SHORT-NAME>Autosar_include_ComM_BSW_Types_h</SHORT-NAME>
                      <URL>Autosar/include/ComM_BSW_Types.h</URL>
                    </XFILE>
                    <XFILE>
                      <SHORT-NAME>Autosar_include_ComM_BusSm_h</SHORT-NAME>
                      <URL>Autosar/include/ComM_BusSm.h</URL>
                    </XFILE>
                    <XFILE>
                      <SHORT-NAME>Autosar_include_ComM_Dcm_h</SHORT-NAME>
                      <URL>Autosar/include/ComM_Dcm.h</URL>
                    </XFILE>
                    <XFILE>
                      <SHORT-NAME>Autosar_include_ComM_EcuMBswM_h</SHORT-NAME>
                      <URL>Autosar/include/ComM_EcuMBswM.h</URL>
                    </XFILE>
                    <XFILE>
                      <SHORT-NAME>Autosar_include_ComM_Hsm_h</SHORT-NAME>
                      <URL>Autosar/include/ComM_Hsm.h</URL>
                    </XFILE>
                    <XFILE>
                      <SHORT-NAME>Autosar_include_ComM_HsmCfg_h</SHORT-NAME>
                      <URL>Autosar/include/ComM_HsmCfg.h</URL>
                    </XFILE>
                    <XFILE>
                      <SHORT-NAME>Autosar_include_ComM_HsmComM_h</SHORT-NAME>
                      <URL>Autosar/include/ComM_HsmComM.h</URL>
                    </XFILE>
                    <XFILE>
                      <SHORT-NAME>Autosar_include_ComM_HsmComMInt_h</SHORT-NAME>
                      <URL>Autosar/include/ComM_HsmComMInt.h</URL>
                    </XFILE>
                    <XFILE>
                      <SHORT-NAME>Autosar_include_ComM_HsmComMPnc_h</SHORT-NAME>
                      <URL>Autosar/include/ComM_HsmComMPnc.h</URL>
                    </XFILE>
                    <XFILE>
                      <SHORT-NAME>Autosar_include_ComM_HsmComMPncInt_h</SHORT-NAME>
                      <URL>Autosar/include/ComM_HsmComMPncInt.h</URL>
                    </XFILE>
                    <XFILE>
                      <SHORT-NAME>Autosar_include_ComM_Int_h</SHORT-NAME>
                      <URL>Autosar/include/ComM_Int.h</URL>
                    </XFILE>
                    <XFILE>
                      <SHORT-NAME>Autosar_include_ComM_Nm_h</SHORT-NAME>
                      <URL>Autosar/include/ComM_Nm.h</URL>
                    </XFILE>
                    <XFILE>
                      <SHORT-NAME>Autosar_include_ComM_Trace_h</SHORT-NAME>
                      <URL>Autosar/include/ComM_Trace.h</URL>
                    </XFILE>
                    <XFILE>
                      <SHORT-NAME>Autosar_include_ComM_Trace_Internal_h</SHORT-NAME>
                      <URL>Autosar/include/ComM_Trace_Internal.h</URL>
                    </XFILE>
                    <XFILE>
                      <SHORT-NAME>Autosar_include_ComM_Types_h</SHORT-NAME>
                      <URL>Autosar/include/ComM_Types.h</URL>
                    </XFILE>
                    <XFILE>
                      <SHORT-NAME>Autosar_include_ComM_Version_h</SHORT-NAME>
                      <URL>Autosar/include/ComM_Version.h</URL>
                    </XFILE>
                  </XFILES>
                </CODE>
                <CODE>
                  <SHORT-NAME>ComMSourceFiles</SHORT-NAME>
                  <TYPE>SRC</TYPE>
                  <XFILES>
                                        <XFILE>
                      <SHORT-NAME>Autosar_src_ComM_c</SHORT-NAME>
                      <URL>Autosar/src/ComM.c</URL>
                    </XFILE>
                    <XFILE>
                      <SHORT-NAME>Autosar_src_ComM_ASR32_Rte_c</SHORT-NAME>
                      <URL>Autosar/src/ComM_ASR32_Rte.c</URL>
                    </XFILE>
                    <XFILE>
                      <SHORT-NAME>Autosar_src_ComM_ASR40_Rte_c</SHORT-NAME>
                      <URL>Autosar/src/ComM_ASR40_Rte.c</URL>
                    </XFILE>
                    <XFILE>
                      <SHORT-NAME>Autosar_src_ComM_Hsm_c</SHORT-NAME>
                      <URL>Autosar/src/ComM_Hsm.c</URL>
                    </XFILE>
                    <XFILE>
                      <SHORT-NAME>Autosar_src_ComM_HsmComMData_c</SHORT-NAME>
                      <URL>Autosar/src/ComM_HsmComMData.c</URL>
                    </XFILE>
                    <XFILE>
                      <SHORT-NAME>Autosar_src_ComM_HsmComMFnct_c</SHORT-NAME>
                      <URL>Autosar/src/ComM_HsmComMFnct.c</URL>
                    </XFILE>
                    <XFILE>
                      <SHORT-NAME>Autosar_src_ComM_HsmComMPncData_c</SHORT-NAME>
                      <URL>Autosar/src/ComM_HsmComMPncData.c</URL>
                    </XFILE>
                    <XFILE>
                      <SHORT-NAME>Autosar_src_ComM_HsmComMPncFnct_c</SHORT-NAME>
                      <URL>Autosar/src/ComM_HsmComMPncFnct.c</URL>
                    </XFILE>
                    <XFILE>
                      <SHORT-NAME>Autosar_src_ComM_Rte_c</SHORT-NAME>
                      <URL>Autosar/src/ComM_Rte.c</URL>
                    </XFILE>
                  </XFILES>
                </CODE>
              </CODE-DESCRIPTORS>
              <PROGRAMMING-LANGUAGE>C</PROGRAMMING-LANGUAGE>
              <RESOURCE-CONSUMPTION>
                <SHORT-NAME>Resources</SHORT-NAME>
                <OBJECT-FILE-SECTIONS>
                  <MEMORY-SECTION>
                    <SHORT-NAME>CODE</SHORT-NAME>
                    <ALIGNMENT>1</ALIGNMENT>
                    <SECTION-NAME>CODE</SECTION-NAME>
                    <SECTION-TYPE>CODE</SECTION-TYPE>
                    <SIZE>0</SIZE>
                    <SW-ADDR-METHOD-REFS>
                      <SW-ADDR-METHOD-REF DEST="SW-ADDR-METHOD">/AUTOSAR_MemMap/SwAddrMethods/CODE</SW-ADDR-METHOD-REF>
                    </SW-ADDR-METHOD-REFS>
                  </MEMORY-SECTION>
                </OBJECT-FILE-SECTIONS>
              </RESOURCE-CONSUMPTION>
              <SW-MAJOR-VERSION>5</SW-MAJOR-VERSION>
              <SW-MINOR-VERSION>19</SW-MINOR-VERSION>
              <SW-PATCH-VERSION>7</SW-PATCH-VERSION>
              <VENDOR-ID>1</VENDOR-ID>
              <AR-MAJOR-VERSION>4</AR-MAJOR-VERSION>
              <AR-MINOR-VERSION>1</AR-MINOR-VERSION>
              <AR-PATCH-VERSION>3</AR-PATCH-VERSION>
              <BEHAVIOR-REF DEST="BSW-BEHAVIOR">/AUTOSAR_ComM/InternalBehaviors/InternalBehavior_0</BEHAVIOR-REF>
              <VENDOR-API-INFIX></VENDOR-API-INFIX>
            </BSW-IMPLEMENTATION>
          </ELEMENTS>
        </AR-PACKAGE>
      </SUB-PACKAGES>
    </AR-PACKAGE>
  </TOP-LEVEL-PACKAGES>
</AUTOSAR>
