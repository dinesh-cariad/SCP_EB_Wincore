[!AUTOSPACING!]
[!//
[!/* determine FiM extension support and calibration support */!][!//
[!IF "node:exists(FiMGeneral/FiMExtendedSupport) and (FiMGeneral/FiMExtendedSupport = 'true')"!]
  [!VAR "ExtendedLevel" = "FiMGeneral/FiMExtendedLevel"!]
[!ELSE!][!//
  [!VAR "ExtendedLevel" = "'FIM_NO_EXTENSION'"!]
[!ENDIF!]
[!//
<?xml version="1.0" encoding="UTF-8"?>
<AUTOSAR xmlns="http://autosar.org/schema/r4.0"
  xmlns:xsi="http://www.w3.org/2001/XMLSchema-instance"
  xsi:schemaLocation="http://autosar.org/schema/r4.0 AUTOSAR_4-0-3_STRICT_COMPACT.xsd">
[!/* do not generate this file if RTE is not used */!][!//
[!SKIPFILE "FiMGeneral/FiMRteUsage = 'false'"!][!//
  <AR-PACKAGES>
    <AR-PACKAGE>
      <SHORT-NAME>AUTOSAR_FiM</SHORT-NAME>
      <ELEMENTS/>
      <AR-PACKAGES>
        <AR-PACKAGE>
          <SHORT-NAME>PortInterfaces</SHORT-NAME>
          <ELEMENTS>
            <CLIENT-SERVER-INTERFACE>
              <SHORT-NAME>FunctionInhibition</SHORT-NAME>
              <IS-SERVICE>true</IS-SERVICE>
              <OPERATIONS>
                <!-- Operation GetFunctionPermission -->
                <CLIENT-SERVER-OPERATION>
                  <SHORT-NAME>GetFunctionPermission</SHORT-NAME>
                  <ARGUMENTS>
                    <ARGUMENT-DATA-PROTOTYPE>
                      <SHORT-NAME>Permission</SHORT-NAME>
                      <TYPE-TREF DEST="IMPLEMENTATION-DATA-TYPE">/AUTOSAR_Platform/ImplementationDataTypes/boolean</TYPE-TREF>
                      <DIRECTION>OUT</DIRECTION>
                    </ARGUMENT-DATA-PROTOTYPE>
                  </ARGUMENTS>
                  <POSSIBLE-ERROR-REFS>
                    <POSSIBLE-ERROR-REF DEST="APPLICATION-ERROR">/AUTOSAR_FiM/PortInterfaces/FunctionInhibition/E_NOT_OK</POSSIBLE-ERROR-REF>
                  </POSSIBLE-ERROR-REFS>
                </CLIENT-SERVER-OPERATION>
              </OPERATIONS>
              <POSSIBLE-ERRORS>
                <APPLICATION-ERROR>
                  <SHORT-NAME>E_NOT_OK</SHORT-NAME>
                  <ERROR-CODE>1</ERROR-CODE>
                </APPLICATION-ERROR>
              </POSSIBLE-ERRORS>
            </CLIENT-SERVER-INTERFACE>
[!IF "$ExtendedLevel != 'FIM_NO_EXTENSION'"!][!//
            <CLIENT-SERVER-INTERFACE>
              <SHORT-NAME>Message</SHORT-NAME>
              <IS-SERVICE>true</IS-SERVICE>
              <OPERATIONS>
                <!-- !LINKSTO VCC-FIM-003:Req18v1,1 -->
                <!-- Operation GetMessageStatus -->
                <CLIENT-SERVER-OPERATION>
                  <SHORT-NAME>GetMessageStatus</SHORT-NAME>
                  <ARGUMENTS>
                    <ARGUMENT-DATA-PROTOTYPE>
                      <SHORT-NAME>Status</SHORT-NAME>
                      <TYPE-TREF DEST="IMPLEMENTATION-DATA-TYPE">/AUTOSAR_Platform/ImplementationDataTypes/boolean</TYPE-TREF>
                      <DIRECTION>OUT</DIRECTION>
                    </ARGUMENT-DATA-PROTOTYPE>
                  </ARGUMENTS>
                  <POSSIBLE-ERROR-REFS>
                    <POSSIBLE-ERROR-REF DEST="APPLICATION-ERROR">/AUTOSAR_FiM/PortInterfaces/Message/E_NOT_OK</POSSIBLE-ERROR-REF>
                  </POSSIBLE-ERROR-REFS>
                </CLIENT-SERVER-OPERATION>
              </OPERATIONS>
              <POSSIBLE-ERRORS>
                <APPLICATION-ERROR>
                  <SHORT-NAME>E_NOT_OK</SHORT-NAME>
                  <ERROR-CODE>1</ERROR-CODE>
                </APPLICATION-ERROR>
              </POSSIBLE-ERRORS>
            </CLIENT-SERVER-INTERFACE>
[!ENDIF!][!//
          </ELEMENTS>
        </AR-PACKAGE>
      </AR-PACKAGES>
    </AR-PACKAGE>
  </AR-PACKAGES>
</AUTOSAR>
