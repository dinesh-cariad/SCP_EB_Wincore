AUTOSAR XML (schema 4-0-3)
package /AUTOSAR_CryIf/BswModuleDescriptions
  bsw module description CryIf: module-id=112, provided-entrys=CryIf_Init
    bsw internal behavior InternalBehavior_0
      bsw called entity CryIf_Init: implemented-entry=CryIf_Init
package /AUTOSAR_CryIf/BswModuleEntrys
  bsw module entry CryIf_Init: service-id=55, is-reentrant=false, is-synchronous=true, call-type=REGULAR, execution-context=UNSPECIFIED, sw-service-impl-policy=STANDARD
package /EB_CryIf/Implementations
  bsw implementation BswImplementation_0: programming-language=C, sw-version=1.0.24, vendor-id=1, ar-release-version=4.3.0, behavior=InternalBehavior_0, vendor-specific-module-def=CryIf
    code-descriptors:
      code Files
        artifact-descriptors:
          short-label=Autosar::include::CryIf.h, category=SWHDR
          short-label=Autosar::include::CryIf_Cbk.h, category=SWHDR
          short-label=Autosar::include::CryIf_Version.h, category=SWHDR
          short-label=Autosar::src::CryIf.c, category=SWSRC
          short-label=make::CryIf_defs.mak, category=SWMAKE
          short-label=make::CryIf_rules.mak, category=SWMAKE
    resource consumption ResourceConsumption
      4 x memory section:
        CODE: sw-addrmethod=CODE
        CONST_UNSPECIFIED: alignment=UNSPECIFIED, sw-addrmethod=CONST
        CONST_32: alignment=32, sw-addrmethod=CONST
        VAR_INIT_BOOLEAN: alignment=BOOLEAN, sw-addrmethod=VAR
